AUTOSAR XML (schema 4-0-3)
package /DaVinci_Project
  module config Rte
    9 x RteBswModuleInstance:
      BswM
        BswM_MainFunctionTimingEvent0 (RteBswEventToTaskMapping): RteBswUsedOsEventRef=Rte_Ev_Cyclic2_TaskSchM_Core0_0_10ms, RteBswUsedOsAlarmRef=Os/Rte_Al_TE2_TaskSchM_Core0_0_10ms
      Can
        3 x RteBswEventToTaskMapping, all with RteBswUsedOsEventRef=Rte_Ev_Cyclic2_TaskSchM_Core0_0_10ms, RteBswUsedOsAlarmRef=Os/Rte_Al_TE2_TaskSchM_Core0_0_10ms:
          Can_MainFunction_BusOffTimingEvent0
          Can_MainFunction_ModeTimingEvent0
          Can_MainFunction_WakeupTimingEvent0
      CanIf
      CanSM
        CanSM_MainFunctionTimingEvent0 (RteBswEventToTaskMapping): RteBswUsedOsEventRef=Rte_Ev_Cyclic2_TaskSchM_Core0_0_10ms, RteBswUsedOsAlarmRef=Os/Rte_Al_TE2_TaskSchM_Core0_0_10ms
      Com
        Com_MainFunctionRxTimingEvent0 (RteBswEventToTaskMapping): RteBswUsedOsEventRef=Rte_Ev_Cyclic2_TaskSchM_Core0_0_10ms, RteBswUsedOsAlarmRef=Os/Rte_Al_TE2_TaskSchM_Core0_0_10ms
        Com_MainFunctionTxTimingEvent0 (RteBswEventToTaskMapping): RteBswUsedOsEventRef=Rte_Ev_Cyclic2_TaskSchM_Core0_0_10ms, RteBswUsedOsAlarmRef=Os/Rte_Al_TE2_TaskSchM_Core0_0_10ms
      ComM
        ComM_MainFunction_0TimingEvent0 (RteBswEventToTaskMapping): RteBswUsedOsEventRef=Rte_Ev_Cyclic2_TaskSchM_Core0_0_20ms, RteBswUsedOsAlarmRef=Os/Rte_Al_TE2_TaskSchM_Core0_0_20ms
      Det
      EcuM
        3 x RteBswEventToTaskMapping:
          EcuM_MainFunctionTimingEvent0: RteBswUsedOsEventRef=Rte_Ev_Cyclic2_TaskSchM_Core0_0_10ms, RteBswUsedOsAlarmRef=Os/Rte_Al_TE2_TaskSchM_Core0_0_10ms
          EcuM_MainFunctionTimingEvent1: RteBswUsedOsAlarmRef=Os/Rte_Al_TE2_EcuM_EcuM_MainFunction
          EcuM_MainFunctionTimingEvent2: RteBswUsedOsAlarmRef=Os/Rte_Al_TE3_EcuM_EcuM_MainFunction
      PduR
    10 x RteSwComponentInstance:
      BswM_EcuSwComposition
        Timer_BswM_MainFunction (RteEventToTaskMapping): RteUsedOsEventRef=Rte_Ev_Cyclic2_TaskSchM_Core0_0_10ms, RteUsedOsAlarmRef=Os/Rte_Al_TE2_TaskSchM_Core0_0_10ms
      ComM_EcuSwComposition
        Timer_ComM_MainFunction_0 (RteEventToTaskMapping): RteUsedOsEventRef=Rte_Ev_Cyclic2_TaskSchM_Core0_0_20ms, RteUsedOsAlarmRef=Os/Rte_Al_TE2_TaskSchM_Core0_0_20ms
      CpAp_FAWDemo_Core0_EcuSwComposition
        9 x RteEventToTaskMapping:
          TMT_Runnable1000ms_Core0: RteUsedOsAlarmRef=Os/Rte_Al_TE_CpAp_FAWDemo_Core0_Runnable1000ms_Core0
          TMT_Runnable100ms_Core0: RteUsedOsAlarmRef=Os/Rte_Al_TE_CpAp_FAWDemo_Core0_Runnable100ms_Core0
          TMT_Runnable10ms_Core0: RteUsedOsAlarmRef=Os/Rte_Al_TE_CpAp_FAWDemo_Core0_Runnable10ms_Core0
          TMT_Runnable1ms_Core0: RteUsedOsAlarmRef=Os/Rte_Al_TE_CpAp_FAWDemo_Core0_Runnable1ms_Core0
          TMT_Runnable200ms_Core0: RteUsedOsAlarmRef=Os/Rte_Al_TE_CpAp_FAWDemo_Core0_Runnable200ms_Core0
          TMT_Runnable20ms_Core0: RteUsedOsAlarmRef=Os/Rte_Al_TE_CpAp_FAWDemo_Core0_Runnable20ms_Core0
          TMT_Runnable500ms_Core0: RteUsedOsAlarmRef=Os/Rte_Al_TE_CpAp_FAWDemo_Core0_Runnable500ms_Core0
          TMT_Runnable50ms_Core0: RteUsedOsAlarmRef=Os/Rte_Al_TE_CpAp_FAWDemo_Core0_Runnable50ms_Core0
          TMT_Runnable5ms_Core0: RteUsedOsAlarmRef=Os/Rte_Al_TE_CpAp_FAWDemo_Core0_Runnable5ms_Core0
      CpAp_FAWDemo_Core1_EcuSwComposition
        9 x RteEventToTaskMapping:
          TMT_Runnable1000ms_Core1: RteUsedOsAlarmRef=Os/Rte_Al_TE_CpAp_FAWDemo_Core1_Runnable1000ms_Core1
          TMT_Runnable100ms_Core1: RteUsedOsAlarmRef=Os/Rte_Al_TE_CpAp_FAWDemo_Core1_Runnable100ms_Core1
          TMT_Runnable10ms_Core1: RteUsedOsAlarmRef=Os/Rte_Al_TE_CpAp_FAWDemo_Core1_Runnable10ms_Core1
          TMT_Runnable1ms_Core1: RteUsedOsAlarmRef=Os/Rte_Al_TE_CpAp_FAWDemo_Core1_Runnable1ms_Core1
          TMT_Runnable200ms_Core1: RteUsedOsAlarmRef=Os/Rte_Al_TE_CpAp_FAWDemo_Core1_Runnable200ms_Core1
          TMT_Runnable20ms_Core1: RteUsedOsAlarmRef=Os/Rte_Al_TE_CpAp_FAWDemo_Core1_Runnable20ms_Core1
          TMT_Runnable500ms_Core1: RteUsedOsAlarmRef=Os/Rte_Al_TE_CpAp_FAWDemo_Core1_Runnable500ms_Core1
          TMT_Runnable50ms_Core1: RteUsedOsAlarmRef=Os/Rte_Al_TE_CpAp_FAWDemo_Core1_Runnable50ms_Core1
          TMT_Runnable5ms_Core1: RteUsedOsAlarmRef=Os/Rte_Al_TE_CpAp_FAWDemo_Core1_Runnable5ms_Core1
      CpAp_FAWDemo_Core2_EcuSwComposition
        9 x RteEventToTaskMapping:
          TMT_Runnable1000ms_Core2: RteUsedOsAlarmRef=Os/Rte_Al_TE_CpAp_FAWDemo_Core2_Runnable1000ms_Core2
          TMT_Runnable100ms_Core2: RteUsedOsAlarmRef=Os/Rte_Al_TE_CpAp_FAWDemo_Core2_Runnable100ms_Core2
          TMT_Runnable10ms_Core2: RteUsedOsAlarmRef=Os/Rte_Al_TE_CpAp_FAWDemo_Core2_Runnable10ms_Core2
          TMT_Runnable1ms_Core2: RteUsedOsAlarmRef=Os/Rte_Al_TE_CpAp_FAWDemo_Core2_Runnable1ms_Core2
          TMT_Runnable200ms_Core2: RteUsedOsAlarmRef=Os/Rte_Al_TE_CpAp_FAWDemo_Core2_Runnable200ms_Core2
          TMT_Runnable20ms_Core2: RteUsedOsAlarmRef=Os/Rte_Al_TE_CpAp_FAWDemo_Core2_Runnable20ms_Core2
          TMT_Runnable500ms_Core2: RteUsedOsAlarmRef=Os/Rte_Al_TE_CpAp_FAWDemo_Core2_Runnable500ms_Core2
          TMT_Runnable50ms_Core2: RteUsedOsAlarmRef=Os/Rte_Al_TE_CpAp_FAWDemo_Core2_Runnable50ms_Core2
          TMT_Runnable5ms_Core2: RteUsedOsAlarmRef=Os/Rte_Al_TE_CpAp_FAWDemo_Core2_Runnable5ms_Core2
      Det_EcuSwComposition
      EcuM_EcuSwComposition
        Timer_EcuM_MainFunction (RteEventToTaskMapping): RteUsedOsEventRef=Rte_Ev_Cyclic2_TaskSchM_Core0_0_10ms, RteUsedOsAlarmRef=Os/Rte_Al_TE2_TaskSchM_Core0_0_10ms
      Os_OsCore{0..2}_swc_EcuSwComposition
    RteOsInteraction
      31 x RteUsedOsActivation, all with RteExpectedActivationOffset=0:
        Rte_Al_TE_CpAp_FAWDemo_Core{0..2}_Runnable1000ms_Core{0..2}: RteActivationOsAlarmRef=Os/Rte_Al_TE_CpAp_FAWDemo_Core{0..2}_Runnable1000ms_Core{0..2}, RteActivationOsTaskRef=Task1000ms_Core{0..2}
        Rte_Al_TE_CpAp_FAWDemo_Core{0..2}_Runnable100ms_Core{0..2}: RteActivationOsAlarmRef=Os/Rte_Al_TE_CpAp_FAWDemo_Core{0..2}_Runnable100ms_Core{0..2}, RteActivationOsTaskRef=Task100ms_Core{0..2}
        Rte_Al_TE_CpAp_FAWDemo_Core{0..2}_Runnable10ms_Core{0..2}: RteActivationOsAlarmRef=Os/Rte_Al_TE_CpAp_FAWDemo_Core{0..2}_Runnable10ms_Core{0..2}, RteActivationOsTaskRef=Task10ms_Core{0..2}
        Rte_Al_TE_CpAp_FAWDemo_Core{0..2}_Runnable1ms_Core{0..2}: RteActivationOsAlarmRef=Os/Rte_Al_TE_CpAp_FAWDemo_Core{0..2}_Runnable1ms_Core{0..2}, RteActivationOsTaskRef=Task1ms_Core{0..2}
        Rte_Al_TE_CpAp_FAWDemo_Core{0..2}_Runnable200ms_Core{0..2}: RteActivationOsAlarmRef=Os/Rte_Al_TE_CpAp_FAWDemo_Core{0..2}_Runnable200ms_Core{0..2}, RteActivationOsTaskRef=Task200ms_Core{0..2}
        Rte_Al_TE_CpAp_FAWDemo_Core{0..2}_Runnable20ms_Core{0..2}: RteActivationOsAlarmRef=Os/Rte_Al_TE_CpAp_FAWDemo_Core{0..2}_Runnable20ms_Core{0..2}, RteActivationOsTaskRef=Task20ms_Core{0..2}
        Rte_Al_TE_CpAp_FAWDemo_Core{0..2}_Runnable500ms_Core{0..2}: RteActivationOsAlarmRef=Os/Rte_Al_TE_CpAp_FAWDemo_Core{0..2}_Runnable500ms_Core{0..2}, RteActivationOsTaskRef=Task500ms_Core{0..2}
        Rte_Al_TE_CpAp_FAWDemo_Core{0..2}_Runnable50ms_Core{0..2}: RteActivationOsAlarmRef=Os/Rte_Al_TE_CpAp_FAWDemo_Core{0..2}_Runnable50ms_Core{0..2}, RteActivationOsTaskRef=Task50ms_Core{0..2}
        Rte_Al_TE_CpAp_FAWDemo_Core{0..2}_Runnable5ms_Core{0..2}: RteActivationOsAlarmRef=Os/Rte_Al_TE_CpAp_FAWDemo_Core{0..2}_Runnable5ms_Core{0..2}, RteActivationOsTaskRef=Task5ms_Core{0..2}
        Rte_Al_TE2_TaskSchM_Core0_0_10ms: RteActivationOsAlarmRef=Os/Rte_Al_TE2_TaskSchM_Core0_0_10ms, RteActivationOsTaskRef=TaskSchM_Core0
        Rte_Al_TE2_TaskSchM_Core0_0_20ms: RteActivationOsAlarmRef=Os/Rte_Al_TE2_TaskSchM_Core0_0_20ms, RteActivationOsTaskRef=TaskSchM_Core0
        Rte_Al_TE2_EcuM_EcuM_MainFunction: RteActivationOsAlarmRef=Os/Rte_Al_TE2_EcuM_EcuM_MainFunction, RteActivationOsTaskRef=TaskSchM_Core1
        Rte_Al_TE3_EcuM_EcuM_MainFunction: RteActivationOsAlarmRef=Os/Rte_Al_TE3_EcuM_EcuM_MainFunction, RteActivationOsTaskRef=TaskSchM_Core2
  module config NvM
  module config Os
    Task1000ms_Core0 (OsTask):
      OsTaskActivation = 1
      OsTaskPriority = 51
      OsTaskSchedule = FULL
      OsTaskAccessingApplication = OsApplication_Core1
      OsTaskAccessingApplication = OsApplication_Core2
    Rte_Al_TE_CpAp_FAWDemo_Core0_Runnable1000ms_Core0 (OsAlarm): OsAlarmCounterRef=SystemTimer_Core0, OsAlarmAccessingApplication=OsApplication_Core1, OsAlarmAccessingApplication=OsApplication_Core2
      OsAlarmAction
        OsAlarmActivateTask: OsAlarmActivateTaskRef=Task1000ms_Core0
    Task1000ms_Core1 (OsTask):
      OsTaskActivation = 1
      OsTaskPriority = 51
      OsTaskSchedule = FULL
      OsTaskAccessingApplication = OsApplication_Core0
      OsTaskAccessingApplication = OsApplication_Core2
    Rte_Al_TE_CpAp_FAWDemo_Core1_Runnable1000ms_Core1 (OsAlarm): OsAlarmCounterRef=SystemTimer_Core1, OsAlarmAccessingApplication=OsApplication_Core0, OsAlarmAccessingApplication=OsApplication_Core2
      OsAlarmAction
        OsAlarmActivateTask: OsAlarmActivateTaskRef=Task1000ms_Core1
    Task1000ms_Core2 (OsTask):
      OsTaskActivation = 1
      OsTaskPriority = 51
      OsTaskSchedule = FULL
      OsTaskAccessingApplication = OsApplication_Core0
      OsTaskAccessingApplication = OsApplication_Core1
    Rte_Al_TE_CpAp_FAWDemo_Core2_Runnable1000ms_Core2 (OsAlarm): OsAlarmCounterRef=SystemTimer_Core2, OsAlarmAccessingApplication=OsApplication_Core0, OsAlarmAccessingApplication=OsApplication_Core1
      OsAlarmAction
        OsAlarmActivateTask: OsAlarmActivateTaskRef=Task1000ms_Core2
    Task100ms_Core0 (OsTask):
      OsTaskActivation = 1
      OsTaskPriority = 54
      OsTaskSchedule = FULL
      OsTaskAccessingApplication = OsApplication_Core1
      OsTaskAccessingApplication = OsApplication_Core2
    Rte_Al_TE_CpAp_FAWDemo_Core0_Runnable100ms_Core0 (OsAlarm): OsAlarmCounterRef=SystemTimer_Core0, OsAlarmAccessingApplication=OsApplication_Core1, OsAlarmAccessingApplication=OsApplication_Core2
      OsAlarmAction
        OsAlarmActivateTask: OsAlarmActivateTaskRef=Task100ms_Core0
    Task100ms_Core1 (OsTask):
      OsTaskActivation = 1
      OsTaskPriority = 54
      OsTaskSchedule = FULL
      OsTaskAccessingApplication = OsApplication_Core0
      OsTaskAccessingApplication = OsApplication_Core2
    Rte_Al_TE_CpAp_FAWDemo_Core1_Runnable100ms_Core1 (OsAlarm): OsAlarmCounterRef=SystemTimer_Core1, OsAlarmAccessingApplication=OsApplication_Core0, OsAlarmAccessingApplication=OsApplication_Core2
      OsAlarmAction
        OsAlarmActivateTask: OsAlarmActivateTaskRef=Task100ms_Core1
    Task100ms_Core2 (OsTask):
      OsTaskActivation = 1
      OsTaskPriority = 54
      OsTaskSchedule = FULL
      OsTaskAccessingApplication = OsApplication_Core0
      OsTaskAccessingApplication = OsApplication_Core1
    Rte_Al_TE_CpAp_FAWDemo_Core2_Runnable100ms_Core2 (OsAlarm): OsAlarmCounterRef=SystemTimer_Core2, OsAlarmAccessingApplication=OsApplication_Core0, OsAlarmAccessingApplication=OsApplication_Core1
      OsAlarmAction
        OsAlarmActivateTask: OsAlarmActivateTaskRef=Task100ms_Core2
    Task10ms_Core0 (OsTask):
      OsTaskActivation = 1
      OsTaskPriority = 57
      OsTaskSchedule = FULL
      OsTaskAccessingApplication = OsApplication_Core1
      OsTaskAccessingApplication = OsApplication_Core2
    Rte_Al_TE_CpAp_FAWDemo_Core0_Runnable10ms_Core0 (OsAlarm): OsAlarmCounterRef=SystemTimer_Core0, OsAlarmAccessingApplication=OsApplication_Core1, OsAlarmAccessingApplication=OsApplication_Core2
      OsAlarmAction
        OsAlarmActivateTask: OsAlarmActivateTaskRef=Task10ms_Core0
    Task10ms_Core1 (OsTask):
      OsTaskActivation = 1
      OsTaskPriority = 57
      OsTaskSchedule = FULL
      OsTaskAccessingApplication = OsApplication_Core0
      OsTaskAccessingApplication = OsApplication_Core2
    Rte_Al_TE_CpAp_FAWDemo_Core1_Runnable10ms_Core1 (OsAlarm): OsAlarmCounterRef=SystemTimer_Core1, OsAlarmAccessingApplication=OsApplication_Core0, OsAlarmAccessingApplication=OsApplication_Core2
      OsAlarmAction
        OsAlarmActivateTask: OsAlarmActivateTaskRef=Task10ms_Core1
    Task10ms_Core2 (OsTask):
      OsTaskActivation = 1
      OsTaskPriority = 57
      OsTaskSchedule = FULL
      OsTaskAccessingApplication = OsApplication_Core0
      OsTaskAccessingApplication = OsApplication_Core1
    Rte_Al_TE_CpAp_FAWDemo_Core2_Runnable10ms_Core2 (OsAlarm): OsAlarmCounterRef=SystemTimer_Core2, OsAlarmAccessingApplication=OsApplication_Core0, OsAlarmAccessingApplication=OsApplication_Core1
      OsAlarmAction
        OsAlarmActivateTask: OsAlarmActivateTaskRef=Task10ms_Core2
    Task1ms_Core0 (OsTask):
      OsTaskActivation = 1
      OsTaskPriority = 59
      OsTaskSchedule = FULL
      OsTaskAccessingApplication = OsApplication_Core1
      OsTaskAccessingApplication = OsApplication_Core2
    Rte_Al_TE_CpAp_FAWDemo_Core0_Runnable1ms_Core0 (OsAlarm): OsAlarmCounterRef=SystemTimer_Core0, OsAlarmAccessingApplication=OsApplication_Core1, OsAlarmAccessingApplication=OsApplication_Core2
      OsAlarmAction
        OsAlarmActivateTask: OsAlarmActivateTaskRef=Task1ms_Core0
    Task1ms_Core1 (OsTask):
      OsTaskActivation = 1
      OsTaskPriority = 59
      OsTaskSchedule = FULL
      OsTaskAccessingApplication = OsApplication_Core0
      OsTaskAccessingApplication = OsApplication_Core2
    Rte_Al_TE_CpAp_FAWDemo_Core1_Runnable1ms_Core1 (OsAlarm): OsAlarmCounterRef=SystemTimer_Core1, OsAlarmAccessingApplication=OsApplication_Core0, OsAlarmAccessingApplication=OsApplication_Core2
      OsAlarmAction
        OsAlarmActivateTask: OsAlarmActivateTaskRef=Task1ms_Core1
    Task1ms_Core2 (OsTask):
      OsTaskActivation = 1
      OsTaskPriority = 59
      OsTaskSchedule = FULL
      OsTaskAccessingApplication = OsApplication_Core0
      OsTaskAccessingApplication = OsApplication_Core1
    Rte_Al_TE_CpAp_FAWDemo_Core2_Runnable1ms_Core2 (OsAlarm): OsAlarmCounterRef=SystemTimer_Core2, OsAlarmAccessingApplication=OsApplication_Core0, OsAlarmAccessingApplication=OsApplication_Core1
      OsAlarmAction
        OsAlarmActivateTask: OsAlarmActivateTaskRef=Task1ms_Core2
    Task200ms_Core0 (OsTask):
      OsTaskActivation = 1
      OsTaskPriority = 53
      OsTaskSchedule = FULL
      OsTaskAccessingApplication = OsApplication_Core1
      OsTaskAccessingApplication = OsApplication_Core2
    Rte_Al_TE_CpAp_FAWDemo_Core0_Runnable200ms_Core0 (OsAlarm): OsAlarmCounterRef=SystemTimer_Core0, OsAlarmAccessingApplication=OsApplication_Core1, OsAlarmAccessingApplication=OsApplication_Core2
      OsAlarmAction
        OsAlarmActivateTask: OsAlarmActivateTaskRef=Task200ms_Core0
    Task200ms_Core1 (OsTask):
      OsTaskActivation = 1
      OsTaskPriority = 53
      OsTaskSchedule = FULL
      OsTaskAccessingApplication = OsApplication_Core0
      OsTaskAccessingApplication = OsApplication_Core2
    Rte_Al_TE_CpAp_FAWDemo_Core1_Runnable200ms_Core1 (OsAlarm): OsAlarmCounterRef=SystemTimer_Core1, OsAlarmAccessingApplication=OsApplication_Core0, OsAlarmAccessingApplication=OsApplication_Core2
      OsAlarmAction
        OsAlarmActivateTask: OsAlarmActivateTaskRef=Task200ms_Core1
    Task200ms_Core2 (OsTask):
      OsTaskActivation = 1
      OsTaskPriority = 53
      OsTaskSchedule = FULL
      OsTaskAccessingApplication = OsApplication_Core0
      OsTaskAccessingApplication = OsApplication_Core1
    Rte_Al_TE_CpAp_FAWDemo_Core2_Runnable200ms_Core2 (OsAlarm): OsAlarmCounterRef=SystemTimer_Core2, OsAlarmAccessingApplication=OsApplication_Core0, OsAlarmAccessingApplication=OsApplication_Core1
      OsAlarmAction
        OsAlarmActivateTask: OsAlarmActivateTaskRef=Task200ms_Core2
    Task20ms_Core0 (OsTask):
      OsTaskActivation = 1
      OsTaskPriority = 56
      OsTaskSchedule = FULL
      OsTaskAccessingApplication = OsApplication_Core1
      OsTaskAccessingApplication = OsApplication_Core2
    Rte_Al_TE_CpAp_FAWDemo_Core0_Runnable20ms_Core0 (OsAlarm): OsAlarmCounterRef=SystemTimer_Core0, OsAlarmAccessingApplication=OsApplication_Core1, OsAlarmAccessingApplication=OsApplication_Core2
      OsAlarmAction
        OsAlarmActivateTask: OsAlarmActivateTaskRef=Task20ms_Core0
    Task20ms_Core1 (OsTask):
      OsTaskActivation = 1
      OsTaskPriority = 56
      OsTaskSchedule = FULL
      OsTaskAccessingApplication = OsApplication_Core0
      OsTaskAccessingApplication = OsApplication_Core2
    Rte_Al_TE_CpAp_FAWDemo_Core1_Runnable20ms_Core1 (OsAlarm): OsAlarmCounterRef=SystemTimer_Core1, OsAlarmAccessingApplication=OsApplication_Core0, OsAlarmAccessingApplication=OsApplication_Core2
      OsAlarmAction
        OsAlarmActivateTask: OsAlarmActivateTaskRef=Task20ms_Core1
    Task20ms_Core2 (OsTask):
      OsTaskActivation = 1
      OsTaskPriority = 56
      OsTaskSchedule = FULL
      OsTaskAccessingApplication = OsApplication_Core0
      OsTaskAccessingApplication = OsApplication_Core1
    Rte_Al_TE_CpAp_FAWDemo_Core2_Runnable20ms_Core2 (OsAlarm): OsAlarmCounterRef=SystemTimer_Core2, OsAlarmAccessingApplication=OsApplication_Core0, OsAlarmAccessingApplication=OsApplication_Core1
      OsAlarmAction
        OsAlarmActivateTask: OsAlarmActivateTaskRef=Task20ms_Core2
    Task500ms_Core0 (OsTask):
      OsTaskActivation = 1
      OsTaskPriority = 52
      OsTaskSchedule = FULL
      OsTaskAccessingApplication = OsApplication_Core1
      OsTaskAccessingApplication = OsApplication_Core2
    Rte_Al_TE_CpAp_FAWDemo_Core0_Runnable500ms_Core0 (OsAlarm): OsAlarmCounterRef=SystemTimer_Core0, OsAlarmAccessingApplication=OsApplication_Core1, OsAlarmAccessingApplication=OsApplication_Core2
      OsAlarmAction
        OsAlarmActivateTask: OsAlarmActivateTaskRef=Task500ms_Core0
    Task500ms_Core1 (OsTask):
      OsTaskActivation = 1
      OsTaskPriority = 52
      OsTaskSchedule = FULL
      OsTaskAccessingApplication = OsApplication_Core0
      OsTaskAccessingApplication = OsApplication_Core2
    Rte_Al_TE_CpAp_FAWDemo_Core1_Runnable500ms_Core1 (OsAlarm): OsAlarmCounterRef=SystemTimer_Core1, OsAlarmAccessingApplication=OsApplication_Core0, OsAlarmAccessingApplication=OsApplication_Core2
      OsAlarmAction
        OsAlarmActivateTask: OsAlarmActivateTaskRef=Task500ms_Core1
    Task500ms_Core2 (OsTask):
      OsTaskActivation = 1
      OsTaskPriority = 52
      OsTaskSchedule = FULL
      OsTaskAccessingApplication = OsApplication_Core0
      OsTaskAccessingApplication = OsApplication_Core1
    Rte_Al_TE_CpAp_FAWDemo_Core2_Runnable500ms_Core2 (OsAlarm): OsAlarmCounterRef=SystemTimer_Core2, OsAlarmAccessingApplication=OsApplication_Core0, OsAlarmAccessingApplication=OsApplication_Core1
      OsAlarmAction
        OsAlarmActivateTask: OsAlarmActivateTaskRef=Task500ms_Core2
    Task50ms_Core0 (OsTask):
      OsTaskActivation = 1
      OsTaskPriority = 55
      OsTaskSchedule = FULL
      OsTaskAccessingApplication = OsApplication_Core1
      OsTaskAccessingApplication = OsApplication_Core2
    Rte_Al_TE_CpAp_FAWDemo_Core0_Runnable50ms_Core0 (OsAlarm): OsAlarmCounterRef=SystemTimer_Core0, OsAlarmAccessingApplication=OsApplication_Core1, OsAlarmAccessingApplication=OsApplication_Core2
      OsAlarmAction
        OsAlarmActivateTask: OsAlarmActivateTaskRef=Task50ms_Core0
    Task50ms_Core1 (OsTask):
      OsTaskActivation = 1
      OsTaskPriority = 55
      OsTaskSchedule = FULL
      OsTaskAccessingApplication = OsApplication_Core0
      OsTaskAccessingApplication = OsApplication_Core2
    Rte_Al_TE_CpAp_FAWDemo_Core1_Runnable50ms_Core1 (OsAlarm): OsAlarmCounterRef=SystemTimer_Core1, OsAlarmAccessingApplication=OsApplication_Core0, OsAlarmAccessingApplication=OsApplication_Core2
      OsAlarmAction
        OsAlarmActivateTask: OsAlarmActivateTaskRef=Task50ms_Core1
    Task50ms_Core2 (OsTask):
      OsTaskActivation = 1
      OsTaskPriority = 55
      OsTaskSchedule = FULL
      OsTaskAccessingApplication = OsApplication_Core0
      OsTaskAccessingApplication = OsApplication_Core1
    Rte_Al_TE_CpAp_FAWDemo_Core2_Runnable50ms_Core2 (OsAlarm): OsAlarmCounterRef=SystemTimer_Core2, OsAlarmAccessingApplication=OsApplication_Core0, OsAlarmAccessingApplication=OsApplication_Core1
      OsAlarmAction
        OsAlarmActivateTask: OsAlarmActivateTaskRef=Task50ms_Core2
    Task5ms_Core0 (OsTask):
      OsTaskActivation = 1
      OsTaskPriority = 58
      OsTaskSchedule = FULL
      OsTaskAccessingApplication = OsApplication_Core1
      OsTaskAccessingApplication = OsApplication_Core2
    Rte_Al_TE_CpAp_FAWDemo_Core0_Runnable5ms_Core0 (OsAlarm): OsAlarmCounterRef=SystemTimer_Core0, OsAlarmAccessingApplication=OsApplication_Core1, OsAlarmAccessingApplication=OsApplication_Core2
      OsAlarmAction
        OsAlarmActivateTask: OsAlarmActivateTaskRef=Task5ms_Core0
    Task5ms_Core1 (OsTask):
      OsTaskActivation = 1
      OsTaskPriority = 58
      OsTaskSchedule = FULL
      OsTaskAccessingApplication = OsApplication_Core0
      OsTaskAccessingApplication = OsApplication_Core2
    Rte_Al_TE_CpAp_FAWDemo_Core1_Runnable5ms_Core1 (OsAlarm): OsAlarmCounterRef=SystemTimer_Core1, OsAlarmAccessingApplication=OsApplication_Core0, OsAlarmAccessingApplication=OsApplication_Core2
      OsAlarmAction
        OsAlarmActivateTask: OsAlarmActivateTaskRef=Task5ms_Core1
    Task5ms_Core2 (OsTask):
      OsTaskActivation = 1
      OsTaskPriority = 58
      OsTaskSchedule = FULL
      OsTaskAccessingApplication = OsApplication_Core0
      OsTaskAccessingApplication = OsApplication_Core1
    Rte_Al_TE_CpAp_FAWDemo_Core2_Runnable5ms_Core2 (OsAlarm): OsAlarmCounterRef=SystemTimer_Core2, OsAlarmAccessingApplication=OsApplication_Core0, OsAlarmAccessingApplication=OsApplication_Core1
      OsAlarmAction
        OsAlarmActivateTask: OsAlarmActivateTaskRef=Task5ms_Core2
    TaskSchM_Core0 (OsTask):
      OsTaskActivation = 1
      OsTaskPriority = 90
      OsTaskSchedule = FULL
      OsTaskEventRef = Rte_Ev_Cyclic2_TaskSchM_Core0_0_10ms
      OsTaskEventRef = Rte_Ev_Cyclic2_TaskSchM_Core0_0_20ms
      OsTaskAccessingApplication = OsApplication_Core1
      OsTaskAccessingApplication = OsApplication_Core2
    Rte_Al_TE2_TaskSchM_Core0_0_10ms (OsAlarm): OsAlarmCounterRef=SystemTimer_Core0, OsAlarmAccessingApplication=OsApplication_Core1, OsAlarmAccessingApplication=OsApplication_Core2
      OsAlarmAction
        OsAlarmSetEvent: OsAlarmSetEventRef=Rte_Ev_Cyclic2_TaskSchM_Core0_0_10ms, OsAlarmSetEventTaskRef=TaskSchM_Core0
    Rte_Al_TE2_TaskSchM_Core0_0_20ms (OsAlarm): OsAlarmCounterRef=SystemTimer_Core0, OsAlarmAccessingApplication=OsApplication_Core1, OsAlarmAccessingApplication=OsApplication_Core2
      OsAlarmAction
        OsAlarmSetEvent: OsAlarmSetEventRef=Rte_Ev_Cyclic2_TaskSchM_Core0_0_20ms, OsAlarmSetEventTaskRef=TaskSchM_Core0
    TaskSchM_Core1 (OsTask):
      OsTaskActivation = 1
      OsTaskPriority = 90
      OsTaskSchedule = FULL
      OsTaskAccessingApplication = OsApplication_Core0
      OsTaskAccessingApplication = OsApplication_Core2
    Rte_Al_TE2_EcuM_EcuM_MainFunction (OsAlarm): OsAlarmCounterRef=SystemTimer_Core1, OsAlarmAccessingApplication=OsApplication_Core0, OsAlarmAccessingApplication=OsApplication_Core2
      OsAlarmAction
        OsAlarmActivateTask: OsAlarmActivateTaskRef=TaskSchM_Core1
    TaskSchM_Core2 (OsTask):
      OsTaskActivation = 1
      OsTaskPriority = 90
      OsTaskSchedule = FULL
      OsTaskAccessingApplication = OsApplication_Core0
      OsTaskAccessingApplication = OsApplication_Core1
    Rte_Al_TE3_EcuM_EcuM_MainFunction (OsAlarm): OsAlarmCounterRef=SystemTimer_Core2, OsAlarmAccessingApplication=OsApplication_Core0, OsAlarmAccessingApplication=OsApplication_Core1
      OsAlarmAction
        OsAlarmActivateTask: OsAlarmActivateTaskRef=TaskSchM_Core2
    Rte_Ev_Cyclic2_TaskSchM_Core0_0_10ms (OsEvent)
    Rte_Ev_Cyclic2_TaskSchM_Core0_0_20ms (OsEvent)
    3 x OsApplication, all with OsTrusted=true:
      OsApplication_Core0: OsAppTaskRef=Task1000ms_Core0, OsAppAlarmRef=Os/Rte_Al_TE_CpAp_FAWDemo_Core0_Runnable1000ms_Core0, OsAppTaskRef=Task100ms_Core0, OsAppAlarmRef=Os/Rte_Al_TE_CpAp_FAWDemo_Core0_Runnable100ms_Core0, OsAppTaskRef=Task10ms_Core0, OsAppAlarmRef=Os/Rte_Al_TE_CpAp_FAWDemo_Core0_Runnable10ms_Core0, OsAppTaskRef=Task1ms_Core0, OsAppAlarmRef=Os/Rte_Al_TE_CpAp_FAWDemo_Core0_Runnable1ms_Core0, OsAppTaskRef=Task200ms_Core0, OsAppAlarmRef=Os/Rte_Al_TE_CpAp_FAWDemo_Core0_Runnable200ms_Core0, OsAppTaskRef=Task20ms_Core0, OsAppAlarmRef=Os/Rte_Al_TE_CpAp_FAWDemo_Core0_Runnable20ms_Core0, OsAppTaskRef=Task500ms_Core0, OsAppAlarmRef=Os/Rte_Al_TE_CpAp_FAWDemo_Core0_Runnable500ms_Core0, OsAppTaskRef=Task50ms_Core0, OsAppAlarmRef=Os/Rte_Al_TE_CpAp_FAWDemo_Core0_Runnable50ms_Core0, OsAppTaskRef=Task5ms_Core0, OsAppAlarmRef=Os/Rte_Al_TE_CpAp_FAWDemo_Core0_Runnable5ms_Core0, OsAppTaskRef=TaskSchM_Core0, OsAppAlarmRef=Os/Rte_Al_TE2_TaskSchM_Core0_0_10ms, OsAppAlarmRef=Os/Rte_Al_TE2_TaskSchM_Core0_0_20ms
      OsApplication_Core1: OsAppTaskRef=Task1000ms_Core1, OsAppAlarmRef=Os/Rte_Al_TE_CpAp_FAWDemo_Core1_Runnable1000ms_Core1, OsAppTaskRef=Task100ms_Core1, OsAppAlarmRef=Os/Rte_Al_TE_CpAp_FAWDemo_Core1_Runnable100ms_Core1, OsAppTaskRef=Task10ms_Core1, OsAppAlarmRef=Os/Rte_Al_TE_CpAp_FAWDemo_Core1_Runnable10ms_Core1, OsAppTaskRef=Task1ms_Core1, OsAppAlarmRef=Os/Rte_Al_TE_CpAp_FAWDemo_Core1_Runnable1ms_Core1, OsAppTaskRef=Task200ms_Core1, OsAppAlarmRef=Os/Rte_Al_TE_CpAp_FAWDemo_Core1_Runnable200ms_Core1, OsAppTaskRef=Task20ms_Core1, OsAppAlarmRef=Os/Rte_Al_TE_CpAp_FAWDemo_Core1_Runnable20ms_Core1, OsAppTaskRef=Task500ms_Core1, OsAppAlarmRef=Os/Rte_Al_TE_CpAp_FAWDemo_Core1_Runnable500ms_Core1, OsAppTaskRef=Task50ms_Core1, OsAppAlarmRef=Os/Rte_Al_TE_CpAp_FAWDemo_Core1_Runnable50ms_Core1, OsAppTaskRef=Task5ms_Core1, OsAppAlarmRef=Os/Rte_Al_TE_CpAp_FAWDemo_Core1_Runnable5ms_Core1, OsAppTaskRef=TaskSchM_Core1, OsAppAlarmRef=Os/Rte_Al_TE2_EcuM_EcuM_MainFunction
      OsApplication_Core2: OsAppTaskRef=Task1000ms_Core2, OsAppAlarmRef=Os/Rte_Al_TE_CpAp_FAWDemo_Core2_Runnable1000ms_Core2, OsAppTaskRef=Task100ms_Core2, OsAppAlarmRef=Os/Rte_Al_TE_CpAp_FAWDemo_Core2_Runnable100ms_Core2, OsAppTaskRef=Task10ms_Core2, OsAppAlarmRef=Os/Rte_Al_TE_CpAp_FAWDemo_Core2_Runnable10ms_Core2, OsAppTaskRef=Task1ms_Core2, OsAppAlarmRef=Os/Rte_Al_TE_CpAp_FAWDemo_Core2_Runnable1ms_Core2, OsAppTaskRef=Task200ms_Core2, OsAppAlarmRef=Os/Rte_Al_TE_CpAp_FAWDemo_Core2_Runnable200ms_Core2, OsAppTaskRef=Task20ms_Core2, OsAppAlarmRef=Os/Rte_Al_TE_CpAp_FAWDemo_Core2_Runnable20ms_Core2, OsAppTaskRef=Task500ms_Core2, OsAppAlarmRef=Os/Rte_Al_TE_CpAp_FAWDemo_Core2_Runnable500ms_Core2, OsAppTaskRef=Task50ms_Core2, OsAppAlarmRef=Os/Rte_Al_TE_CpAp_FAWDemo_Core2_Runnable50ms_Core2, OsAppTaskRef=Task5ms_Core2, OsAppAlarmRef=Os/Rte_Al_TE_CpAp_FAWDemo_Core2_Runnable5ms_Core2, OsAppTaskRef=TaskSchM_Core2, OsAppAlarmRef=Os/Rte_Al_TE3_EcuM_EcuM_MainFunction
  module config EcuC
  ecuc value collection DaVinci_Project: ecuc-values=[Com, Rte, Os, EcuC, NvM]
