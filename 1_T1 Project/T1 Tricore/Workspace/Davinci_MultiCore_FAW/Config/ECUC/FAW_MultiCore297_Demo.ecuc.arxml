AUTOSAR XML (schema 4-2-1)
package /ActiveEcuC
  ecuc value collection ActiveEcuC: ecu-extract=SYSTEM, ecuc-values=[BswM, Det, EcuC, EcuM, Os, Rte, Mcu, Com, ComM, CanIf, Can, PduR, CanSM]
  module config BswM: implementation-config-variant=VARIANT-PRE-COMPILE, module-description=BswM_Impl
    BswMGeneral:
      BswMCanSMEnabled = true
      BswMComMEnabled = true
      BswMDcmEnabled = false
      BswMDevErrorDetect = false
      BswMEcuMEnabled = true
      BswMEthIfEnabled = false
      BswMEthSMEnabled = false
      BswMFrSMEnabled = false
      BswMGenericRequestEnabled = true
      BswMJ1939DcmEnabled = false
      BswMJ1939NmEnabled = false
      BswMLinSMEnabled = false
      BswMLinTPEnabled = false
      BswMNmEnabled = false
      BswMNvMEnabled = false
      BswMPduREnabled = false
      BswMRuleControlEnabled = false
      BswMSdEnabled = false
      BswMVersionInfoApi = false
      BswMWdgMEnabled = false
      BswMModeCheck = true
      BswMActionListQueueSearchAlgorithm = LINEAR_SEARCH
      BswMMainFunctionPeriod = 0.01
      BswMCommonData
      BswMGeneration:
        BswMOutOfBoundsWriteSanitizer = false
        BswMOutOfBoundsReadSanitizer = false
        BswMReduceConstantData2Define = true
        BswMReduceDataByStreaming = false
        BswMBoolDataInArrayOfStructStrategy = BITMASKING
        BswMInterfacesForDeactivatedData = false
    BswMConfig
      BswMArbitration
        CC_CN_CAN00_d9752b68_TX (BswMRule):
          BswMNestedExecutionOnly = false
          BswMRuleId = 2
          BswMRuleInitState = BSWM_FALSE
          BswMRuleExpressionRef = CC_LE_CN_CAN00_d9752b68_TX
          BswMRuleFalseActionList = CC_AL_CN_CAN00_d9752b68_TX_Disable
          BswMRuleTrueActionList = CC_AL_CN_CAN00_d9752b68_TX_EnableNoinit
        CC_LE_CN_CAN00_d9752b68_TX (BswMLogicalExpression): BswMLogicalOperator=BSWM_AND, BswMArgumentRef=CC_Cond_CanSMIndication_CN_CAN00_d9752b68_EQ_CANSM_BSWM_FULL_COMMUNICATION
        CC_Cond_CanSMIndication_CN_CAN00_d9752b68_EQ_CANSM_BSWM_FULL_COMMUNICATION (BswMModeCondition): BswMConditionType=BSWM_EQUALS, BswMConditionMode=CC_CanSMIndication_CN_CAN00_d9752b68
          BswMConditionValue
            BswMBswMode: BswMBswRequestedMode=CANSM_BSWM_FULL_COMMUNICATION
        CC_CanSMIndication_CN_CAN00_d9752b68 (BswMModeRequestPort): BswMArbitrateOnInit=false, BswMRequestProcessing=BSWM_IMMEDIATE
          BswMModeRequestSource
            BswMCanSMIndication: BswMCanSMChannelRef=ComMConfigSet/CN_CAN00_d9752b68
          BswMModeInitValue
            BswMBswModeInitValue: BswMBswModeInitValueMode=CANSM_BSWM_NO_COMMUNICATION
        CC_CN_CAN00_d9752b68_RX_DM (BswMRule):
          BswMNestedExecutionOnly = false
          BswMRuleId = 1
          BswMRuleInitState = BSWM_FALSE
          BswMRuleExpressionRef = CC_LE_CN_CAN00_d9752b68_RX_DM
          BswMRuleFalseActionList = CC_AL_CN_CAN00_d9752b68_Disable_DM
          BswMRuleTrueActionList = CC_AL_CN_CAN00_d9752b68_Enable_DM
        CC_LE_CN_CAN00_d9752b68_RX_DM (BswMLogicalExpression): BswMLogicalOperator=BSWM_AND, BswMArgumentRef=CC_Cond_CanSMIndication_CN_CAN00_d9752b68_EQ_CANSM_BSWM_FULL_COMMUNICATION
        CC_CN_CAN00_d9752b68_RX (BswMRule):
          BswMNestedExecutionOnly = false
          BswMRuleId = 0
          BswMRuleInitState = BSWM_FALSE
          BswMRuleExpressionRef = CC_LE_CN_CAN00_d9752b68_RX
          BswMRuleFalseActionList = CC_AL_CN_CAN00_d9752b68_RX_Disable
          BswMRuleTrueActionList = CC_AL_CN_CAN00_d9752b68_RX_EnableNoinit
        CC_LE_CN_CAN00_d9752b68_RX (BswMLogicalExpression): BswMLogicalOperator=BSWM_AND, BswMArgumentRef=CC_Cond_CanSMIndication_CN_CAN00_d9752b68_NEQ_CANSM_BSWM_NO_COMMUNICATION
        CC_Cond_CanSMIndication_CN_CAN00_d9752b68_NEQ_CANSM_BSWM_NO_COMMUNICATION (BswMModeCondition): BswMConditionType=BSWM_EQUALS_NOT, BswMConditionMode=CC_CanSMIndication_CN_CAN00_d9752b68
          BswMConditionValue
            BswMBswMode: BswMBswRequestedMode=CANSM_BSWM_NO_COMMUNICATION
        ESH_RunToPostRun (BswMRule):
          BswMNestedExecutionOnly = false
          BswMRuleId = 8
          BswMRuleInitState = BSWM_FALSE
          BswMRuleExpressionRef = ESH_LE_RunToPostRun
          BswMRuleTrueActionList = ESH_AL_ExitRun
        ESH_LE_RunToPostRun (BswMLogicalExpression):
          BswMLogicalOperator = BSWM_AND
          BswMArgumentRef = ESH_Cond_StateIsRun
          BswMArgumentRef = ESH_LE_AllChannelsNoCom
          BswMArgumentRef = ESH_LE_RunReleased
          BswMArgumentRef = ESH_Cond_SelfRunReqTimerExpired
        ESH_Cond_StateIsRun (BswMModeCondition): BswMConditionType=BSWM_EQUALS, BswMConditionMode=ESH_State
          BswMConditionValue
            BswMBswMode: BswMBswRequestedMode=ESH_RUN
        ESH_State (BswMModeRequestPort): BswMArbitrateOnInit=true, BswMRequestProcessing=BSWM_IMMEDIATE
          BswMModeRequestSource
            BswMGenericRequest: BswMModeRequesterId=230, BswMRequestedModeMax=7
              7 x BswMGenericRequestMode:
                ESH_INIT: BswMGenericRequestModeValue=0
                ESH_RUN: BswMGenericRequestModeValue=1
                ESH_POST_RUN: BswMGenericRequestModeValue=2
                ESH_PREP_SHUTDOWN: BswMGenericRequestModeValue=3
                ESH_WAIT_FOR_NVM: BswMGenericRequestModeValue=4
                ESH_SHUTDOWN: BswMGenericRequestModeValue=5
                ESH_WAKEUP: BswMGenericRequestModeValue=6
          BswMModeInitValue
            BswMBswModeInitValue: BswMBswModeInitValueMode=ESH_INIT
        ESH_LE_AllChannelsNoCom (BswMLogicalExpression): BswMLogicalOperator=BSWM_AND, BswMArgumentRef=ESH_Cond_NoComOn_CN_CAN00_d9752b68
        ESH_Cond_NoComOn_CN_CAN00_d9752b68 (BswMModeCondition): BswMConditionType=BSWM_EQUALS, BswMConditionMode=ESH_ComMIndication_CN_CAN00_d9752b68
          BswMConditionValue
            BswMBswMode: BswMBswRequestedMode=COMM_NO_COMMUNICATION
        ESH_ComMIndication_CN_CAN00_d9752b68 (BswMModeRequestPort): BswMArbitrateOnInit=false, BswMRequestProcessing=BSWM_DEFERRED
          BswMModeRequestSource
            BswMComMIndication: BswMComMChannelRef=ComMConfigSet/CN_CAN00_d9752b68
          BswMModeInitValue
            BswMBswModeInitValue: BswMBswModeInitValueMode=COMM_NO_COMMUNICATION
        ESH_LE_RunReleased (BswMLogicalExpression): BswMLogicalOperator=BSWM_AND, BswMArgumentRef=ESH_Cond_RunRequest0IsReleased, BswMArgumentRef=ESH_Cond_RunRequest1IsReleased
        ESH_Cond_RunRequest0IsReleased (BswMModeCondition): BswMConditionType=BSWM_EQUALS, BswMConditionMode=ESH_RunRequest_0
          BswMConditionValue
            BswMModeDeclaration: BswMModeValueRef=RELEASED
        ESH_RunRequest_0 (BswMModeRequestPort): BswMArbitrateOnInit=false, BswMRequestProcessing=BSWM_DEFERRED
          BswMModeRequestSource
            BswMSwcModeRequest: BswMModeRequestDataElementPrototypeName=requestedMode, BswMSwcModeRequestModeDeclarationGroupPrototypeRef=BswM_MDGP_ESH_RunRequest
          BswMModeInitValue
            BswMSwcModeInitValue: BswMSwcModeInitValueRef=RELEASED
        ESH_Cond_RunRequest1IsReleased (BswMModeCondition): BswMConditionType=BSWM_EQUALS, BswMConditionMode=ESH_RunRequest_1
          BswMConditionValue
            BswMModeDeclaration: BswMModeValueRef=RELEASED
        ESH_RunRequest_1 (BswMModeRequestPort): BswMArbitrateOnInit=false, BswMRequestProcessing=BSWM_DEFERRED
          BswMModeRequestSource
            BswMSwcModeRequest: BswMModeRequestDataElementPrototypeName=requestedMode, BswMSwcModeRequestModeDeclarationGroupPrototypeRef=BswM_MDGP_ESH_RunRequest
          BswMModeInitValue
            BswMSwcModeInitValue: BswMSwcModeInitValueRef=RELEASED
        ESH_Cond_SelfRunReqTimerExpired (BswMModeCondition): BswMConditionType=BSWM_EQUALS, BswMConditionMode=ESH_SelfRunRequestTimer
          BswMConditionValue
            BswMBswMode: BswMBswRequestedMode=BSWM_TIMER_EXPIRED
        ESH_SelfRunRequestTimer (BswMModeRequestPort): BswMArbitrateOnInit=false, BswMRequestProcessing=BSWM_DEFERRED
          BswMModeRequestSource
            BswMTimer
          BswMModeInitValue
            BswMBswModeInitValue: BswMBswModeInitValueMode=BSWM_TIMER_STOPPED
        ESH_RunToPostRunNested (BswMRule):
          BswMNestedExecutionOnly = true
          BswMRuleId = 9
          BswMRuleInitState = BSWM_FALSE
          BswMRuleExpressionRef = ESH_LE_ComMNoPendingRequests
          BswMRuleTrueActionList = ESH_AL_RunToPostRun
        ESH_LE_ComMNoPendingRequests (BswMLogicalExpression): BswMLogicalOperator=BSWM_AND, BswMArgumentRef=ESH_Cond_ComMNoPendingRequests
        ESH_Cond_ComMNoPendingRequests (BswMModeCondition): BswMConditionType=BSWM_EQUALS, BswMConditionMode=ESH_ComMPendingRequests
          BswMConditionValue
            BswMBswMode: BswMBswRequestedMode=ESH_COMM_NO_REQUEST
        ESH_ComMPendingRequests (BswMModeRequestPort): BswMArbitrateOnInit=false, BswMRequestProcessing=BSWM_DEFERRED
          BswMModeRequestSource
            BswMGenericRequest: BswMModeRequesterId=232, BswMRequestedModeMax=2
              ESH_COMM_NO_REQUEST (BswMGenericRequestMode): BswMGenericRequestModeValue=0
              ESH_COMM_PENDING_REQUEST (BswMGenericRequestMode): BswMGenericRequestModeValue=1
          BswMModeInitValue
            BswMBswModeInitValue: BswMBswModeInitValueMode=ESH_COMM_NO_REQUEST
        ESH_WaitToShutdown (BswMRule):
          BswMNestedExecutionOnly = false
          BswMRuleId = 10
          BswMRuleInitState = BSWM_FALSE
          BswMRuleExpressionRef = ESH_LE_WaitForNvMToShutdown
          BswMRuleTrueActionList = ESH_AL_WaitForNvMToShutdown
        ESH_LE_WaitForNvMToShutdown (BswMLogicalExpression): BswMLogicalOperator=BSWM_AND, BswMArgumentRef=ESH_Cond_StateIsWaitForNvm, BswMArgumentRef=ESH_LE_NoWakeup
        ESH_Cond_StateIsWaitForNvm (BswMModeCondition): BswMConditionType=BSWM_EQUALS, BswMConditionMode=ESH_State
          BswMConditionValue
            BswMBswMode: BswMBswRequestedMode=ESH_WAIT_FOR_NVM
        ESH_LE_NoWakeup (BswMLogicalExpression): BswMLogicalOperator=BSWM_AND, BswMArgumentRef=ESH_Cond_NoValidatedWakeups, BswMArgumentRef=ESH_Cond_ComMNoPendingRequests
        ESH_Cond_NoValidatedWakeups (BswMModeCondition): BswMConditionType=BSWM_EQUALS, BswMConditionMode=ESH_EcuM_GetValidatedWakeupEvents
          BswMConditionValue
            BswMBswMode: BswMBswRequestedMode=0
        ESH_EcuM_GetValidatedWakeupEvents (BswMModeRequestPort): BswMArbitrateOnInit=false, BswMRequestProcessing=BSWM_DEFERRED
          BswMModeRequestSource
            BswMUserConditionRequest: BswMUserCondition=EcuM_GetValidatedWakeupEvents()
        ESH_WakeupToPrep (BswMRule):
          BswMNestedExecutionOnly = false
          BswMRuleId = 12
          BswMRuleInitState = BSWM_FALSE
          BswMRuleExpressionRef = ESH_LE_WakeupToPrepShutdown
          BswMRuleTrueActionList = ESH_AL_WakeupToPrep
        ESH_LE_WakeupToPrepShutdown (BswMLogicalExpression): BswMLogicalOperator=BSWM_AND, BswMArgumentRef=ESH_Cond_StateIsWakeup, BswMArgumentRef=ESH_Cond_NoPendingWakeups, BswMArgumentRef=ESH_LE_NoWakeup
        ESH_Cond_StateIsWakeup (BswMModeCondition): BswMConditionType=BSWM_EQUALS, BswMConditionMode=ESH_State
          BswMConditionValue
            BswMBswMode: BswMBswRequestedMode=ESH_WAKEUP
        ESH_Cond_NoPendingWakeups (BswMModeCondition): BswMConditionType=BSWM_EQUALS, BswMConditionMode=ESH_EcuM_GetPendingWakeupEvents
          BswMConditionValue
            BswMBswMode: BswMBswRequestedMode=0
        ESH_EcuM_GetPendingWakeupEvents (BswMModeRequestPort): BswMArbitrateOnInit=false, BswMRequestProcessing=BSWM_DEFERRED
          BswMModeRequestSource
            BswMUserConditionRequest: BswMUserCondition=EcuM_GetPendingWakeupEvents()
        ESH_WaitToWakeup (BswMRule):
          BswMNestedExecutionOnly = false
          BswMRuleId = 11
          BswMRuleInitState = BSWM_FALSE
          BswMRuleExpressionRef = ESH_LE_WaitForNvMToWakeup
          BswMRuleTrueActionList = ESH_AL_WaitForNvMWakeup
        ESH_LE_WaitForNvMToWakeup (BswMLogicalExpression): BswMLogicalOperator=BSWM_AND, BswMArgumentRef=ESH_Cond_StateIsWaitForNvm, BswMArgumentRef=ESH_LE_ValidWakeup
        ESH_LE_ValidWakeup (BswMLogicalExpression): BswMLogicalOperator=BSWM_OR, BswMArgumentRef=ESH_Cond_ValidatedWakeups, BswMArgumentRef=ESH_Cond_ComMPendingRequests
        ESH_Cond_ValidatedWakeups (BswMModeCondition): BswMConditionType=BSWM_EQUALS_NOT, BswMConditionMode=ESH_EcuM_GetValidatedWakeupEvents
          BswMConditionValue
            BswMBswMode: BswMBswRequestedMode=0
        ESH_Cond_ComMPendingRequests (BswMModeCondition): BswMConditionType=BSWM_EQUALS, BswMConditionMode=ESH_ComMPendingRequests
          BswMConditionValue
            BswMBswMode: BswMBswRequestedMode=ESH_COMM_PENDING_REQUEST
        ESH_WakeupToRun (BswMRule):
          BswMNestedExecutionOnly = false
          BswMRuleId = 13
          BswMRuleInitState = BSWM_FALSE
          BswMRuleExpressionRef = ESH_LE_WakeupToRun
          BswMRuleTrueActionList = ESH_AL_WakeupToRun
        ESH_LE_WakeupToRun (BswMLogicalExpression): BswMLogicalOperator=BSWM_AND, BswMArgumentRef=ESH_Cond_StateIsWakeup, BswMArgumentRef=ESH_LE_ValidWakeup
        ESH_InitToWakeup (BswMRule):
          BswMNestedExecutionOnly = false
          BswMRuleId = 3
          BswMRuleInitState = BSWM_FALSE
          BswMRuleExpressionRef = ESH_LE_InitToWakeup
          BswMRuleTrueActionList = ESH_AL_InitToWakeup
        ESH_LE_InitToWakeup (BswMLogicalExpression): BswMLogicalOperator=BSWM_AND, BswMArgumentRef=ESH_Cond_StateIsInit
        ESH_Cond_StateIsInit (BswMModeCondition): BswMConditionType=BSWM_EQUALS, BswMConditionMode=ESH_State
          BswMConditionValue
            BswMBswMode: BswMBswRequestedMode=ESH_INIT
        ESH_PostRunToPrepNested (BswMRule):
          BswMNestedExecutionOnly = true
          BswMRuleId = 6
          BswMRuleInitState = BSWM_FALSE
          BswMRuleExpressionRef = ESH_LE_PostRunToPrep
          BswMRuleTrueActionList = ESH_AL_PostRunToPrepShutdown
        ESH_LE_PostRunToPrep (BswMLogicalExpression): BswMLogicalOperator=BSWM_AND, BswMArgumentRef=ESH_LE_PostRunReleased
        ESH_LE_PostRunReleased (BswMLogicalExpression): BswMLogicalOperator=BSWM_AND, BswMArgumentRef=ESH_Cond_PostRunRequest0IsReleased, BswMArgumentRef=ESH_Cond_PostRunRequest1IsReleased
        ESH_Cond_PostRunRequest0IsReleased (BswMModeCondition): BswMConditionType=BSWM_EQUALS, BswMConditionMode=ESH_PostRunRequest_0
          BswMConditionValue
            BswMModeDeclaration: BswMModeValueRef=RELEASED
        ESH_PostRunRequest_0 (BswMModeRequestPort): BswMArbitrateOnInit=false, BswMRequestProcessing=BSWM_DEFERRED
          BswMModeRequestSource
            BswMSwcModeRequest: BswMModeRequestDataElementPrototypeName=requestedMode, BswMSwcModeRequestModeDeclarationGroupPrototypeRef=BswM_MDGP_ESH_RunRequest
          BswMModeInitValue
            BswMSwcModeInitValue: BswMSwcModeInitValueRef=RELEASED
        ESH_Cond_PostRunRequest1IsReleased (BswMModeCondition): BswMConditionType=BSWM_EQUALS, BswMConditionMode=ESH_PostRunRequest_1
          BswMConditionValue
            BswMModeDeclaration: BswMModeValueRef=RELEASED
        ESH_PostRunRequest_1 (BswMModeRequestPort): BswMArbitrateOnInit=false, BswMRequestProcessing=BSWM_DEFERRED
          BswMModeRequestSource
            BswMSwcModeRequest: BswMModeRequestDataElementPrototypeName=requestedMode, BswMSwcModeRequestModeDeclarationGroupPrototypeRef=BswM_MDGP_ESH_RunRequest
          BswMModeInitValue
            BswMSwcModeInitValue: BswMSwcModeInitValueRef=RELEASED
        ESH_PostRunNested (BswMRule):
          BswMNestedExecutionOnly = true
          BswMRuleId = 5
          BswMRuleInitState = BSWM_FALSE
          BswMRuleExpressionRef = ESH_LE_RunRequestsOrWakeup
          BswMRuleFalseActionList = ESH_AL_ESH_PostRunToPrepCheck
          BswMRuleTrueActionList = ESH_AL_PostRunToRun
        ESH_LE_RunRequestsOrWakeup (BswMLogicalExpression): BswMLogicalOperator=BSWM_OR, BswMArgumentRef=ESH_LE_RunRequested, BswMArgumentRef=ESH_LE_ValidWakeup
        ESH_LE_RunRequested (BswMLogicalExpression): BswMLogicalOperator=BSWM_OR, BswMArgumentRef=ESH_Cond_RunRequest0IsRequested, BswMArgumentRef=ESH_Cond_RunRequest1IsRequested
        ESH_Cond_RunRequest0IsRequested (BswMModeCondition): BswMConditionType=BSWM_EQUALS, BswMConditionMode=ESH_RunRequest_0
          BswMConditionValue
            BswMModeDeclaration: BswMModeValueRef=REQUESTED
        ESH_Cond_RunRequest1IsRequested (BswMModeCondition): BswMConditionType=BSWM_EQUALS, BswMConditionMode=ESH_RunRequest_1
          BswMConditionValue
            BswMModeDeclaration: BswMModeValueRef=REQUESTED
        ESH_PostRun (BswMRule):
          BswMNestedExecutionOnly = false
          BswMRuleId = 4
          BswMRuleInitState = BSWM_FALSE
          BswMRuleExpressionRef = ESH_LE_PostRun
          BswMRuleTrueActionList = ESH_AL_ExitPostRun
        ESH_LE_PostRun (BswMLogicalExpression): BswMLogicalOperator=BSWM_AND, BswMArgumentRef=ESH_Cond_StateIsPostRun, BswMArgumentRef=ESH_Cond_SelfRunReqTimerExpired
        ESH_Cond_StateIsPostRun (BswMModeCondition): BswMConditionType=BSWM_EQUALS, BswMConditionMode=ESH_State
          BswMConditionValue
            BswMBswMode: BswMBswRequestedMode=ESH_POST_RUN
        ESH_PrepToWait (BswMRule):
          BswMNestedExecutionOnly = false
          BswMRuleId = 7
          BswMRuleInitState = BSWM_FALSE
          BswMRuleExpressionRef = ESH_LE_PrepShutdownToWaitForNvM
          BswMRuleTrueActionList = ESH_AL_PrepShutdownToWaitForNvM
        ESH_LE_PrepShutdownToWaitForNvM (BswMLogicalExpression): BswMLogicalOperator=BSWM_AND, BswMArgumentRef=ESH_Cond_StateIsPrepShutdown
        ESH_Cond_StateIsPrepShutdown (BswMModeCondition): BswMConditionType=BSWM_EQUALS, BswMConditionMode=ESH_State
          BswMConditionValue
            BswMBswMode: BswMBswRequestedMode=ESH_PREP_SHUTDOWN
      BswMModeControl: BswMInitActionListRef=INIT_AL_Initialize
        INIT_AL_Initialize (BswMActionList): BswMActionListExecution=BSWM_CONDITION
          9 x BswMActionListItem, all with BswMAbortOnFail=false:
            INIT_Action_EnableInterrupts: BswMActionListItemIndex=6, BswMActionListItemRef=BswMModeControl/INIT_Action_EnableInterrupts
            INIT_Action_RteStart: BswMActionListItemIndex=8, BswMActionListItemRef=BswMModeControl/INIT_Action_RteStart
            INIT_Action_Det_Init: BswMActionListItemIndex=0, BswMActionListItemRef=BswMModeControl/INIT_Action_Det_Init
            INIT_Action_Can_Init: BswMActionListItemIndex=1, BswMActionListItemRef=BswMModeControl/INIT_Action_Can_Init
            INIT_Action_CanIf_Init: BswMActionListItemIndex=2, BswMActionListItemRef=BswMModeControl/INIT_Action_CanIf_Init
            INIT_Action_Com_Init: BswMActionListItemIndex=3, BswMActionListItemRef=BswMModeControl/INIT_Action_Com_Init
            INIT_Action_PduR_Init: BswMActionListItemIndex=4, BswMActionListItemRef=BswMModeControl/INIT_Action_PduR_Init
            INIT_Action_CanSM_Init: BswMActionListItemIndex=5, BswMActionListItemRef=BswMModeControl/INIT_Action_CanSM_Init
            INIT_Action_ComM_Init: BswMActionListItemIndex=7, BswMActionListItemRef=BswMModeControl/INIT_Action_ComM_Init
        INIT_Action_EnableInterrupts (BswMAction)
          BswMAvailableActions
            BswMUserCallout: BswMUserCalloutFunction=BswM_AL_SetProgrammableInterrupts(), BswMCreateCallout=true
        INIT_Action_RteStart (BswMAction)
          BswMAvailableActions
            BswMUserCallout: BswMUserCalloutFunction=(void)Rte_Start(), BswMCreateCallout=false, BswMUserIncludeFile=Rte_Main.h
        CC_AL_CN_CAN00_d9752b68_TX_Disable (BswMActionList): BswMActionListExecution=BSWM_TRIGGER
          CC_DisablePDUGroup_iECU_oCAN00_Tx_f55b9750 (BswMActionListItem): BswMAbortOnFail=false, BswMActionListItemIndex=0, BswMActionListItemRef=BswMModeControl/CC_DisablePDUGroup_iECU_oCAN00_Tx_f55b9750
        CC_DisablePDUGroup_iECU_oCAN00_Tx_f55b9750 (BswMAction)
          BswMAvailableActions
            BswMPduGroupSwitch: BswMPduGroupSwitchReinit=false, BswMDisabledPduGroupRef=iECU_oCAN00_Tx_f55b9750
        CC_AL_CN_CAN00_d9752b68_TX_EnableNoinit (BswMActionList): BswMActionListExecution=BSWM_TRIGGER
          CC_EnablePDUGroup_iECU_oCAN00_Tx_f55b9750 (BswMActionListItem): BswMAbortOnFail=false, BswMActionListItemIndex=0, BswMActionListItemRef=BswMModeControl/CC_EnablePDUGroup_iECU_oCAN00_Tx_f55b9750
        CC_EnablePDUGroup_iECU_oCAN00_Tx_f55b9750 (BswMAction)
          BswMAvailableActions
            BswMPduGroupSwitch: BswMPduGroupSwitchReinit=false, BswMEnabledPduGroupRef=iECU_oCAN00_Tx_f55b9750
        CC_AL_CN_CAN00_d9752b68_Disable_DM (BswMActionList): BswMActionListExecution=BSWM_TRIGGER
          CC_DisableDM_iECU_oCAN00_Rx_a30130d6 (BswMActionListItem): BswMAbortOnFail=false, BswMActionListItemIndex=0, BswMActionListItemRef=BswMModeControl/CC_DisableDM_iECU_oCAN00_Rx_a30130d6
        CC_DisableDM_iECU_oCAN00_Rx_a30130d6 (BswMAction)
          BswMAvailableActions
            BswMDeadlineMonitoringControl: BswMDisabledDMPduGroupRef=iECU_oCAN00_Rx_a30130d6
        CC_AL_CN_CAN00_d9752b68_Enable_DM (BswMActionList): BswMActionListExecution=BSWM_TRIGGER
          CC_EnableDM_iECU_oCAN00_Rx_a30130d6 (BswMActionListItem): BswMAbortOnFail=false, BswMActionListItemIndex=0, BswMActionListItemRef=BswMModeControl/CC_EnableDM_iECU_oCAN00_Rx_a30130d6
        CC_EnableDM_iECU_oCAN00_Rx_a30130d6 (BswMAction)
          BswMAvailableActions
            BswMDeadlineMonitoringControl: BswMEnabledDMPduGroupRef=iECU_oCAN00_Rx_a30130d6
        CC_AL_CN_CAN00_d9752b68_RX_Disable (BswMActionList): BswMActionListExecution=BSWM_TRIGGER
          CC_DisablePDUGroup_iECU_oCAN00_Rx_a30130d6 (BswMActionListItem): BswMAbortOnFail=false, BswMActionListItemIndex=0, BswMActionListItemRef=BswMModeControl/CC_DisablePDUGroup_iECU_oCAN00_Rx_a30130d6
        CC_DisablePDUGroup_iECU_oCAN00_Rx_a30130d6 (BswMAction)
          BswMAvailableActions
            BswMPduGroupSwitch: BswMPduGroupSwitchReinit=false, BswMDisabledPduGroupRef=iECU_oCAN00_Rx_a30130d6
        CC_AL_CN_CAN00_d9752b68_RX_EnableNoinit (BswMActionList): BswMActionListExecution=BSWM_TRIGGER
          CC_EnablePDUGroup_iECU_oCAN00_Rx_a30130d6 (BswMActionListItem): BswMAbortOnFail=false, BswMActionListItemIndex=0, BswMActionListItemRef=BswMModeControl/CC_EnablePDUGroup_iECU_oCAN00_Rx_a30130d6
        CC_EnablePDUGroup_iECU_oCAN00_Rx_a30130d6 (BswMAction)
          BswMAvailableActions
            BswMPduGroupSwitch: BswMPduGroupSwitchReinit=false, BswMEnabledPduGroupRef=iECU_oCAN00_Rx_a30130d6
        ESH_AL_ExitRun (BswMActionList): BswMActionListExecution=BSWM_CONDITION
          4 x BswMActionListItem, all with BswMAbortOnFail=false:
            ESH_Action_EnterExclusiveArea: BswMActionListItemIndex=0, BswMActionListItemRef=BswMModeControl/ESH_Action_EnterExclusiveArea
            ESH_Action_ComMCheckPendingRequests: BswMActionListItemIndex=1, BswMActionListItemRef=BswMModeControl/ESH_Action_ComMCheckPendingRequests
            ESH_RunToPostRunNested: BswMActionListItemIndex=2, BswMActionListItemRef=BswMArbitration/ESH_RunToPostRunNested
            ESH_Action_ExitExclusiveArea: BswMActionListItemIndex=3, BswMActionListItemRef=BswMModeControl/ESH_Action_ExitExclusiveArea
        ESH_Action_EnterExclusiveArea (BswMAction)
          BswMAvailableActions
            BswMUserCallout: BswMUserCalloutFunction=SchM_Enter_BswM_BSWM_EXCLUSIVE_AREA_0(), BswMCreateCallout=false, BswMUserIncludeFile=SchM_BswM.h
        ESH_Action_ComMCheckPendingRequests (BswMAction)
          BswMAvailableActions
            BswMUserCallout:
              BswMUserCalloutFunction = ESH_ComM_CheckPendingRequests()
              BswMCreateCallout = true
              BswMUserCode = ComM_StateType CN_CAN00_d9752b68 = COMM_NO_COM_NO_PENDING_REQUEST; (void)ComM_GetState(ComMConf_ComMChannel_CN_CAN00_d9752b68, &CN_CAN00_d9752b68); /* SBSW_BSWM_FCTCALL_LOCALVAR */ if(CN_CAN00_d9752b68 != COMM_NO_COM_NO_PENDING_REQUEST) { BswM_RequestMode(BSWM_GENERIC_ESH_ComMPendingRequests, BSWM_GENERICVALUE_ESH_ComMPendingRequests_ESH_COMM_PENDING_REQUEST); } else { BswM_RequestMode(BSWM_GENERIC_ESH_ComMPendingRequests, BSWM_GENERICVALUE_ESH_ComMPendingRequests_ESH_COMM_NO_REQUEST); }
        ESH_AL_RunToPostRun (BswMActionList): BswMActionListExecution=BSWM_CONDITION
          3 x BswMActionListItem, all with BswMAbortOnFail=false:
            ESH_Action_ComMDisallow_CN_CAN00_d9752b68: BswMActionListItemIndex=0, BswMActionListItemRef=BswMModeControl/ESH_Action_ComMDisallow_CN_CAN00_d9752b68
            ESH_Action_EcuMClearValidatedWakeupEvents: BswMActionListItemIndex=1, BswMActionListItemRef=BswMModeControl/ESH_Action_EcuMClearValidatedWakeupEvents
            ESH_Action_ESH_PostRun: BswMActionListItemIndex=2, BswMActionListItemRef=BswMModeControl/ESH_Action_ESH_PostRun
        4 x BswMAction:
          ESH_Action_ComMDisallow_CN_CAN00_d9752b68
            BswMAvailableActions
              BswMComMAllowCom: BswMComAllowed=false, BswMComMAllowChannelRef=ComMConfigSet/CN_CAN00_d9752b68
          ESH_Action_EcuMClearValidatedWakeupEvents
            BswMAvailableActions
              BswMUserCallout: BswMUserCalloutFunction=EcuM_ClearValidatedWakeupEvent(ECUM_WKSOURCE_ALL_SOURCES), BswMCreateCallout=false, BswMUserIncludeFile=EcuM.h
          ESH_Action_ESH_PostRun
            BswMAvailableActions
              BswMGenericModeSwitch: BswMGenericRequestRef=ESH_State, BswMGenericRequestModeRef=ESH_POST_RUN
          ESH_Action_ExitExclusiveArea
            BswMAvailableActions
              BswMUserCallout: BswMUserCalloutFunction=SchM_Exit_BswM_BSWM_EXCLUSIVE_AREA_0(), BswMCreateCallout=false, BswMUserIncludeFile=SchM_BswM.h
        ESH_AL_WaitForNvMToShutdown (BswMActionList): BswMActionListExecution=BSWM_CONDITION
          ESH_Action_EcuMGoToSelectedShutdownTarget (BswMActionListItem): BswMAbortOnFail=false, BswMActionListItemIndex=0, BswMActionListItemRef=BswMModeControl/ESH_Action_EcuMGoToSelectedShutdownTarget
        ESH_Action_EcuMGoToSelectedShutdownTarget (BswMAction)
          BswMAvailableActions
            BswMUserCallout: BswMUserCalloutFunction=(void)EcuM_GoToSelectedShutdownTarget(), BswMCreateCallout=false, BswMUserIncludeFile=EcuM.h
        ESH_AL_WakeupToPrep (BswMActionList): BswMActionListExecution=BSWM_CONDITION
          ESH_Action_ESH_PrepShutdown (BswMActionListItem): BswMAbortOnFail=false, BswMActionListItemIndex=0, BswMActionListItemRef=BswMModeControl/ESH_Action_ESH_PrepShutdown
        ESH_Action_ESH_PrepShutdown (BswMAction)
          BswMAvailableActions
            BswMGenericModeSwitch: BswMGenericRequestRef=ESH_State, BswMGenericRequestModeRef=ESH_PREP_SHUTDOWN
        ESH_AL_WaitForNvMWakeup (BswMActionList): BswMActionListExecution=BSWM_CONDITION
          ESH_Action_ESH_Wakeup (BswMActionListItem): BswMAbortOnFail=false, BswMActionListItemIndex=0, BswMActionListItemRef=BswMModeControl/ESH_Action_ESH_Wakeup
        ESH_Action_ESH_Wakeup (BswMAction)
          BswMAvailableActions
            BswMGenericModeSwitch: BswMGenericRequestRef=ESH_State, BswMGenericRequestModeRef=ESH_WAKEUP
        ESH_AL_WakeupToRun (BswMActionList): BswMActionListExecution=BSWM_CONDITION
          3 x BswMActionListItem, all with BswMAbortOnFail=false:
            ESH_Action_ComMAllow_CN_CAN00_d9752b68: BswMActionListItemIndex=0, BswMActionListItemRef=BswMModeControl/ESH_Action_ComMAllow_CN_CAN00_d9752b68
            ESH_Action_SelfRunRequestTimer_Start: BswMActionListItemIndex=1, BswMActionListItemRef=BswMModeControl/ESH_Action_SelfRunRequestTimer_Start
            ESH_Action_ESH_Run: BswMActionListItemIndex=2, BswMActionListItemRef=BswMModeControl/ESH_Action_ESH_Run
        3 x BswMAction:
          ESH_Action_ComMAllow_CN_CAN00_d9752b68
            BswMAvailableActions
              BswMComMAllowCom: BswMComAllowed=true, BswMComMAllowChannelRef=ComMConfigSet/CN_CAN00_d9752b68
          ESH_Action_SelfRunRequestTimer_Start
            BswMAvailableActions
              BswMTimerControl: BswMTimerAction=BSWM_TIMER_START, BswMTimerValue=0.1, BswMTimerRef=ESH_SelfRunRequestTimer
          ESH_Action_ESH_Run
            BswMAvailableActions
              BswMGenericModeSwitch: BswMGenericRequestRef=ESH_State, BswMGenericRequestModeRef=ESH_RUN
        6 x BswMActionList, all with BswMActionListExecution=BSWM_CONDITION:
          ESH_AL_InitToWakeup
            ESH_Action_ESH_Wakeup (BswMActionListItem): BswMAbortOnFail=false, BswMActionListItemIndex=0, BswMActionListItemRef=BswMModeControl/ESH_Action_ESH_Wakeup
          ESH_AL_PostRunToPrepShutdown
            ESH_Action_ESH_PrepShutdown (BswMActionListItem): BswMAbortOnFail=false, BswMActionListItemIndex=0, BswMActionListItemRef=BswMModeControl/ESH_Action_ESH_PrepShutdown
          ESH_AL_ESH_PostRunToPrepCheck
            ESH_PostRunToPrepNested (BswMActionListItem): BswMAbortOnFail=false, BswMActionListItemIndex=0, BswMActionListItemRef=BswMArbitration/ESH_PostRunToPrepNested
          ESH_AL_PostRunToRun
            3 x BswMActionListItem, all with BswMAbortOnFail=false:
              ESH_Action_ComMAllow_CN_CAN00_d9752b68: BswMActionListItemIndex=0, BswMActionListItemRef=BswMModeControl/ESH_Action_ComMAllow_CN_CAN00_d9752b68
              ESH_Action_SelfRunRequestTimer_Start: BswMActionListItemIndex=1, BswMActionListItemRef=BswMModeControl/ESH_Action_SelfRunRequestTimer_Start
              ESH_Action_ESH_Run: BswMActionListItemIndex=2, BswMActionListItemRef=BswMModeControl/ESH_Action_ESH_Run
          ESH_AL_ExitPostRun
            4 x BswMActionListItem, all with BswMAbortOnFail=false:
              ESH_Action_EnterExclusiveArea: BswMActionListItemIndex=0, BswMActionListItemRef=BswMModeControl/ESH_Action_EnterExclusiveArea
              ESH_Action_ComMCheckPendingRequests: BswMActionListItemIndex=1, BswMActionListItemRef=BswMModeControl/ESH_Action_ComMCheckPendingRequests
              ESH_PostRunNested: BswMActionListItemIndex=2, BswMActionListItemRef=BswMArbitration/ESH_PostRunNested
              ESH_Action_ExitExclusiveArea: BswMActionListItemIndex=3, BswMActionListItemRef=BswMModeControl/ESH_Action_ExitExclusiveArea
          ESH_AL_PrepShutdownToWaitForNvM
            ESH_Action_ComMCheckPendingRequests (BswMActionListItem): BswMAbortOnFail=false, BswMActionListItemIndex=0, BswMActionListItemRef=BswMModeControl/ESH_Action_ComMCheckPendingRequests
            ESH_Action_ESH_WaitForNvm (BswMActionListItem): BswMAbortOnFail=false, BswMActionListItemIndex=1, BswMActionListItemRef=BswMModeControl/ESH_Action_ESH_WaitForNvm
        8 x BswMAction:
          ESH_Action_ESH_WaitForNvm
            BswMAvailableActions
              BswMGenericModeSwitch: BswMGenericRequestRef=ESH_State, BswMGenericRequestModeRef=ESH_WAIT_FOR_NVM
          INIT_Action_Det_Init
            BswMAvailableActions
              BswMUserCallout: BswMUserCalloutFunction=Det_Init(Det_Config_Ptr), BswMCreateCallout=false, BswMUserIncludeFile=Det.h
          INIT_Action_Can_Init
            BswMAvailableActions
              BswMUserCallout: BswMUserCalloutFunction=Can_Init(Can_Config_Ptr), BswMCreateCallout=false, BswMUserIncludeFile=Can.h
          INIT_Action_CanIf_Init
            BswMAvailableActions
              BswMUserCallout: BswMUserCalloutFunction=CanIf_Init(CanIf_Config_Ptr), BswMCreateCallout=false, BswMUserIncludeFile=CanIf.h
          INIT_Action_Com_Init
            BswMAvailableActions
              BswMUserCallout: BswMUserCalloutFunction=Com_Init(Com_Config_Ptr), BswMCreateCallout=false, BswMUserIncludeFile=Com.h
          INIT_Action_PduR_Init
            BswMAvailableActions
              BswMUserCallout: BswMUserCalloutFunction=PduR_Init(PduR_Config_Ptr), BswMCreateCallout=false, BswMUserIncludeFile=PduR.h
          INIT_Action_CanSM_Init
            BswMAvailableActions
              BswMUserCallout: BswMUserCalloutFunction=CanSM_Init(CanSM_Config_Ptr), BswMCreateCallout=false, BswMUserIncludeFile=CanSM_EcuM.h
          INIT_Action_ComM_Init
            BswMAvailableActions
              BswMUserCallout: BswMUserCalloutFunction=ComM_Init(), BswMCreateCallout=false, BswMUserIncludeFile=ComM.h
      BswMDataTypeMappingSets: BswMDataTypeMappingSetRef=BswMMappingSet
      ESH_RunRequest (BswMRteModeDclGroup): BswMInitMode=RELEASED
        RELEASED (BswMRteMode): BswMModePhysicalValue=0
        REQUESTED (BswMRteMode): BswMModePhysicalValue=1
  module config Det: implementation-config-variant=VARIANT-PRE-COMPILE, module-description=Det_Impl
    DetGeneral:
      DetVersionInfoApi = false
      DetEnableDet = true
      DetExtDebugSupport = false
      DetGlobalFilterSize = 0
      DetBreakFilterSize = 0
      DetLogBufferSize = 0
      DetReportErrorRecursionLimit = 0
      DetReportRuntimeErrorRecursionLimit = 0
      DetReportTransientFaultRecursionLimit = 0
      DetDltFilterSize = 0
    DetConfigSet
      DetModule: DetModuleId=4096
  module config EcuC: implementation-config-variant=VARIANT-PRE-COMPILE, module-description=EcuC_Impl
    EcucGeneral:
      CPUType = CPU32Bit
      ByteOrder = LITTLE_ENDIAN
      BitOrder = LSB_to_MSB
      AtomicBitAccessInBitfield = false
      AtomicVariableAccess = Atomic32BitAccess
      SizeOfEnum = Size8Bit
      SizeOfInt = Size32Bit
      SizeOfROMPointer = Size32Bit
      SizeOfRAMPointer = Size32Bit
      BitFieldDataType = INT
      StructAlignment = Auto
      ArrayAlignment = Align8Bit
      StructInArrayAlignment = Auto
      DummyFunction = false
      EcuCSafeBswChecks = false
      DummyStatement = true
      DummyStatementKind = None
      ConditionalGenerating = true
      EcucBswImplementationCodeType = EcuCSourceCode
      EcuCUseStdReturnTypeForRte = false
      PostbuildLoadable: AlignmentFillPattern=0, PBROMStartAddress=0, PBRAMStartAddress=0, PBROMEndAddress=0, PBRAMEndAddress=0
      BswInitialization
        19 x InitFunction:
          BswM_Init: Header=BswM.h, InitPhase=NO_INIT, ConfigType=BswM_ConfigType, ConfigPtrName=BswM_Config_Ptr, ConfigPtrClass=BSWM_INIT_DATA, ModuleRef=BswM
          BswM_InitMemory: Header=BswM.h, InitPhase=INIT_MEMORY, ModuleRef=BswM
          Det_Init: Header=Det.h, InitPhase=INIT_ZERO, ConfigType=Det_ConfigType, ConfigPtrName=Det_Config_Ptr, ConfigPtrClass=DET_INIT_DATA, ModuleRef=Det
          Det_InitMemory: Header=Det.h, InitPhase=INIT_MEMORY, ModuleRef=Det
          EcuM_Init: Header=EcuM.h, InitPhase=NO_INIT, ConfigType=EcuM_PbConfigType, ConfigPtrName=EcuM_Config_Ptr, ConfigPtrClass=ECUM_INIT_DATA, ModuleRef=EcuM
          Rte_InitMemory: Header=Rte_Main.h, InitPhase=INIT_MEMORY, ModuleRef=Rte
          SchM_Init: Header=Rte_Main.h, InitPhase=NO_INIT, ModuleRef=Rte
          Can_InitMemory: Header=Can.h, InitPhase=INIT_MEMORY, ModuleRef=Can
          Can_Init: Header=Can.h, InitPhase=INIT_TWO_DRV, ConfigType=Can_ConfigType, ConfigPtrName=Can_Config_Ptr, ConfigPtrClass=CAN_INIT_DATA, ModuleRef=Can
          CanIf_InitMemory: Header=CanIf.h, InitPhase=INIT_MEMORY, ModuleRef=CanIf
          CanIf_Init: Header=CanIf.h, InitPhase=INIT_TWO_IF, ConfigType=CanIf_ConfigType, ConfigPtrName=CanIf_Config_Ptr, ConfigPtrClass=CANIF_INIT_DATA, ModuleRef=CanIf
          CanSM_InitMemory: Header=CanSM_EcuM.h, InitPhase=INIT_MEMORY, ModuleRef=CanSM
          CanSM_Init: Header=CanSM_EcuM.h, InitPhase=INIT_TWO_SM, ConfigType=CanSM_ConfigType, ConfigPtrName=CanSM_Config_Ptr, ConfigPtrClass=CANSM_INIT_DATA, ModuleRef=CanSM
          ComM_Init: Header=ComM.h, InitPhase=INIT_TWO_POST_NVMREADALL, ModuleRef=ComM
          ComM_InitMemory: Header=ComM.h, InitPhase=INIT_MEMORY, ModuleRef=ComM
          Com_Init: Header=Com.h, InitPhase=INIT_TWO_COM, ConfigType=Com_ConfigType, ConfigPtrName=Com_Config_Ptr, ConfigPtrClass=COM_INIT_DATA, ModuleRef=Com
          Com_InitMemory: Header=Com.h, InitPhase=INIT_MEMORY, ModuleRef=Com
          PduR_InitMemory: Header=PduR.h, InitPhase=INIT_MEMORY, ModuleRef=PduR
          PduR_Init: Header=PduR.h, InitPhase=INIT_TWO_COM, ConfigType=PduR_PBConfigType, ConfigPtrName=PduR_Config_Ptr, ConfigPtrClass=PDUR_INIT_DATA, ModuleRef=PduR
    EcucHardware
      3 x EcucCoreDefinition:
        EcucCoreDefinition: EcucCoreId=0
        EcucCoreDefinition_001: EcucCoreId=1
        EcucCoreDefinition_002: EcucCoreId=2
    EcucPduCollection: PduIdTypeEnum=UINT8, PduLengthTypeEnum=UINT8
      4 x Pdu, all with PduLength=8, J1939Requestable=false:
        T1_TxMsg_oCAN00_ef2c7eaf_Tx: SysTPduToFrameMappingRef=T1_TxMsg
        T1_RxMsg_oCAN00_c2c93374_Rx
        T1_TxMsg_oCAN00_2df49694_Tx
        T1_RxMsg_oCAN00_53752368_Rx: SysTPduToFrameMappingRef=T1_RxMsg
  module config EcuM: implementation-config-variant=VARIANT-PRE-COMPILE, module-description=EcuM_Impl
    EcuMFlexGeneral: EcuMAlarmClockPresent=false, EcuMResetLoopDetection=false, EcuMEnableDefBehaviour=false
    EcuMGeneral:
      EcuMDevErrorDetect = false
      EcuMIncludeDem = true
      EcuMIncludeDet = true
      EcuMMainFunctionPeriod = 0.01
      EcuMVersionInfoApi = false
      EcuMDeferredBswMNotification = false
      EcuMSlaveCoreHandling = true
      EcuMEnableFixBehavior = false
      EcuMGeneration: EcuMOutOfBoundsWriteSanitizer=false, EcuMOutOfBoundsReadSanitizer=false, EcuMInterfacesForDeactivatedData=false
    EcuMConfiguration
      EcuMCommonConfiguration: EcuMConfigConsistencyHash=7687516420925952819, EcuMDefaultAppMode=OSDEFAULTAPPMODE, EcuMOSResource=RES_SCHEDULER_OsCore0
        5 x EcuMWakeupSource, all with EcuMValidationTimeout=0, EcuMCheckWakeupTimeout=0, EcuMWakeupSourcePolling=false:
          ECUM_WKSOURCE_POWER: EcuMWakeupSourceId=0
          ECUM_WKSOURCE_RESET: EcuMWakeupSourceId=1
          ECUM_WKSOURCE_INTERNAL_RESET: EcuMWakeupSourceId=2
          ECUM_WKSOURCE_INTERNAL_WDG: EcuMWakeupSourceId=3
          ECUM_WKSOURCE_EXTERNAL_WDG: EcuMWakeupSourceId=4
        EcuMDefaultShutdownTarget: EcuMDefaultState=EcuMStateOff
        EcuMDriverInitListZero
          Rte_InitMemory (EcuMDriverInitItem): index=0, EcuMModuleID=Rte, EcuMModuleService=Rte_InitMemory, EcuMModuleHeader=Rte_Main.h
          BswM_InitMemory (EcuMDriverInitItem): index=2, EcuMModuleID=BswM, EcuMModuleService=BswM_InitMemory, EcuMModuleHeader=BswM.h
        EcuMDriverInitListOne
        CN_CAN00_d9752b68 (EcuMWakeupSource): EcuMWakeupSourceId=5, EcuMWakeupSourcePolling=false, EcuMComMChannelRef=ComMConfigSet/CN_CAN00_d9752b68
        EcuMDriverRestartList
      EcuMFlexConfiguration: EcuMFlexModuleConfigurationRef=CanConfigSet, EcuMNormalMcuModeRef=McuModeSettingConf
        3 x EcuMResetMode:
          ECUM_RESET_MCU: EcuMResetModeId=0
          ECUM_RESET_WDG: EcuMResetModeId=1
          ECUM_RESET_IO: EcuMResetModeId=2
        4 x EcuMShutdownCause:
          ECUM_CAUSE_UNKNOWN: EcuMShutdownCauseId=0
          ECUM_CAUSE_ECU_STATE: EcuMShutdownCauseId=1
          ECUM_CAUSE_WDGM: EcuMShutdownCauseId=2
          ECUM_CAUSE_DCM: EcuMShutdownCauseId=3
        ECUM_RESET_WAKEUP (EcuMResetMode): EcuMResetModeId=3
  module config Os: implementation-config-variant=VARIANT-PRE-COMPILE, module-description=Os_Impl
    SystemTimer_Core0 (OsCounter):
      OsCounterMaxAllowedValue = 1073741823
      OsCounterMinCycle = 1
      OsCounterType = HARDWARE
      OsSecondsPerTick = 1E-8
      OsCounterTicksPerBase = 1
      OsCounterAccessingApplication = SystemApplication_OsCore{0..2}
      OsDriver: OsDriverHighResolution=true, OsDriverHardwareTimerChannelRef=STM0_Ch0, OsDriverIsrRef=CounterIsr_SystemTimer_Core0
    OsOS:
      OsStackMonitoring = true
      OsStatus = STANDARD
      OsUseGetServiceId = false
      OsUseParameterAccess = false
      OsUseResScheduler = true
      OsForcibleTermination = false
      OsGenerateCalloutStubs = true
      OsGenerateMemMap = COMPLETE
      OsGenerateMemMapForNearAddressing = true
      OsGenerateMemMapForThreads = false
      OsServiceProtection = false
      OsStackUsageMeasurement = false
      OsUseXSignalAsyncApiCalls = false
      OsFpuUsage = NONE
      OsNumberOfCores = 3
      OsScalabilityClass = SC1
      OsMasterCore = OsCore0
      OsSystemTimer = SystemTimer_Core0
      OsHooks: OsErrorHook=false, OsPostTaskHook=false, OsPreTaskHook=false, OsShutdownHook=false, OsStartupHook=false, OsProtectionHook=false
      OsStackSummary
        45 x OsStack, all with OsStackSize=1024:
          OsCore0_Init: OsStackType=CORE_INIT_STACK, OsStackCore=OsCore0, OsStackUser=OsCore0
          OsCore0_Kernel: OsStackType=CORE_KERNEL_STACK, OsStackCore=OsCore0, OsStackUser=OsCore0
          OsCore{0..2}_Task_Prio4294967295: OsStackType=TASK_SHARED_PRIORITY_STACK, OsStackCore=OsCore{0..2}, OsStackUser=IdleTask_OsCore{0..2}
          OsCore1_Isr_Core: OsStackType=ISR_SHARED_CORE_STACK, OsStackCore=OsCore1, OsStackUser=XSignalIsr_OsCore1, OsStackUser=CounterIsr_SystemTimer_Core1, OsStackUser=Adc0Sr0_Isr, OsStackUser=Adc1Sr0_Isr, OsStackUser=Adc2Sr0_Isr, OsStackUser=Adc3Sr0_Isr, OsStackUser=Adc4Sr0_Isr, OsStackUser=Adc5Sr0_Isr, OsStackUser=Adc6Sr0_Isr, OsStackUser=Isr_TIM02, OsStackUser=Isr_TIM03
          OsCore2_Isr_Core: OsStackType=ISR_SHARED_CORE_STACK, OsStackCore=OsCore2, OsStackUser=XSignalIsr_OsCore2, OsStackUser=CounterIsr_SystemTimer_Core2
          OsCore1_Init: OsStackType=CORE_INIT_STACK, OsStackCore=OsCore1, OsStackUser=OsCore1
          OsCore1_Kernel: OsStackType=CORE_KERNEL_STACK, OsStackCore=OsCore1, OsStackUser=OsCore1
          OsCore2_Init: OsStackType=CORE_INIT_STACK, OsStackCore=OsCore2, OsStackUser=OsCore2
          OsCore2_Kernel: OsStackType=CORE_KERNEL_STACK, OsStackCore=OsCore2, OsStackUser=OsCore2
          OsCore0_Isr_Core: OsStackType=ISR_SHARED_CORE_STACK, OsStackCore=OsCore0, OsStackUser=XSignalIsr_OsCore0, OsStackUser=CounterIsr_SystemTimer_Core0, OsStackUser=CanIsr_0
          OsCore{0..2}_Task_Prio100: OsStackType=TASK_SHARED_PRIORITY_STACK, OsStackCore=OsCore{0..2}, OsStackUser=TaskInit_Core{0..2}
          TaskSchM_Core0: OsStackType=TASK_SHARED_PRIORITY_STACK, OsStackCore=OsCore0, OsStackUser=Os/TaskSchM_Core0
          OsCore0_Task_Prio52: OsStackType=TASK_SHARED_PRIORITY_STACK, OsStackCore=OsCore0, OsStackUser=Task500ms_Core0
          OsCore0_Task_Prio51: OsStackType=TASK_SHARED_PRIORITY_STACK, OsStackCore=OsCore0, OsStackUser=Task1000ms_Core0
          OsCore0_Task_Prio54: OsStackType=TASK_SHARED_PRIORITY_STACK, OsStackCore=OsCore0, OsStackUser=Task100ms_Core0
          OsCore0_Task_Prio55: OsStackType=TASK_SHARED_PRIORITY_STACK, OsStackCore=OsCore0, OsStackUser=Task50ms_Core0
          OsCore0_Task_Prio56: OsStackType=TASK_SHARED_PRIORITY_STACK, OsStackCore=OsCore0, OsStackUser=Task20ms_Core0
          OsCore0_Task_Prio57: OsStackType=TASK_SHARED_PRIORITY_STACK, OsStackCore=OsCore0, OsStackUser=Task10ms_Core0
          OsCore0_Task_Prio58: OsStackType=TASK_SHARED_PRIORITY_STACK, OsStackCore=OsCore0, OsStackUser=Task5ms_Core0
          OsCore0_Task_Prio59: OsStackType=TASK_SHARED_PRIORITY_STACK, OsStackCore=OsCore0, OsStackUser=Task1ms_Core0
          OsCore0_Task_Prio53: OsStackType=TASK_SHARED_PRIORITY_STACK, OsStackCore=OsCore0, OsStackUser=Task200ms_Core0
          OsCore1_Task_Prio59: OsStackType=TASK_SHARED_PRIORITY_STACK, OsStackCore=OsCore1, OsStackUser=Task1ms_Core1
          OsCore1_Task_Prio58: OsStackType=TASK_SHARED_PRIORITY_STACK, OsStackCore=OsCore1, OsStackUser=Task5ms_Core1
          OsCore1_Task_Prio52: OsStackType=TASK_SHARED_PRIORITY_STACK, OsStackCore=OsCore1, OsStackUser=Task500ms_Core1
          OsCore1_Task_Prio51: OsStackType=TASK_SHARED_PRIORITY_STACK, OsStackCore=OsCore1, OsStackUser=Task1000ms_Core1
          OsCore1_Task_Prio53: OsStackType=TASK_SHARED_PRIORITY_STACK, OsStackCore=OsCore1, OsStackUser=Task200ms_Core1
          OsCore1_Task_Prio54: OsStackType=TASK_SHARED_PRIORITY_STACK, OsStackCore=OsCore1, OsStackUser=Task100ms_Core1
          OsCore1_Task_Prio55: OsStackType=TASK_SHARED_PRIORITY_STACK, OsStackCore=OsCore1, OsStackUser=Task50ms_Core1
          OsCore1_Task_Prio56: OsStackType=TASK_SHARED_PRIORITY_STACK, OsStackCore=OsCore1, OsStackUser=Task20ms_Core1
          OsCore1_Task_Prio57: OsStackType=TASK_SHARED_PRIORITY_STACK, OsStackCore=OsCore1, OsStackUser=Task10ms_Core1
          OsCore1_Task_Prio90: OsStackType=TASK_SHARED_PRIORITY_STACK, OsStackCore=OsCore1, OsStackUser=TaskSchM_Core1
          OsCore2_Task_Prio59: OsStackType=TASK_SHARED_PRIORITY_STACK, OsStackCore=OsCore2, OsStackUser=Task1ms_Core2
          OsCore2_Task_Prio51: OsStackType=TASK_SHARED_PRIORITY_STACK, OsStackCore=OsCore2, OsStackUser=Task1000ms_Core2
          OsCore2_Task_Prio52: OsStackType=TASK_SHARED_PRIORITY_STACK, OsStackCore=OsCore2, OsStackUser=Task500ms_Core2
          OsCore2_Task_Prio58: OsStackType=TASK_SHARED_PRIORITY_STACK, OsStackCore=OsCore2, OsStackUser=Task5ms_Core2
          OsCore2_Task_Prio53: OsStackType=TASK_SHARED_PRIORITY_STACK, OsStackCore=OsCore2, OsStackUser=Task200ms_Core2
          OsCore2_Task_Prio54: OsStackType=TASK_SHARED_PRIORITY_STACK, OsStackCore=OsCore2, OsStackUser=Task100ms_Core2
          OsCore2_Task_Prio55: OsStackType=TASK_SHARED_PRIORITY_STACK, OsStackCore=OsCore2, OsStackUser=Task50ms_Core2
          OsCore2_Task_Prio56: OsStackType=TASK_SHARED_PRIORITY_STACK, OsStackCore=OsCore2, OsStackUser=Task20ms_Core2
          OsCore2_Task_Prio57: OsStackType=TASK_SHARED_PRIORITY_STACK, OsStackCore=OsCore2, OsStackUser=Task10ms_Core2
          OsCore2_Task_Prio90: OsStackType=TASK_SHARED_PRIORITY_STACK, OsStackCore=OsCore2, OsStackUser=TaskSchM_Core2
      OsDebug: OsAssertions=false, OsTimingHooksIncludeHeader=T1_Microsar.h
    OSDEFAULTAPPMODE (OsAppMode)
    OS_APPMODE_ANY (OsAppMode)
    OsPublishedInformation: OsKernelVersion=7, OsPlatformName=TriCoreAurix
      TC29x (OsDerivativeInformation):
        OsMpuAlignment = 8
        OsStackAlignment = 8
        OsExceptionVectorTableAlignment = 32
        OsInterruptVectorTableAlignment = 32
        OsHardwareManuals = User Manual: tc29xB_um_v1.3._TC29x_B-Step_User_Manual_rev_1v3_2014_12.pdf V1.3 Errata Sheet: TC29x_BA_Errata_Sheet_v1_0.pdf V1.0 Safety Manual: AURIX Safety Manual_3.pdf V1.3 2015-09
        3 x OsPhysicalCore, all with OsPhysicalCoreExceptionSources=8, OsPhysicalCorePrivelegedHwAccess=true:
          Core0: OsPhysicalCoreId=0, OsPhysicalCoreDefaultEntrySymbol=_start_tc0, OsPhysicalCoreType=TC1.6.1E, OsPhysicalCoreMasterStartAllowed=true, OsPhysicalCoreIsAutostart=true, OsPhysicalCoreStackProtectionUnit=OsPhysicalCore0DataMpu
            OsPhysicalCore0DataMpu (OsPhysicalCoreMpu): OsPhysicalCoreMpuId=0, OsPhysicalCoreMpuMaxRegions=16, OsPhysicalCoreMpuType=DATA
            OsPhysicalCore0CodeMpu (OsPhysicalCoreMpu): OsPhysicalCoreMpuId=1, OsPhysicalCoreMpuMaxRegions=8, OsPhysicalCoreMpuType=CODE
          Core1: OsPhysicalCoreId=1, OsPhysicalCoreDefaultEntrySymbol=_start_tc1, OsPhysicalCoreType=TC1.6.1P, OsPhysicalCoreMasterStartAllowed=false, OsPhysicalCoreIsAutostart=false, OsPhysicalCoreStackProtectionUnit=OsPhysicalCore1DataMpu
            OsPhysicalCore1DataMpu (OsPhysicalCoreMpu): OsPhysicalCoreMpuId=0, OsPhysicalCoreMpuMaxRegions=16, OsPhysicalCoreMpuType=DATA
            OsPhysicalCore1CodeMpu (OsPhysicalCoreMpu): OsPhysicalCoreMpuId=1, OsPhysicalCoreMpuMaxRegions=8, OsPhysicalCoreMpuType=CODE
          Core2: OsPhysicalCoreId=2, OsPhysicalCoreDefaultEntrySymbol=_start_tc2, OsPhysicalCoreType=TC1.6.1P, OsPhysicalCoreMasterStartAllowed=false, OsPhysicalCoreIsAutostart=false, OsPhysicalCoreStackProtectionUnit=OsPhysicalCore2DataMpu
            OsPhysicalCore2DataMpu (OsPhysicalCoreMpu): OsPhysicalCoreMpuId=0, OsPhysicalCoreMpuMaxRegions=16, OsPhysicalCoreMpuType=DATA
            OsPhysicalCore2CodeMpu (OsPhysicalCoreMpu): OsPhysicalCoreMpuId=1, OsPhysicalCoreMpuMaxRegions=8, OsPhysicalCoreMpuType=CODE
        3 x OsHardwareTimer, all with OsHardwareTimerSize=32, OsHardwareTimerUnit=FRT, OsHardwareTimerType=STM:
          STM0: OsHardwareTimerBaseAddress=4026531840, OsHardwareTimerId=0
            STM0_Ch0 (OsHardwareTimerChannel): OsHardwareTimerChannelIntSource=1168, OsHardwareTimerChannelOffset=0, OsHardwareTimerChannelId=0
            STM0_Ch1 (OsHardwareTimerChannel): OsHardwareTimerChannelIntSource=1172, OsHardwareTimerChannelOffset=1, OsHardwareTimerChannelId=1
          STM1: OsHardwareTimerBaseAddress=4026532096, OsHardwareTimerId=1
            STM1_Ch0 (OsHardwareTimerChannel): OsHardwareTimerChannelIntSource=1176, OsHardwareTimerChannelOffset=0, OsHardwareTimerChannelId=0
            STM1_Ch1 (OsHardwareTimerChannel): OsHardwareTimerChannelIntSource=1180, OsHardwareTimerChannelOffset=1, OsHardwareTimerChannelId=1
          STM2: OsHardwareTimerBaseAddress=4026532352, OsHardwareTimerId=2
            STM2_Ch0 (OsHardwareTimerChannel): OsHardwareTimerChannelIntSource=1184, OsHardwareTimerChannelOffset=0, OsHardwareTimerChannelId=0
            STM2_Ch1 (OsHardwareTimerChannel): OsHardwareTimerChannelIntSource=1188, OsHardwareTimerChannelOffset=1, OsHardwareTimerChannelId=1
        AURIXTC2XX_IR (OsSystemIntCtrl): OsSystemIntCtrlMaxPrios=255, OsSystemIntCtrlPrioOrder=ASC, OsSystemIntCtrlMaxSources=8192, OsSystemIntCtrlBaseAddress=4026757120
        GPT (OsHardwareTimer): OsHardwareTimerSize=16, OsHardwareTimerUnit=PIT, OsHardwareTimerBaseAddress=4026543616, OsHardwareTimerId=0, OsHardwareTimerType=PIT
          GPT_Ch0 (OsHardwareTimerChannel): OsHardwareTimerChannelIntSource=1128, OsHardwareTimerChannelOffset=0, OsHardwareTimerChannelId=0
          GPT_Ch1 (OsHardwareTimerChannel): OsHardwareTimerChannelIntSource=1140, OsHardwareTimerChannelOffset=1, OsHardwareTimerChannelId=1
        OsMemoryRegionSpecifics
          12 x OsMemoryRegionAccess:
            PS0_R: OsMemoryRegionAccessRights=R, OsMemoryRegionAccessType=PROTECTION_SET0
            PS0_W: OsMemoryRegionAccessRights=W, OsMemoryRegionAccessType=PROTECTION_SET0
            PS0_X: OsMemoryRegionAccessRights=X, OsMemoryRegionAccessType=PROTECTION_SET0
            PS1_R: OsMemoryRegionAccessRights=R, OsMemoryRegionAccessType=PROTECTION_SET1
            PS1_W: OsMemoryRegionAccessRights=W, OsMemoryRegionAccessType=PROTECTION_SET1
            PS1_X: OsMemoryRegionAccessRights=X, OsMemoryRegionAccessType=PROTECTION_SET1
            PS2_R: OsMemoryRegionAccessRights=R, OsMemoryRegionAccessType=PROTECTION_SET2
            PS2_W: OsMemoryRegionAccessRights=W, OsMemoryRegionAccessType=PROTECTION_SET2
            PS2_X: OsMemoryRegionAccessRights=X, OsMemoryRegionAccessType=PROTECTION_SET2
            PS3_R: OsMemoryRegionAccessRights=R, OsMemoryRegionAccessType=PROTECTION_SET3
            PS3_W: OsMemoryRegionAccessRights=W, OsMemoryRegionAccessType=PROTECTION_SET3
            PS3_X: OsMemoryRegionAccessRights=X, OsMemoryRegionAccessType=PROTECTION_SET3
        DMA (OsInterruptSupportedType): OsInterruptSupportedTypeSeparateSources=false
        DEFAULT (OsInterruptSupportedType): OsInterruptSupportedTypeSeparateSources=false
    OsCore0 (OsCore):
      OsCoreIsAutostart = true
      OsCoreIsAutosar = true
      OsCoreEntrySymbol = _start_tc0
      OsCorePhysicalCoreRef = Core0
      OsCoreIdleTask = IdleTask_OsCore0
      OsCoreSystemApplication = SystemApplication_OsCore0
      OsCoreEcucCoreRef = EcucCoreDefinition
      OsCoreResScheduler = RES_SCHEDULER_OsCore0
      OsCoreStacks:
        OsCoreKernelStackSize = 1024
        OsCoreStartupStackSize = 1024
        OsCoreShutdownStackSize = 1024
        OsCoreErrorStackSize = 1024
        OsCoreProtectionStackSize = 1024
        OsCoreInitStackSize = 1024
      XSignalChl_OsCore1 (OsCoreXSignalChannel): OsCoreXSignalChannelSize=1, OsCoreXSignalChannelReceiverIsr=XSignalIsr_OsCore1
      XSignalChl_OsCore2 (OsCoreXSignalChannel): OsCoreXSignalChannelSize=1, OsCoreXSignalChannelReceiverIsr=XSignalIsr_OsCore2
    IdleTask_OsCore0 (OsTask):
      OsTaskActivation = 1
      OsTaskPriority = 4294967295
      OsTaskSchedule = FULL
      OsTaskStackSharing = false
      OsTaskStackSize = 1024
      OsTaskType = AUTO
      OsTaskUsesFpu = false
      OsTaskAccessingApplication = SystemApplication_OsCore{0..2}
      OsTaskResourceRef = RES_SCHEDULER_OsCore0
      OsTaskAutostart: OsTaskAppModeRef=OS_APPMODE_ANY
    SystemApplication_OsCore0 (OsApplication):
      OsTrusted = true
      OsTrustedApplicationDelayTimingViolationCall = false
      OsTrustedApplicationWithProtection = false
      OsApplicationIsPrivileged = true
      OsAppUseTrustedFunctionStubs = false
      OsApplicationCoreRef = EcucCoreDefinition
      OsAppTaskRef = IdleTask_OsCore0
      OsAppIsrRef = CounterIsr_SystemTimer_Core0
      OsAppCounterRef = SystemTimer_Core0
      OsAppIsrRef = XSignalIsr_OsCore0
      OsApplicationHooks: OsAppErrorHook=false, OsAppShutdownHook=false, OsAppStartupHook=false
    OsCore1 (OsCore):
      OsCoreIsAutostart = false
      OsCoreIsAutosar = true
      OsCoreEntrySymbol = _start_tc1
      OsCorePhysicalCoreRef = Core1
      OsCoreIdleTask = IdleTask_OsCore1
      OsCoreSystemApplication = SystemApplication_OsCore1
      OsCoreEcucCoreRef = EcucCoreDefinition_001
      OsCoreResScheduler = RES_SCHEDULER_OsCore1
      OsCoreStacks:
        OsCoreKernelStackSize = 1024
        OsCoreStartupStackSize = 1024
        OsCoreShutdownStackSize = 1024
        OsCoreErrorStackSize = 1024
        OsCoreProtectionStackSize = 1024
        OsCoreInitStackSize = 1024
      XSignalChl_OsCore0 (OsCoreXSignalChannel): OsCoreXSignalChannelSize=1, OsCoreXSignalChannelReceiverIsr=XSignalIsr_OsCore0
      XSignalChl_OsCore2 (OsCoreXSignalChannel): OsCoreXSignalChannelSize=1, OsCoreXSignalChannelReceiverIsr=XSignalIsr_OsCore2
    IdleTask_OsCore1 (OsTask):
      OsTaskActivation = 1
      OsTaskPriority = 4294967295
      OsTaskSchedule = FULL
      OsTaskStackSharing = false
      OsTaskStackSize = 1024
      OsTaskType = AUTO
      OsTaskUsesFpu = false
      OsTaskAccessingApplication = SystemApplication_OsCore1
      OsTaskAccessingApplication = SystemApplication_OsCore2
      OsTaskAccessingApplication = SystemApplication_OsCore0
      OsTaskResourceRef = RES_SCHEDULER_OsCore1
      OsTaskAutostart: OsTaskAppModeRef=OS_APPMODE_ANY
    SystemApplication_OsCore1 (OsApplication):
      OsTrusted = true
      OsTrustedApplicationDelayTimingViolationCall = false
      OsTrustedApplicationWithProtection = false
      OsApplicationIsPrivileged = true
      OsAppUseTrustedFunctionStubs = false
      OsAppTaskRef = IdleTask_OsCore1
      OsApplicationCoreRef = EcucCoreDefinition_001
      OsAppIsrRef = CounterIsr_SystemTimer_Core1
      OsAppCounterRef = SystemTimer_Core1
      OsAppIsrRef = XSignalIsr_OsCore1
      OsApplicationHooks: OsAppErrorHook=false, OsAppShutdownHook=false, OsAppStartupHook=false
    OsCore2 (OsCore):
      OsCoreIsAutostart = false
      OsCoreIsAutosar = true
      OsCoreEntrySymbol = _start_tc2
      OsCorePhysicalCoreRef = Core2
      OsCoreIdleTask = IdleTask_OsCore2
      OsCoreSystemApplication = SystemApplication_OsCore2
      OsCoreEcucCoreRef = EcucCoreDefinition_002
      OsCoreResScheduler = RES_SCHEDULER_OsCore2
      OsCoreStacks:
        OsCoreKernelStackSize = 1024
        OsCoreStartupStackSize = 1024
        OsCoreShutdownStackSize = 1024
        OsCoreErrorStackSize = 1024
        OsCoreProtectionStackSize = 1024
        OsCoreInitStackSize = 1024
      XSignalChl_OsCore1 (OsCoreXSignalChannel): OsCoreXSignalChannelSize=1, OsCoreXSignalChannelReceiverIsr=XSignalIsr_OsCore1
      XSignalChl_OsCore0 (OsCoreXSignalChannel): OsCoreXSignalChannelSize=1, OsCoreXSignalChannelReceiverIsr=XSignalIsr_OsCore0
    IdleTask_OsCore2 (OsTask):
      OsTaskActivation = 1
      OsTaskPriority = 4294967295
      OsTaskSchedule = FULL
      OsTaskStackSharing = false
      OsTaskStackSize = 1024
      OsTaskType = AUTO
      OsTaskUsesFpu = false
      OsTaskAccessingApplication = SystemApplication_OsCore1
      OsTaskAccessingApplication = SystemApplication_OsCore2
      OsTaskAccessingApplication = SystemApplication_OsCore0
      OsTaskResourceRef = RES_SCHEDULER_OsCore2
      OsTaskAutostart: OsTaskAppModeRef=OS_APPMODE_ANY
    SystemApplication_OsCore2 (OsApplication):
      OsTrusted = true
      OsTrustedApplicationDelayTimingViolationCall = false
      OsTrustedApplicationWithProtection = false
      OsApplicationIsPrivileged = true
      OsAppUseTrustedFunctionStubs = false
      OsAppTaskRef = IdleTask_OsCore2
      OsApplicationCoreRef = EcucCoreDefinition_002
      OsAppIsrRef = CounterIsr_SystemTimer_Core2
      OsAppCounterRef = SystemTimer_Core2
      OsAppIsrRef = XSignalIsr_OsCore2
      OsApplicationHooks: OsAppErrorHook=false, OsAppShutdownHook=false, OsAppStartupHook=false
    3 x OsIsr, all with OsIsrCategory=CATEGORY_2, OsIsrInterruptType=EXTERNAL, OsIsrInterruptPriority=18, OsIsrStackSize=1024, OsIsrEnableNesting=false, OsIsrUsesFpu=false, OsIsrSpecialFunctionName=Os_XSigRecvIsrHandler, OsIsrInterruptMapping=DEFAULT:
      XSignalIsr_OsCore1: OsIsrInterruptSource=4128
        OsIsrXSignalReceiver:
          OsIsrXSignalReceiverProvidedApis = ShutdownAllCores
          OsIsrXSignalReceiverProvidedApis = ActivateTask
          OsIsrXSignalReceiverProvidedApis = CancelAlarm
          OsIsrXSignalReceiverProvidedApis = ChainTask
          OsIsrXSignalReceiverProvidedApis = ControlIdle
          OsIsrXSignalReceiverProvidedApis = GetAlarm
          OsIsrXSignalReceiverProvidedApis = GetApplicationState
          OsIsrXSignalReceiverProvidedApis = GetCounterValue
          OsIsrXSignalReceiverProvidedApis = GetElapsedValue
          OsIsrXSignalReceiverProvidedApis = GetErrorHookStackUsage
          OsIsrXSignalReceiverProvidedApis = GetEvent
          OsIsrXSignalReceiverProvidedApis = GetISRStackUsage
          OsIsrXSignalReceiverProvidedApis = GetKernelStackUsage
          OsIsrXSignalReceiverProvidedApis = GetProtectionHookStackUsage
          OsIsrXSignalReceiverProvidedApis = GetScheduleTableStatus
          OsIsrXSignalReceiverProvidedApis = GetShutdownHookStackUsage
          OsIsrXSignalReceiverProvidedApis = GetStartupHookStackUsage
          OsIsrXSignalReceiverProvidedApis = GetTaskStackUsage
          OsIsrXSignalReceiverProvidedApis = GetTaskState
          OsIsrXSignalReceiverProvidedApis = HookCallCallback
          OsIsrXSignalReceiverProvidedApis = NextScheduleTable
          OsIsrXSignalReceiverProvidedApis = SetAbsAlarm
          OsIsrXSignalReceiverProvidedApis = SetEvent
          OsIsrXSignalReceiverProvidedApis = SetRelAlarm
          OsIsrXSignalReceiverProvidedApis = StartScheduleTableAbs
          OsIsrXSignalReceiverProvidedApis = StartScheduleTableRel
          OsIsrXSignalReceiverProvidedApis = StopScheduleTable
          OsIsrXSignalReceiverProvidedApis = TerminateApplication
      XSignalIsr_OsCore2: OsIsrInterruptSource=4160
        OsIsrXSignalReceiver:
          OsIsrXSignalReceiverProvidedApis = ShutdownAllCores
          OsIsrXSignalReceiverProvidedApis = ActivateTask
          OsIsrXSignalReceiverProvidedApis = CancelAlarm
          OsIsrXSignalReceiverProvidedApis = ChainTask
          OsIsrXSignalReceiverProvidedApis = ControlIdle
          OsIsrXSignalReceiverProvidedApis = GetAlarm
          OsIsrXSignalReceiverProvidedApis = GetApplicationState
          OsIsrXSignalReceiverProvidedApis = GetCounterValue
          OsIsrXSignalReceiverProvidedApis = GetElapsedValue
          OsIsrXSignalReceiverProvidedApis = GetErrorHookStackUsage
          OsIsrXSignalReceiverProvidedApis = GetEvent
          OsIsrXSignalReceiverProvidedApis = GetISRStackUsage
          OsIsrXSignalReceiverProvidedApis = GetKernelStackUsage
          OsIsrXSignalReceiverProvidedApis = GetProtectionHookStackUsage
          OsIsrXSignalReceiverProvidedApis = GetScheduleTableStatus
          OsIsrXSignalReceiverProvidedApis = GetShutdownHookStackUsage
          OsIsrXSignalReceiverProvidedApis = GetStartupHookStackUsage
          OsIsrXSignalReceiverProvidedApis = GetTaskStackUsage
          OsIsrXSignalReceiverProvidedApis = GetTaskState
          OsIsrXSignalReceiverProvidedApis = HookCallCallback
          OsIsrXSignalReceiverProvidedApis = NextScheduleTable
          OsIsrXSignalReceiverProvidedApis = SetAbsAlarm
          OsIsrXSignalReceiverProvidedApis = SetEvent
          OsIsrXSignalReceiverProvidedApis = SetRelAlarm
          OsIsrXSignalReceiverProvidedApis = StartScheduleTableAbs
          OsIsrXSignalReceiverProvidedApis = StartScheduleTableRel
          OsIsrXSignalReceiverProvidedApis = StopScheduleTable
          OsIsrXSignalReceiverProvidedApis = TerminateApplication
      XSignalIsr_OsCore0: OsIsrInterruptSource=4096
        OsIsrXSignalReceiver:
          OsIsrXSignalReceiverProvidedApis = ShutdownAllCores
          OsIsrXSignalReceiverProvidedApis = ActivateTask
          OsIsrXSignalReceiverProvidedApis = CancelAlarm
          OsIsrXSignalReceiverProvidedApis = ChainTask
          OsIsrXSignalReceiverProvidedApis = ControlIdle
          OsIsrXSignalReceiverProvidedApis = GetAlarm
          OsIsrXSignalReceiverProvidedApis = GetApplicationState
          OsIsrXSignalReceiverProvidedApis = GetCounterValue
          OsIsrXSignalReceiverProvidedApis = GetElapsedValue
          OsIsrXSignalReceiverProvidedApis = GetErrorHookStackUsage
          OsIsrXSignalReceiverProvidedApis = GetEvent
          OsIsrXSignalReceiverProvidedApis = GetISRStackUsage
          OsIsrXSignalReceiverProvidedApis = GetKernelStackUsage
          OsIsrXSignalReceiverProvidedApis = GetProtectionHookStackUsage
          OsIsrXSignalReceiverProvidedApis = GetScheduleTableStatus
          OsIsrXSignalReceiverProvidedApis = GetShutdownHookStackUsage
          OsIsrXSignalReceiverProvidedApis = GetStartupHookStackUsage
          OsIsrXSignalReceiverProvidedApis = GetTaskStackUsage
          OsIsrXSignalReceiverProvidedApis = GetTaskState
          OsIsrXSignalReceiverProvidedApis = HookCallCallback
          OsIsrXSignalReceiverProvidedApis = NextScheduleTable
          OsIsrXSignalReceiverProvidedApis = SetAbsAlarm
          OsIsrXSignalReceiverProvidedApis = SetEvent
          OsIsrXSignalReceiverProvidedApis = SetRelAlarm
          OsIsrXSignalReceiverProvidedApis = StartScheduleTableAbs
          OsIsrXSignalReceiverProvidedApis = StartScheduleTableRel
          OsIsrXSignalReceiverProvidedApis = StopScheduleTable
          OsIsrXSignalReceiverProvidedApis = TerminateApplication
    3 x OsApplication, all with OsTrusted=true, OsTrustedApplicationDelayTimingViolationCall=false, OsTrustedApplicationWithProtection=false, OsApplicationIsPrivileged=true, OsAppUseTrustedFunctionStubs=false:
      OsApplication_Core0: OsApplicationCoreRef=EcucCoreDefinition, OsAppTaskRef=TaskInit_Core0, OsAppTaskRef=Task200ms_Core0, OsAppTaskRef=Os/TaskSchM_Core0, OsAppAlarmRef=Os/Rte_Al_TE_CpAp_FAWDemo_Core0_Runnable200ms_Core0, OsAppTaskRef=Task1ms_Core0, OsAppTaskRef=Task5ms_Core0, OsAppTaskRef=Task10ms_Core0, OsAppTaskRef=Task20ms_Core0, OsAppTaskRef=Task50ms_Core0, OsAppTaskRef=Task100ms_Core0, OsAppTaskRef=Task1000ms_Core0, OsAppAlarmRef=Os/Rte_Al_TE_CpAp_FAWDemo_Core0_Runnable1000ms_Core0, OsAppAlarmRef=Os/Rte_Al_TE_CpAp_FAWDemo_Core0_Runnable1ms_Core0, OsAppAlarmRef=Os/Rte_Al_TE_CpAp_FAWDemo_Core0_Runnable20ms_Core0, OsAppAlarmRef=Os/Rte_Al_TE_CpAp_FAWDemo_Core0_Runnable50ms_Core0, OsAppAlarmRef=Os/Rte_Al_TE_CpAp_FAWDemo_Core0_Runnable5ms_Core0, OsAppTaskRef=Task500ms_Core0, OsAppAlarmRef=Os/Rte_Al_TE_CpAp_FAWDemo_Core0_Runnable500ms_Core0, OsAppAlarmRef=Os/Rte_Al_TE2_TaskSchM_Core0_0_10ms, OsAppAlarmRef=Os/Rte_Al_TE_CpAp_FAWDemo_Core0_Runnable100ms_Core0, OsAppAlarmRef=Os/Rte_Al_TE_CpAp_FAWDemo_Core0_Runnable10ms_Core0, OsAppAlarmRef=Os/Rte_Al_TE2_TaskSchM_Core0_0_20ms, OsAppIsrRef=CanIsr_0
        OsApplicationHooks: OsAppErrorHook=false, OsAppShutdownHook=false, OsAppStartupHook=false
      OsApplication_Core1: OsApplicationCoreRef=EcucCoreDefinition_001, OsAppTaskRef=TaskInit_Core1, OsAppTaskRef=Task200ms_Core1, OsAppTaskRef=TaskSchM_Core1, OsAppAlarmRef=Os/Rte_Al_TE2_EcuM_EcuM_MainFunction, OsAppAlarmRef=Os/Rte_Al_TE_CpAp_FAWDemo_Core1_Runnable200ms_Core1, OsAppTaskRef=Task10ms_Core1, OsAppTaskRef=Task20ms_Core1, OsAppTaskRef=Task50ms_Core1, OsAppTaskRef=Task100ms_Core1, OsAppAlarmRef=Os/Rte_Al_TE_CpAp_FAWDemo_Core1_Runnable100ms_Core1, OsAppAlarmRef=Os/Rte_Al_TE_CpAp_FAWDemo_Core1_Runnable10ms_Core1, OsAppAlarmRef=Os/Rte_Al_TE_CpAp_FAWDemo_Core1_Runnable20ms_Core1, OsAppAlarmRef=Os/Rte_Al_TE_CpAp_FAWDemo_Core1_Runnable50ms_Core1, OsAppTaskRef=Task1ms_Core1, OsAppTaskRef=Task5ms_Core1, OsAppTaskRef=Task500ms_Core1, OsAppTaskRef=Task1000ms_Core1, OsAppIsrRef=Adc0Sr0_Isr, OsAppIsrRef=Adc1Sr0_Isr, OsAppIsrRef=Adc2Sr0_Isr, OsAppIsrRef=Adc3Sr0_Isr, OsAppIsrRef=Adc4Sr0_Isr, OsAppIsrRef=Adc5Sr0_Isr, OsAppIsrRef=Adc6Sr0_Isr, OsAppIsrRef=Isr_TIM02, OsAppIsrRef=Isr_TIM03, OsAppAlarmRef=Os/Rte_Al_TE_CpAp_FAWDemo_Core1_Runnable1000ms_Core1, OsAppAlarmRef=Os/Rte_Al_TE_CpAp_FAWDemo_Core1_Runnable1ms_Core1, OsAppAlarmRef=Os/Rte_Al_TE_CpAp_FAWDemo_Core1_Runnable500ms_Core1, OsAppAlarmRef=Os/Rte_Al_TE_CpAp_FAWDemo_Core1_Runnable5ms_Core1
        OsApplicationHooks: OsAppErrorHook=false, OsAppShutdownHook=false, OsAppStartupHook=false
      OsApplication_Core2: OsApplicationCoreRef=EcucCoreDefinition_002, OsAppTaskRef=TaskInit_Core2, OsAppTaskRef=Task200ms_Core2, OsAppTaskRef=TaskSchM_Core2, OsAppAlarmRef=Os/Rte_Al_TE3_EcuM_EcuM_MainFunction, OsAppAlarmRef=Os/Rte_Al_TE_CpAp_FAWDemo_Core2_Runnable200ms_Core2, OsAppTaskRef=Task10ms_Core2, OsAppTaskRef=Task20ms_Core2, OsAppTaskRef=Task50ms_Core2, OsAppTaskRef=Task100ms_Core2, OsAppAlarmRef=Os/Rte_Al_TE_CpAp_FAWDemo_Core2_Runnable100ms_Core2, OsAppAlarmRef=Os/Rte_Al_TE_CpAp_FAWDemo_Core2_Runnable10ms_Core2, OsAppAlarmRef=Os/Rte_Al_TE_CpAp_FAWDemo_Core2_Runnable20ms_Core2, OsAppAlarmRef=Os/Rte_Al_TE_CpAp_FAWDemo_Core2_Runnable50ms_Core2, OsAppTaskRef=Task1ms_Core2, OsAppTaskRef=Task1000ms_Core2, OsAppTaskRef=Task500ms_Core2, OsAppTaskRef=Task5ms_Core2, OsAppAlarmRef=Os/Rte_Al_TE_CpAp_FAWDemo_Core2_Runnable1000ms_Core2, OsAppAlarmRef=Os/Rte_Al_TE_CpAp_FAWDemo_Core2_Runnable1ms_Core2, OsAppAlarmRef=Os/Rte_Al_TE_CpAp_FAWDemo_Core2_Runnable500ms_Core2, OsAppAlarmRef=Os/Rte_Al_TE_CpAp_FAWDemo_Core2_Runnable5ms_Core2
        OsApplicationHooks: OsAppErrorHook=false, OsAppShutdownHook=false, OsAppStartupHook=false
    SystemTimer_Core1 (OsCounter):
      OsCounterMaxAllowedValue = 1073741823
      OsCounterMinCycle = 1
      OsCounterType = HARDWARE
      OsSecondsPerTick = 1E-8
      OsCounterTicksPerBase = 1
      OsCounterAccessingApplication = SystemApplication_OsCore{0..2}
      OsDriver: OsDriverHighResolution=true, OsDriverHardwareTimerChannelRef=STM1_Ch0, OsDriverIsrRef=CounterIsr_SystemTimer_Core1
    SystemTimer_Core2 (OsCounter):
      OsCounterMaxAllowedValue = 1073741823
      OsCounterMinCycle = 1
      OsCounterType = HARDWARE
      OsSecondsPerTick = 1E-8
      OsCounterTicksPerBase = 1
      OsCounterAccessingApplication = SystemApplication_OsCore{0..2}
      OsDriver: OsDriverHighResolution=true, OsDriverHardwareTimerChannelRef=STM2_Ch0, OsDriverIsrRef=CounterIsr_SystemTimer_Core2
    3 x OsIsr, all with OsIsrCategory=CATEGORY_2, OsIsrInterruptType=EXTERNAL, OsIsrInterruptPriority=3, OsIsrStackSize=1024, OsIsrEnableNesting=false, OsIsrUsesFpu=false, OsIsrSpecialFunctionName=Os_TimerHrtIsr, OsIsrInterruptMapping=DEFAULT:
      CounterIsr_SystemTimer_Core0: OsIsrInterruptSource=1168
      CounterIsr_SystemTimer_Core1: OsIsrInterruptSource=1176
      CounterIsr_SystemTimer_Core2: OsIsrInterruptSource=1184
    3 x OsResource, all with OsResourceProperty=STANDARD, OsResourceAccessingApplication=SystemApplication_OsCore0, OsResourceAccessingApplication=SystemApplication_OsCore1, OsResourceAccessingApplication=SystemApplication_OsCore2:
      RES_SCHEDULER_OsCore{0..2}: OsResourceAccessingApplication=OsApplication_Core{0..2}
    9 x OsTask, all with OsTaskActivation=1, OsTaskStackSharing=false, OsTaskStackSize=1024, OsTaskType=AUTO, OsTaskUsesFpu=false, OsTaskAccessingApplication=SystemApplication_OsCore0, OsTaskAccessingApplication=SystemApplication_OsCore1, OsTaskAccessingApplication=SystemApplication_OsCore2:
      TaskInit_Core0: OsTaskPriority=100, OsTaskSchedule=NON, OsTaskResourceRef=RES_SCHEDULER_OsCore0
        OsTaskAutostart: OsTaskAppModeRef=OS_APPMODE_ANY
      TaskInit_Core1: OsTaskPriority=100, OsTaskSchedule=NON, OsTaskResourceRef=RES_SCHEDULER_OsCore1
        OsTaskAutostart: OsTaskAppModeRef=OS_APPMODE_ANY
      TaskInit_Core2: OsTaskPriority=100, OsTaskSchedule=NON, OsTaskResourceRef=RES_SCHEDULER_OsCore2
        OsTaskAutostart: OsTaskAppModeRef=OS_APPMODE_ANY
      Task200ms_Core0: OsTaskPriority=53, OsTaskSchedule=FULL, OsTaskResourceRef=RES_SCHEDULER_OsCore0, OsTaskAccessingApplication=OsApplication_Core1, OsTaskAccessingApplication=OsApplication_Core2
      Task200ms_Core1: OsTaskPriority=53, OsTaskSchedule=FULL, OsTaskResourceRef=RES_SCHEDULER_OsCore1, OsTaskAccessingApplication=OsApplication_Core0, OsTaskAccessingApplication=OsApplication_Core2
      Task200ms_Core2: OsTaskPriority=53, OsTaskSchedule=FULL, OsTaskResourceRef=RES_SCHEDULER_OsCore2, OsTaskAccessingApplication=OsApplication_Core0, OsTaskAccessingApplication=OsApplication_Core1
      TaskSchM_Core0: OsTaskPriority=90, OsTaskSchedule=FULL, OsTaskResourceRef=RES_SCHEDULER_OsCore0, OsTaskAccessingApplication=OsApplication_Core1, OsTaskAccessingApplication=OsApplication_Core2, OsTaskEventRef=Rte_Ev_Cyclic2_TaskSchM_Core0_0_10ms, OsTaskEventRef=Rte_Ev_Cyclic2_TaskSchM_Core0_0_20ms
      TaskSchM_Core1: OsTaskPriority=90, OsTaskSchedule=FULL, OsTaskResourceRef=RES_SCHEDULER_OsCore1, OsTaskAccessingApplication=OsApplication_Core0, OsTaskAccessingApplication=OsApplication_Core2
      TaskSchM_Core2: OsTaskPriority=90, OsTaskSchedule=FULL, OsTaskResourceRef=RES_SCHEDULER_OsCore2, OsTaskAccessingApplication=OsApplication_Core0, OsTaskAccessingApplication=OsApplication_Core1
    5 x OsAlarm, all with OsAlarmAccessingApplication=SystemApplication_OsCore0, OsAlarmAccessingApplication=SystemApplication_OsCore1, OsAlarmAccessingApplication=SystemApplication_OsCore2:
      Rte_Al_TE2_EcuM_EcuM_MainFunction: OsAlarmCounterRef=SystemTimer_Core1, OsAlarmAccessingApplication=OsApplication_Core0, OsAlarmAccessingApplication=OsApplication_Core2
        OsAlarmAction
          OsAlarmActivateTask: OsAlarmActivateTaskRef=TaskSchM_Core1
      Rte_Al_TE3_EcuM_EcuM_MainFunction: OsAlarmCounterRef=SystemTimer_Core2, OsAlarmAccessingApplication=OsApplication_Core0, OsAlarmAccessingApplication=OsApplication_Core1
        OsAlarmAction
          OsAlarmActivateTask: OsAlarmActivateTaskRef=TaskSchM_Core2
      Rte_Al_TE_CpAp_FAWDemo_Core0_Runnable200ms_Core0: OsAlarmCounterRef=SystemTimer_Core0, OsAlarmAccessingApplication=OsApplication_Core1, OsAlarmAccessingApplication=OsApplication_Core2
        OsAlarmAction
          OsAlarmActivateTask: OsAlarmActivateTaskRef=Task200ms_Core0
      Rte_Al_TE_CpAp_FAWDemo_Core1_Runnable200ms_Core1: OsAlarmCounterRef=SystemTimer_Core1, OsAlarmAccessingApplication=OsApplication_Core0, OsAlarmAccessingApplication=OsApplication_Core2
        OsAlarmAction
          OsAlarmActivateTask: OsAlarmActivateTaskRef=Task200ms_Core1
      Rte_Al_TE_CpAp_FAWDemo_Core2_Runnable200ms_Core2: OsAlarmCounterRef=SystemTimer_Core2, OsAlarmAccessingApplication=OsApplication_Core0, OsAlarmAccessingApplication=OsApplication_Core1
        OsAlarmAction
          OsAlarmActivateTask: OsAlarmActivateTaskRef=Task200ms_Core2
    15 x OsTask, all with OsTaskActivation=1, OsTaskSchedule=FULL, OsTaskStackSharing=false, OsTaskStackSize=1024, OsTaskType=AUTO, OsTaskUsesFpu=false, OsTaskAccessingApplication=SystemApplication_OsCore0, OsTaskAccessingApplication=SystemApplication_OsCore1, OsTaskAccessingApplication=SystemApplication_OsCore2:
      Task1ms_Core0: OsTaskPriority=59, OsTaskResourceRef=RES_SCHEDULER_OsCore0, OsTaskAccessingApplication=OsApplication_Core1, OsTaskAccessingApplication=OsApplication_Core2
      Task5ms_Core0: OsTaskPriority=58, OsTaskResourceRef=RES_SCHEDULER_OsCore0, OsTaskAccessingApplication=OsApplication_Core1, OsTaskAccessingApplication=OsApplication_Core2
      Task10ms_Core0: OsTaskPriority=57, OsTaskResourceRef=RES_SCHEDULER_OsCore0, OsTaskAccessingApplication=OsApplication_Core1, OsTaskAccessingApplication=OsApplication_Core2
      Task20ms_Core0: OsTaskPriority=56, OsTaskResourceRef=RES_SCHEDULER_OsCore0, OsTaskAccessingApplication=OsApplication_Core1, OsTaskAccessingApplication=OsApplication_Core2
      Task50ms_Core0: OsTaskPriority=55, OsTaskResourceRef=RES_SCHEDULER_OsCore0, OsTaskAccessingApplication=OsApplication_Core1, OsTaskAccessingApplication=OsApplication_Core2
      Task100ms_Core0: OsTaskPriority=54, OsTaskResourceRef=RES_SCHEDULER_OsCore0, OsTaskAccessingApplication=OsApplication_Core1, OsTaskAccessingApplication=OsApplication_Core2
      Task1000ms_Core0: OsTaskPriority=51, OsTaskResourceRef=RES_SCHEDULER_OsCore0, OsTaskAccessingApplication=OsApplication_Core1, OsTaskAccessingApplication=OsApplication_Core2
      Task10ms_Core1: OsTaskPriority=57, OsTaskResourceRef=RES_SCHEDULER_OsCore1, OsTaskAccessingApplication=OsApplication_Core0, OsTaskAccessingApplication=OsApplication_Core2
      Task20ms_Core1: OsTaskPriority=56, OsTaskResourceRef=RES_SCHEDULER_OsCore1, OsTaskAccessingApplication=OsApplication_Core0, OsTaskAccessingApplication=OsApplication_Core2
      Task50ms_Core1: OsTaskPriority=55, OsTaskResourceRef=RES_SCHEDULER_OsCore1, OsTaskAccessingApplication=OsApplication_Core0, OsTaskAccessingApplication=OsApplication_Core2
      Task100ms_Core1: OsTaskPriority=54, OsTaskResourceRef=RES_SCHEDULER_OsCore1, OsTaskAccessingApplication=OsApplication_Core0, OsTaskAccessingApplication=OsApplication_Core2
      Task10ms_Core2: OsTaskPriority=57, OsTaskResourceRef=RES_SCHEDULER_OsCore2, OsTaskAccessingApplication=OsApplication_Core0, OsTaskAccessingApplication=OsApplication_Core1
      Task20ms_Core2: OsTaskPriority=56, OsTaskResourceRef=RES_SCHEDULER_OsCore2, OsTaskAccessingApplication=OsApplication_Core0, OsTaskAccessingApplication=OsApplication_Core1
      Task50ms_Core2: OsTaskPriority=55, OsTaskResourceRef=RES_SCHEDULER_OsCore2, OsTaskAccessingApplication=OsApplication_Core0, OsTaskAccessingApplication=OsApplication_Core1
      Task100ms_Core2: OsTaskPriority=54, OsTaskResourceRef=RES_SCHEDULER_OsCore2, OsTaskAccessingApplication=OsApplication_Core0, OsTaskAccessingApplication=OsApplication_Core1
    13 x OsAlarm, all with OsAlarmAccessingApplication=SystemApplication_OsCore0, OsAlarmAccessingApplication=SystemApplication_OsCore1, OsAlarmAccessingApplication=SystemApplication_OsCore2:
      Rte_Al_TE_CpAp_FAWDemo_Core0_Runnable1000ms_Core0: OsAlarmCounterRef=SystemTimer_Core0, OsAlarmAccessingApplication=OsApplication_Core1, OsAlarmAccessingApplication=OsApplication_Core2
        OsAlarmAction
          OsAlarmActivateTask: OsAlarmActivateTaskRef=Task1000ms_Core0
      Rte_Al_TE_CpAp_FAWDemo_Core1_Runnable100ms_Core1: OsAlarmCounterRef=SystemTimer_Core1, OsAlarmAccessingApplication=OsApplication_Core0, OsAlarmAccessingApplication=OsApplication_Core2
        OsAlarmAction
          OsAlarmActivateTask: OsAlarmActivateTaskRef=Task100ms_Core1
      Rte_Al_TE_CpAp_FAWDemo_Core2_Runnable100ms_Core2: OsAlarmCounterRef=SystemTimer_Core2, OsAlarmAccessingApplication=OsApplication_Core0, OsAlarmAccessingApplication=OsApplication_Core1
        OsAlarmAction
          OsAlarmActivateTask: OsAlarmActivateTaskRef=Task100ms_Core2
      Rte_Al_TE_CpAp_FAWDemo_Core1_Runnable10ms_Core1: OsAlarmCounterRef=SystemTimer_Core1, OsAlarmAccessingApplication=OsApplication_Core0, OsAlarmAccessingApplication=OsApplication_Core2
        OsAlarmAction
          OsAlarmActivateTask: OsAlarmActivateTaskRef=Task10ms_Core1
      Rte_Al_TE_CpAp_FAWDemo_Core2_Runnable10ms_Core2: OsAlarmCounterRef=SystemTimer_Core2, OsAlarmAccessingApplication=OsApplication_Core0, OsAlarmAccessingApplication=OsApplication_Core1
        OsAlarmAction
          OsAlarmActivateTask: OsAlarmActivateTaskRef=Task10ms_Core2
      Rte_Al_TE_CpAp_FAWDemo_Core0_Runnable1ms_Core0: OsAlarmCounterRef=SystemTimer_Core0, OsAlarmAccessingApplication=OsApplication_Core1, OsAlarmAccessingApplication=OsApplication_Core2
        OsAlarmAction
          OsAlarmActivateTask: OsAlarmActivateTaskRef=Task1ms_Core0
      Rte_Al_TE_CpAp_FAWDemo_Core0_Runnable20ms_Core0: OsAlarmCounterRef=SystemTimer_Core0, OsAlarmAccessingApplication=OsApplication_Core1, OsAlarmAccessingApplication=OsApplication_Core2
        OsAlarmAction
          OsAlarmActivateTask: OsAlarmActivateTaskRef=Task20ms_Core0
      Rte_Al_TE_CpAp_FAWDemo_Core1_Runnable20ms_Core1: OsAlarmCounterRef=SystemTimer_Core1, OsAlarmAccessingApplication=OsApplication_Core0, OsAlarmAccessingApplication=OsApplication_Core2
        OsAlarmAction
          OsAlarmActivateTask: OsAlarmActivateTaskRef=Task20ms_Core1
      Rte_Al_TE_CpAp_FAWDemo_Core2_Runnable20ms_Core2: OsAlarmCounterRef=SystemTimer_Core2, OsAlarmAccessingApplication=OsApplication_Core0, OsAlarmAccessingApplication=OsApplication_Core1
        OsAlarmAction
          OsAlarmActivateTask: OsAlarmActivateTaskRef=Task20ms_Core2
      Rte_Al_TE_CpAp_FAWDemo_Core0_Runnable50ms_Core0: OsAlarmCounterRef=SystemTimer_Core0, OsAlarmAccessingApplication=OsApplication_Core1, OsAlarmAccessingApplication=OsApplication_Core2
        OsAlarmAction
          OsAlarmActivateTask: OsAlarmActivateTaskRef=Task50ms_Core0
      Rte_Al_TE_CpAp_FAWDemo_Core1_Runnable50ms_Core1: OsAlarmCounterRef=SystemTimer_Core1, OsAlarmAccessingApplication=OsApplication_Core0, OsAlarmAccessingApplication=OsApplication_Core2
        OsAlarmAction
          OsAlarmActivateTask: OsAlarmActivateTaskRef=Task50ms_Core1
      Rte_Al_TE_CpAp_FAWDemo_Core2_Runnable50ms_Core2: OsAlarmCounterRef=SystemTimer_Core2, OsAlarmAccessingApplication=OsApplication_Core0, OsAlarmAccessingApplication=OsApplication_Core1
        OsAlarmAction
          OsAlarmActivateTask: OsAlarmActivateTaskRef=Task50ms_Core2
      Rte_Al_TE_CpAp_FAWDemo_Core0_Runnable5ms_Core0: OsAlarmCounterRef=SystemTimer_Core0, OsAlarmAccessingApplication=OsApplication_Core1, OsAlarmAccessingApplication=OsApplication_Core2
        OsAlarmAction
          OsAlarmActivateTask: OsAlarmActivateTaskRef=Task5ms_Core0
    9 x OsTask, all with OsTaskActivation=1, OsTaskSchedule=FULL, OsTaskStackSharing=false, OsTaskStackSize=1024, OsTaskType=AUTO, OsTaskUsesFpu=false, OsTaskAccessingApplication=SystemApplication_OsCore0, OsTaskAccessingApplication=SystemApplication_OsCore1, OsTaskAccessingApplication=SystemApplication_OsCore2:
      Task500ms_Core0: OsTaskPriority=52, OsTaskResourceRef=RES_SCHEDULER_OsCore0, OsTaskAccessingApplication=OsApplication_Core1, OsTaskAccessingApplication=OsApplication_Core2
      Task1ms_Core1: OsTaskPriority=59, OsTaskResourceRef=RES_SCHEDULER_OsCore1, OsTaskAccessingApplication=OsApplication_Core0, OsTaskAccessingApplication=OsApplication_Core2
      Task5ms_Core1: OsTaskPriority=58, OsTaskResourceRef=RES_SCHEDULER_OsCore1, OsTaskAccessingApplication=OsApplication_Core0, OsTaskAccessingApplication=OsApplication_Core2
      Task500ms_Core1: OsTaskPriority=52, OsTaskResourceRef=RES_SCHEDULER_OsCore1, OsTaskAccessingApplication=OsApplication_Core0, OsTaskAccessingApplication=OsApplication_Core2
      Task1000ms_Core1: OsTaskPriority=51, OsTaskResourceRef=RES_SCHEDULER_OsCore1, OsTaskAccessingApplication=OsApplication_Core0, OsTaskAccessingApplication=OsApplication_Core2
      Task1ms_Core2: OsTaskPriority=59, OsTaskResourceRef=RES_SCHEDULER_OsCore2, OsTaskAccessingApplication=OsApplication_Core0, OsTaskAccessingApplication=OsApplication_Core1
      Task1000ms_Core2: OsTaskPriority=51, OsTaskResourceRef=RES_SCHEDULER_OsCore2, OsTaskAccessingApplication=OsApplication_Core0, OsTaskAccessingApplication=OsApplication_Core1
      Task500ms_Core2: OsTaskPriority=52, OsTaskResourceRef=RES_SCHEDULER_OsCore2, OsTaskAccessingApplication=OsApplication_Core0, OsTaskAccessingApplication=OsApplication_Core1
      Task5ms_Core2: OsTaskPriority=58, OsTaskResourceRef=RES_SCHEDULER_OsCore2, OsTaskAccessingApplication=OsApplication_Core0, OsTaskAccessingApplication=OsApplication_Core1
    9 x OsIsr, all with OsIsrCategory=CATEGORY_2, OsIsrInterruptType=EXTERNAL, OsIsrStackSize=1024, OsIsrEnableNesting=false, OsIsrUsesFpu=false, OsIsrInterruptMapping=DEFAULT:
      Adc0Sr0_Isr: OsIsrInterruptSource=2432, OsIsrInterruptPriority=50
      Adc1Sr0_Isr: OsIsrInterruptSource=2448, OsIsrInterruptPriority=51
      Adc2Sr0_Isr: OsIsrInterruptSource=2464, OsIsrInterruptPriority=52
      Adc3Sr0_Isr: OsIsrInterruptSource=2480, OsIsrInterruptPriority=53
      Adc4Sr0_Isr: OsIsrInterruptSource=2496, OsIsrInterruptPriority=54
      Adc5Sr0_Isr: OsIsrInterruptSource=2512, OsIsrInterruptPriority=55
      Adc6Sr0_Isr: OsIsrInterruptSource=2528, OsIsrInterruptPriority=56
      Isr_TIM02: OsIsrInterruptSource=6024, OsIsrInterruptPriority=30
      Isr_TIM03: OsIsrInterruptSource=6028, OsIsrInterruptPriority=31
    13 x OsAlarm, all with OsAlarmAccessingApplication=SystemApplication_OsCore0, OsAlarmAccessingApplication=SystemApplication_OsCore1, OsAlarmAccessingApplication=SystemApplication_OsCore2:
      Rte_Al_TE_CpAp_FAWDemo_Core1_Runnable1000ms_Core1: OsAlarmCounterRef=SystemTimer_Core1, OsAlarmAccessingApplication=OsApplication_Core0, OsAlarmAccessingApplication=OsApplication_Core2
        OsAlarmAction
          OsAlarmActivateTask: OsAlarmActivateTaskRef=Task1000ms_Core1
      Rte_Al_TE_CpAp_FAWDemo_Core2_Runnable1000ms_Core2: OsAlarmCounterRef=SystemTimer_Core2, OsAlarmAccessingApplication=OsApplication_Core0, OsAlarmAccessingApplication=OsApplication_Core1
        OsAlarmAction
          OsAlarmActivateTask: OsAlarmActivateTaskRef=Task1000ms_Core2
      Rte_Al_TE_CpAp_FAWDemo_Core1_Runnable1ms_Core1: OsAlarmCounterRef=SystemTimer_Core1, OsAlarmAccessingApplication=OsApplication_Core0, OsAlarmAccessingApplication=OsApplication_Core2
        OsAlarmAction
          OsAlarmActivateTask: OsAlarmActivateTaskRef=Task1ms_Core1
      Rte_Al_TE_CpAp_FAWDemo_Core2_Runnable1ms_Core2: OsAlarmCounterRef=SystemTimer_Core2, OsAlarmAccessingApplication=OsApplication_Core0, OsAlarmAccessingApplication=OsApplication_Core1
        OsAlarmAction
          OsAlarmActivateTask: OsAlarmActivateTaskRef=Task1ms_Core2
      Rte_Al_TE_CpAp_FAWDemo_Core0_Runnable500ms_Core0: OsAlarmCounterRef=SystemTimer_Core0, OsAlarmAccessingApplication=OsApplication_Core1, OsAlarmAccessingApplication=OsApplication_Core2
        OsAlarmAction
          OsAlarmActivateTask: OsAlarmActivateTaskRef=Task500ms_Core0
      Rte_Al_TE_CpAp_FAWDemo_Core1_Runnable500ms_Core1: OsAlarmCounterRef=SystemTimer_Core1, OsAlarmAccessingApplication=OsApplication_Core0, OsAlarmAccessingApplication=OsApplication_Core2
        OsAlarmAction
          OsAlarmActivateTask: OsAlarmActivateTaskRef=Task500ms_Core1
      Rte_Al_TE_CpAp_FAWDemo_Core2_Runnable500ms_Core2: OsAlarmCounterRef=SystemTimer_Core2, OsAlarmAccessingApplication=OsApplication_Core0, OsAlarmAccessingApplication=OsApplication_Core1
        OsAlarmAction
          OsAlarmActivateTask: OsAlarmActivateTaskRef=Task500ms_Core2
      Rte_Al_TE_CpAp_FAWDemo_Core1_Runnable5ms_Core1: OsAlarmCounterRef=SystemTimer_Core1, OsAlarmAccessingApplication=OsApplication_Core0, OsAlarmAccessingApplication=OsApplication_Core2
        OsAlarmAction
          OsAlarmActivateTask: OsAlarmActivateTaskRef=Task5ms_Core1
      Rte_Al_TE_CpAp_FAWDemo_Core2_Runnable5ms_Core2: OsAlarmCounterRef=SystemTimer_Core2, OsAlarmAccessingApplication=OsApplication_Core0, OsAlarmAccessingApplication=OsApplication_Core1
        OsAlarmAction
          OsAlarmActivateTask: OsAlarmActivateTaskRef=Task5ms_Core2
      Rte_Al_TE2_TaskSchM_Core0_0_10ms: OsAlarmCounterRef=SystemTimer_Core0, OsAlarmAccessingApplication=OsApplication_Core1, OsAlarmAccessingApplication=OsApplication_Core2
        OsAlarmAction
          OsAlarmSetEvent: OsAlarmSetEventRef=Rte_Ev_Cyclic2_TaskSchM_Core0_0_10ms, OsAlarmSetEventTaskRef=Os/TaskSchM_Core0
      Rte_Al_TE_CpAp_FAWDemo_Core0_Runnable100ms_Core0: OsAlarmCounterRef=SystemTimer_Core0, OsAlarmAccessingApplication=OsApplication_Core1, OsAlarmAccessingApplication=OsApplication_Core2
        OsAlarmAction
          OsAlarmActivateTask: OsAlarmActivateTaskRef=Task100ms_Core0
      Rte_Al_TE_CpAp_FAWDemo_Core0_Runnable10ms_Core0: OsAlarmCounterRef=SystemTimer_Core0, OsAlarmAccessingApplication=OsApplication_Core1, OsAlarmAccessingApplication=OsApplication_Core2
        OsAlarmAction
          OsAlarmActivateTask: OsAlarmActivateTaskRef=Task10ms_Core0
      Rte_Al_TE2_TaskSchM_Core0_0_20ms: OsAlarmCounterRef=SystemTimer_Core0, OsAlarmAccessingApplication=OsApplication_Core1, OsAlarmAccessingApplication=OsApplication_Core2
        OsAlarmAction
          OsAlarmSetEvent: OsAlarmSetEventRef=Rte_Ev_Cyclic2_TaskSchM_Core0_0_20ms, OsAlarmSetEventTaskRef=Os/TaskSchM_Core0
    Rte_Ev_Cyclic2_TaskSchM_Core0_0_10ms (OsEvent)
    Rte_Ev_Cyclic2_TaskSchM_Core0_0_20ms (OsEvent)
    CanIsr_0 (OsIsr):  # Os Interrupt Service Routine PLAIN_TEXT Can transmit, receive and busoff events of controller CT_CAN00_1adbe8e8. This OsIsr container has been created automatically based on the driver configuration.
      OsIsrCategory = CATEGORY_2
      OsIsrInterruptType = EXTERNAL
      OsIsrInterruptSource = 2304
      OsIsrInterruptPriority = 10
      OsIsrStackSize = 1024
      OsIsrEnableNesting = false
      OsIsrUsesFpu = false
      OsIsrInterruptMapping = DEFAULT
  module config Rte: implementation-config-variant=VARIANT-PRE-COMPILE, module-description=Rte_Impl
    RteOsInteraction
      31 x RteUsedOsActivation, all with RteExpectedActivationOffset=0, RteExpectedTickDuration=0:
        Rte_Al_TE2_EcuM_EcuM_MainFunction: RteActivationOsAlarmRef=Os/Rte_Al_TE2_EcuM_EcuM_MainFunction, RteActivationOsTaskRef=TaskSchM_Core1
        Rte_Al_TE3_EcuM_EcuM_MainFunction: RteActivationOsAlarmRef=Os/Rte_Al_TE3_EcuM_EcuM_MainFunction, RteActivationOsTaskRef=TaskSchM_Core2
        Rte_Al_TE_CpAp_FAWDemo_Core{0..2}_Runnable200ms_Core{0..2}: RteActivationOsAlarmRef=Os/Rte_Al_TE_CpAp_FAWDemo_Core{0..2}_Runnable200ms_Core{0..2}, RteActivationOsTaskRef=Task200ms_Core{0..2}
        Rte_Al_TE_CpAp_FAWDemo_Core0_Runnable1000ms_Core0: RteActivationOsAlarmRef=Os/Rte_Al_TE_CpAp_FAWDemo_Core0_Runnable1000ms_Core0, RteActivationOsTaskRef=Task1000ms_Core0
        Rte_Al_TE_CpAp_FAWDemo_Core1_Runnable100ms_Core1: RteActivationOsAlarmRef=Os/Rte_Al_TE_CpAp_FAWDemo_Core1_Runnable100ms_Core1, RteActivationOsTaskRef=Task100ms_Core1
        Rte_Al_TE_CpAp_FAWDemo_Core2_Runnable100ms_Core2: RteActivationOsAlarmRef=Os/Rte_Al_TE_CpAp_FAWDemo_Core2_Runnable100ms_Core2, RteActivationOsTaskRef=Task100ms_Core2
        Rte_Al_TE_CpAp_FAWDemo_Core1_Runnable10ms_Core1: RteActivationOsAlarmRef=Os/Rte_Al_TE_CpAp_FAWDemo_Core1_Runnable10ms_Core1, RteActivationOsTaskRef=Task10ms_Core1
        Rte_Al_TE_CpAp_FAWDemo_Core2_Runnable10ms_Core2: RteActivationOsAlarmRef=Os/Rte_Al_TE_CpAp_FAWDemo_Core2_Runnable10ms_Core2, RteActivationOsTaskRef=Task10ms_Core2
        Rte_Al_TE_CpAp_FAWDemo_Core0_Runnable1ms_Core0: RteActivationOsAlarmRef=Os/Rte_Al_TE_CpAp_FAWDemo_Core0_Runnable1ms_Core0, RteActivationOsTaskRef=Task1ms_Core0
        Rte_Al_TE_CpAp_FAWDemo_Core{0..2}_Runnable20ms_Core{0..2}: RteActivationOsAlarmRef=Os/Rte_Al_TE_CpAp_FAWDemo_Core{0..2}_Runnable20ms_Core{0..2}, RteActivationOsTaskRef=Task20ms_Core{0..2}
        Rte_Al_TE_CpAp_FAWDemo_Core{0..2}_Runnable50ms_Core{0..2}: RteActivationOsAlarmRef=Os/Rte_Al_TE_CpAp_FAWDemo_Core{0..2}_Runnable50ms_Core{0..2}, RteActivationOsTaskRef=Task50ms_Core{0..2}
        Rte_Al_TE_CpAp_FAWDemo_Core0_Runnable5ms_Core0: RteActivationOsAlarmRef=Os/Rte_Al_TE_CpAp_FAWDemo_Core0_Runnable5ms_Core0, RteActivationOsTaskRef=Task5ms_Core0
        Rte_Al_TE_CpAp_FAWDemo_Core1_Runnable1000ms_Core1: RteActivationOsAlarmRef=Os/Rte_Al_TE_CpAp_FAWDemo_Core1_Runnable1000ms_Core1, RteActivationOsTaskRef=Task1000ms_Core1
        Rte_Al_TE_CpAp_FAWDemo_Core2_Runnable1000ms_Core2: RteActivationOsAlarmRef=Os/Rte_Al_TE_CpAp_FAWDemo_Core2_Runnable1000ms_Core2, RteActivationOsTaskRef=Task1000ms_Core2
        Rte_Al_TE_CpAp_FAWDemo_Core1_Runnable1ms_Core1: RteActivationOsAlarmRef=Os/Rte_Al_TE_CpAp_FAWDemo_Core1_Runnable1ms_Core1, RteActivationOsTaskRef=Task1ms_Core1
        Rte_Al_TE_CpAp_FAWDemo_Core2_Runnable1ms_Core2: RteActivationOsAlarmRef=Os/Rte_Al_TE_CpAp_FAWDemo_Core2_Runnable1ms_Core2, RteActivationOsTaskRef=Task1ms_Core2
        Rte_Al_TE_CpAp_FAWDemo_Core{0..2}_Runnable500ms_Core{0..2}: RteActivationOsAlarmRef=Os/Rte_Al_TE_CpAp_FAWDemo_Core{0..2}_Runnable500ms_Core{0..2}, RteActivationOsTaskRef=Task500ms_Core{0..2}
        Rte_Al_TE_CpAp_FAWDemo_Core1_Runnable5ms_Core1: RteActivationOsAlarmRef=Os/Rte_Al_TE_CpAp_FAWDemo_Core1_Runnable5ms_Core1, RteActivationOsTaskRef=Task5ms_Core1
        Rte_Al_TE_CpAp_FAWDemo_Core2_Runnable5ms_Core2: RteActivationOsAlarmRef=Os/Rte_Al_TE_CpAp_FAWDemo_Core2_Runnable5ms_Core2, RteActivationOsTaskRef=Task5ms_Core2
        Rte_Al_TE2_TaskSchM_Core0_0_10ms: RteActivationOsAlarmRef=Os/Rte_Al_TE2_TaskSchM_Core0_0_10ms, RteActivationOsTaskRef=Os/TaskSchM_Core0
        Rte_Al_TE_CpAp_FAWDemo_Core0_Runnable100ms_Core0: RteActivationOsAlarmRef=Os/Rte_Al_TE_CpAp_FAWDemo_Core0_Runnable100ms_Core0, RteActivationOsTaskRef=Task100ms_Core0
        Rte_Al_TE_CpAp_FAWDemo_Core0_Runnable10ms_Core0: RteActivationOsAlarmRef=Os/Rte_Al_TE_CpAp_FAWDemo_Core0_Runnable10ms_Core0, RteActivationOsTaskRef=Task10ms_Core0
        Rte_Al_TE2_TaskSchM_Core0_0_20ms: RteActivationOsAlarmRef=Os/Rte_Al_TE2_TaskSchM_Core0_0_20ms, RteActivationOsTaskRef=Os/TaskSchM_Core0
    RteGeneration:
      RteGenerationMode = COMPATIBILITY_MODE
      RteIocInteractionReturnValue = RTE_IOC
      RteValueRangeCheckEnabled = false
      RteCalibrationSupport = NONE
      RteCodeVendorId = 30
      RteDevErrorDetect = false
      RteDevErrorDetectUninit = false
      RteMeasurementSupport = false
      RteOptimizationMode = MEMORY
      RteVfbTraceEnabled = false
    RteInitializationBehavior: RteInitializationStrategy=RTE_INITIALIZATION_STRATEGY_AT_DATA_DECLARATION, RteSectionInitializationPolicy=INIT
    RteBswGeneral: RteSchMVersionInfoApi=false, RteUseComShadowSignalApi=false
    BswM (RteBswModuleInstance): RteBswImplementationRef=BswM_Impl, RteBswModuleConfigurationRef=BswM
      BswM_MainFunctionTimingEvent0 (RteBswEventToTaskMapping):
        RteBswImmediateRestart = false
        RteBswPositionInTask = 1
        RteBswEventRef = BswM_MainFunctionTimingEvent0
        RteBswMappedToTaskRef = Os/TaskSchM_Core0
        RteBswUsedOsAlarmRef = Os/Rte_Al_TE2_TaskSchM_Core0_0_10ms
        RteBswUsedOsEventRef = Rte_Ev_Cyclic2_TaskSchM_Core0_0_10ms
      BSWM_EXCLUSIVE_AREA_0 (RteBswExclusiveAreaImpl): RteExclusiveAreaImplMechanism=ALL_INTERRUPT_BLOCKING, RteBswExclusiveAreaRef=BSWM_EXCLUSIVE_AREA_0
    9 x RteSwComponentInstance:
      BswM_EcuSwComposition: RteSoftwareComponentInstanceRef=BswM
        Timer_BswM_MainFunction (RteEventToTaskMapping):
          RteImmediateRestart = false
          RtePositionInTask = 1
          RteEventRef = Timer_BswM_MainFunction
          RteMappedToTaskRef = Os/TaskSchM_Core0
          RteUsedOsAlarmRef = Os/Rte_Al_TE2_TaskSchM_Core0_0_10ms
          RteUsedOsEventRef = Rte_Ev_Cyclic2_TaskSchM_Core0_0_10ms
      Det_EcuSwComposition: RteSoftwareComponentInstanceRef=Det
        OpEventReportError_ReportError_DetModule (RteEventToTaskMapping): RteImmediateRestart=false, RtePositionInTask=3, RteEventRef=OpEventReportError_ReportError_DetModule, RteMappedToTaskRef=Os/TaskSchM_Core0
      EcuM_EcuSwComposition: RteSoftwareComponentInstanceRef=EcuM
        8 x RteEventToTaskMapping, all with RteImmediateRestart=false:
          Timer_EcuM_MainFunction: RtePositionInTask=2, RteEventRef=Timer_EcuM_MainFunction, RteMappedToTaskRef=Os/TaskSchM_Core0, RteUsedOsAlarmRef=Os/Rte_Al_TE2_TaskSchM_Core0_0_10ms, RteUsedOsEventRef=Rte_Ev_Cyclic2_TaskSchM_Core0_0_10ms
          OpEventSelectShutdownTarget_SelectShutdownTarget_EcuM_ShutdownTarget: RteEventRef=OpEventSelectShutdownTarget_SelectShutdownTarget_EcuM_ShutdownTarget
          OpEventGetShutdownTarget_GetShutdownTarget_EcuM_ShutdownTarget: RteEventRef=OpEventGetShutdownTarget_GetShutdownTarget_EcuM_ShutdownTarget
          OpEventGetLastShutdownTarget_GetLastShutdownTarget_EcuM_ShutdownTarget: RteEventRef=OpEventGetLastShutdownTarget_GetLastShutdownTarget_EcuM_ShutdownTarget
          OpEventSelectShutdownCause_SelectShutdownCause_EcuM_ShutdownTarget: RteEventRef=OpEventSelectShutdownCause_SelectShutdownCause_EcuM_ShutdownTarget
          OpEventGetShutdownCause_GetShutdownCause_EcuM_ShutdownTarget: RteEventRef=OpEventGetShutdownCause_GetShutdownCause_EcuM_ShutdownTarget
          OpEventSelectBootTarget_SelectBootTarget_EcuM_BootTarget: RteEventRef=OpEventSelectBootTarget_SelectBootTarget_EcuM_BootTarget
          OpEventGetBootTarget_GetBootTarget_EcuM_BootTarget: RteEventRef=OpEventGetBootTarget_GetBootTarget_EcuM_BootTarget
      Os_OsCore0_swc_EcuSwComposition: RteSoftwareComponentInstanceRef=Os_OsCore0_swc
        OpEventGetCounterValue_GetCounterValue_OsService_SystemTimer_Core0 (RteEventToTaskMapping):
          RteImmediateRestart = false
          RtePositionInTask = 0
          RteEventRef = OpEventGetCounterValue_GetCounterValue_OsService_SystemTimer_Core0
          RteMappedToTaskRef = Os/TaskSchM_Core0
        OpEventGetElapsedValue_GetElapsedValue_OsService_SystemTimer_Core0 (RteEventToTaskMapping): RteImmediateRestart=false, RteEventRef=OpEventGetElapsedValue_GetElapsedValue_OsService_SystemTimer_Core0
      Os_OsCore1_swc_EcuSwComposition: RteSoftwareComponentInstanceRef=Os_OsCore1_swc
        OpEventGetCounterValue_GetCounterValue_OsService_SystemTimer_Core1 (RteEventToTaskMapping):
          RteImmediateRestart = false
          RtePositionInTask = 0
          RteEventRef = OpEventGetCounterValue_GetCounterValue_OsService_SystemTimer_Core1
          RteMappedToTaskRef = TaskSchM_Core1
        OpEventGetElapsedValue_GetElapsedValue_OsService_SystemTimer_Core1 (RteEventToTaskMapping): RteImmediateRestart=false, RteEventRef=OpEventGetElapsedValue_GetElapsedValue_OsService_SystemTimer_Core1
      Os_OsCore2_swc_EcuSwComposition: RteSoftwareComponentInstanceRef=Os_OsCore2_swc
        OpEventGetCounterValue_GetCounterValue_OsService_SystemTimer_Core2 (RteEventToTaskMapping):
          RteImmediateRestart = false
          RtePositionInTask = 0
          RteEventRef = OpEventGetCounterValue_GetCounterValue_OsService_SystemTimer_Core2
          RteMappedToTaskRef = TaskSchM_Core2
        OpEventGetElapsedValue_GetElapsedValue_OsService_SystemTimer_Core2 (RteEventToTaskMapping): RteImmediateRestart=false, RteEventRef=OpEventGetElapsedValue_GetElapsedValue_OsService_SystemTimer_Core2
      CpAp_FAWDemo_Core0_EcuSwComposition: RteSoftwareComponentInstanceRef=CpAp_FAWDemo_Core0
        9 x RteEventToTaskMapping, all with RteImmediateRestart=false, RtePositionInTask=0:
          TMT_Runnable200ms_Core0: RteEventRef=TMT_Runnable200ms_Core0, RteMappedToTaskRef=Task200ms_Core0, RteUsedOsAlarmRef=Os/Rte_Al_TE_CpAp_FAWDemo_Core0_Runnable200ms_Core0
          TMT_Runnable5ms_Core0: RteEventRef=TMT_Runnable5ms_Core0, RteMappedToTaskRef=Task5ms_Core0, RteUsedOsAlarmRef=Os/Rte_Al_TE_CpAp_FAWDemo_Core0_Runnable5ms_Core0
          TMT_Runnable1ms_Core0: RteEventRef=TMT_Runnable1ms_Core0, RteMappedToTaskRef=Task1ms_Core0, RteUsedOsAlarmRef=Os/Rte_Al_TE_CpAp_FAWDemo_Core0_Runnable1ms_Core0
          TMT_Runnable100ms_Core0: RteEventRef=TMT_Runnable100ms_Core0, RteMappedToTaskRef=Task100ms_Core0, RteUsedOsAlarmRef=Os/Rte_Al_TE_CpAp_FAWDemo_Core0_Runnable100ms_Core0
          TMT_Runnable20ms_Core0: RteEventRef=TMT_Runnable20ms_Core0, RteMappedToTaskRef=Task20ms_Core0, RteUsedOsAlarmRef=Os/Rte_Al_TE_CpAp_FAWDemo_Core0_Runnable20ms_Core0
          TMT_Runnable50ms_Core0: RteEventRef=TMT_Runnable50ms_Core0, RteMappedToTaskRef=Task50ms_Core0, RteUsedOsAlarmRef=Os/Rte_Al_TE_CpAp_FAWDemo_Core0_Runnable50ms_Core0
          TMT_Runnable1000ms_Core0: RteEventRef=TMT_Runnable1000ms_Core0, RteMappedToTaskRef=Task1000ms_Core0, RteUsedOsAlarmRef=Os/Rte_Al_TE_CpAp_FAWDemo_Core0_Runnable1000ms_Core0
          TMT_Runnable10ms_Core0: RteEventRef=TMT_Runnable10ms_Core0, RteMappedToTaskRef=Task10ms_Core0, RteUsedOsAlarmRef=Os/Rte_Al_TE_CpAp_FAWDemo_Core0_Runnable10ms_Core0
          TMT_Runnable500ms_Core0: RteEventRef=TMT_Runnable500ms_Core0, RteMappedToTaskRef=Task500ms_Core0, RteUsedOsAlarmRef=Os/Rte_Al_TE_CpAp_FAWDemo_Core0_Runnable500ms_Core0
      CpAp_FAWDemo_Core1_EcuSwComposition: RteSoftwareComponentInstanceRef=CpAp_FAWDemo_Core1
        9 x RteEventToTaskMapping, all with RteImmediateRestart=false, RtePositionInTask=0:
          TMT_Runnable200ms_Core1: RteEventRef=TMT_Runnable200ms_Core1, RteMappedToTaskRef=Task200ms_Core1, RteUsedOsAlarmRef=Os/Rte_Al_TE_CpAp_FAWDemo_Core1_Runnable200ms_Core1
          TMT_Runnable50ms_Core1: RteEventRef=TMT_Runnable50ms_Core1, RteMappedToTaskRef=Task50ms_Core1, RteUsedOsAlarmRef=Os/Rte_Al_TE_CpAp_FAWDemo_Core1_Runnable50ms_Core1
          TMT_Runnable20ms_Core1: RteEventRef=TMT_Runnable20ms_Core1, RteMappedToTaskRef=Task20ms_Core1, RteUsedOsAlarmRef=Os/Rte_Al_TE_CpAp_FAWDemo_Core1_Runnable20ms_Core1
          TMT_Runnable100ms_Core1: RteEventRef=TMT_Runnable100ms_Core1, RteMappedToTaskRef=Task100ms_Core1, RteUsedOsAlarmRef=Os/Rte_Al_TE_CpAp_FAWDemo_Core1_Runnable100ms_Core1
          TMT_Runnable10ms_Core1: RteEventRef=TMT_Runnable10ms_Core1, RteMappedToTaskRef=Task10ms_Core1, RteUsedOsAlarmRef=Os/Rte_Al_TE_CpAp_FAWDemo_Core1_Runnable10ms_Core1
          TMT_Runnable500ms_Core1: RteEventRef=TMT_Runnable500ms_Core1, RteMappedToTaskRef=Task500ms_Core1, RteUsedOsAlarmRef=Os/Rte_Al_TE_CpAp_FAWDemo_Core1_Runnable500ms_Core1
          TMT_Runnable1ms_Core1: RteEventRef=TMT_Runnable1ms_Core1, RteMappedToTaskRef=Task1ms_Core1, RteUsedOsAlarmRef=Os/Rte_Al_TE_CpAp_FAWDemo_Core1_Runnable1ms_Core1
          TMT_Runnable1000ms_Core1: RteEventRef=TMT_Runnable1000ms_Core1, RteMappedToTaskRef=Task1000ms_Core1, RteUsedOsAlarmRef=Os/Rte_Al_TE_CpAp_FAWDemo_Core1_Runnable1000ms_Core1
          TMT_Runnable5ms_Core1: RteEventRef=TMT_Runnable5ms_Core1, RteMappedToTaskRef=Task5ms_Core1, RteUsedOsAlarmRef=Os/Rte_Al_TE_CpAp_FAWDemo_Core1_Runnable5ms_Core1
      CpAp_FAWDemo_Core2_EcuSwComposition: RteSoftwareComponentInstanceRef=CpAp_FAWDemo_Core2
        9 x RteEventToTaskMapping, all with RteImmediateRestart=false, RtePositionInTask=0:
          TMT_Runnable200ms_Core2: RteEventRef=TMT_Runnable200ms_Core2, RteMappedToTaskRef=Task200ms_Core2, RteUsedOsAlarmRef=Os/Rte_Al_TE_CpAp_FAWDemo_Core2_Runnable200ms_Core2
          TMT_Runnable100ms_Core2: RteEventRef=TMT_Runnable100ms_Core2, RteMappedToTaskRef=Task100ms_Core2, RteUsedOsAlarmRef=Os/Rte_Al_TE_CpAp_FAWDemo_Core2_Runnable100ms_Core2
          TMT_Runnable10ms_Core2: RteEventRef=TMT_Runnable10ms_Core2, RteMappedToTaskRef=Task10ms_Core2, RteUsedOsAlarmRef=Os/Rte_Al_TE_CpAp_FAWDemo_Core2_Runnable10ms_Core2
          TMT_Runnable20ms_Core2: RteEventRef=TMT_Runnable20ms_Core2, RteMappedToTaskRef=Task20ms_Core2, RteUsedOsAlarmRef=Os/Rte_Al_TE_CpAp_FAWDemo_Core2_Runnable20ms_Core2
          TMT_Runnable50ms_Core2: RteEventRef=TMT_Runnable50ms_Core2, RteMappedToTaskRef=Task50ms_Core2, RteUsedOsAlarmRef=Os/Rte_Al_TE_CpAp_FAWDemo_Core2_Runnable50ms_Core2
          TMT_Runnable1ms_Core2: RteEventRef=TMT_Runnable1ms_Core2, RteMappedToTaskRef=Task1ms_Core2, RteUsedOsAlarmRef=Os/Rte_Al_TE_CpAp_FAWDemo_Core2_Runnable1ms_Core2
          TMT_Runnable500ms_Core2: RteEventRef=TMT_Runnable500ms_Core2, RteMappedToTaskRef=Task500ms_Core2, RteUsedOsAlarmRef=Os/Rte_Al_TE_CpAp_FAWDemo_Core2_Runnable500ms_Core2
          TMT_Runnable1000ms_Core2: RteEventRef=TMT_Runnable1000ms_Core2, RteMappedToTaskRef=Task1000ms_Core2, RteUsedOsAlarmRef=Os/Rte_Al_TE_CpAp_FAWDemo_Core2_Runnable1000ms_Core2
          TMT_Runnable5ms_Core2: RteEventRef=TMT_Runnable5ms_Core2, RteMappedToTaskRef=Task5ms_Core2, RteUsedOsAlarmRef=Os/Rte_Al_TE_CpAp_FAWDemo_Core2_Runnable5ms_Core2
    3 x RteSwComponentType:
      CtAp_FAWDemo_Core0: RteComponentTypeRef=CtAp_FAWDemo_Core0, RteImplementationRef=CtAp_FAWDemo_Core0_Implementation
        ComponentTypeCalibration (RteComponentTypeCalibration): RteCalibrationSupportEnabled=false
      CtAp_FAWDemo_Core2: RteComponentTypeRef=CtAp_FAWDemo_Core2, RteImplementationRef=CtAp_FAWDemo_Core2_Implementation
        ComponentTypeCalibration (RteComponentTypeCalibration): RteCalibrationSupportEnabled=false
      CtAp_FAWDemo_Core1: RteComponentTypeRef=CtAp_FAWDemo_Core1, RteImplementationRef=CtAp_FAWDemo_Core1_Implementation
        ComponentTypeCalibration (RteComponentTypeCalibration): RteCalibrationSupportEnabled=false
    3 x RteBswModuleInstance:
      Rte: RteBswImplementationRef=Rte_Impl, RteBswModuleConfigurationRef=Rte
        Rte_ComSendSignalProxyPeriodicTimingEvent0 (RteBswEventToTaskMapping): RteBswImmediateRestart=false, RteBswEventRef=Rte_ComSendSignalProxyPeriodicTimingEvent0
      Det: RteBswImplementationRef=Det_Impl, RteBswModuleConfigurationRef=Det
        DET_EXCLUSIVE_AREA_0 (RteBswExclusiveAreaImpl): RteExclusiveAreaImplMechanism=ALL_INTERRUPT_BLOCKING, RteBswExclusiveAreaRef=DET_EXCLUSIVE_AREA_0
      EcuM: RteBswImplementationRef=EcuM_Impl, RteBswModuleConfigurationRef=EcuM
        3 x RteBswExclusiveAreaImpl, all with RteExclusiveAreaImplMechanism=ALL_INTERRUPT_BLOCKING:
          ECUM_EXCLUSIVE_AREA_{0..2}: RteBswExclusiveAreaRef=ECUM_EXCLUSIVE_AREA_{0..2}
        3 x RteBswEventToTaskMapping, all with RteBswImmediateRestart=false:
          EcuM_MainFunctionTimingEvent0: RteBswPositionInTask=2, RteBswEventRef=EcuM_MainFunctionTimingEvent0, RteBswMappedToTaskRef=Os/TaskSchM_Core0, RteBswUsedOsAlarmRef=Os/Rte_Al_TE2_TaskSchM_Core0_0_10ms, RteBswUsedOsEventRef=Rte_Ev_Cyclic2_TaskSchM_Core0_0_10ms
          EcuM_MainFunctionTimingEvent1: RteBswPositionInTask=1, RteBswEventRef=EcuM_MainFunctionTimingEvent1, RteBswMappedToTaskRef=TaskSchM_Core1, RteBswUsedOsAlarmRef=Os/Rte_Al_TE2_EcuM_EcuM_MainFunction
          EcuM_MainFunctionTimingEvent2: RteBswPositionInTask=1, RteBswEventRef=EcuM_MainFunctionTimingEvent2, RteBswMappedToTaskRef=TaskSchM_Core2, RteBswUsedOsAlarmRef=Os/Rte_Al_TE3_EcuM_EcuM_MainFunction
    ComM_EcuSwComposition (RteSwComponentInstance): RteSoftwareComponentInstanceRef=ComM
      13 x RteEventToTaskMapping, all with RteImmediateRestart=false:
        Timer_ComM_MainFunction_0: RtePositionInTask=8, RteEventRef=Timer_ComM_MainFunction_0, RteMappedToTaskRef=Os/TaskSchM_Core0, RteUsedOsEventRef=Rte_Ev_Cyclic2_TaskSchM_Core0_0_20ms, RteUsedOsAlarmRef=Os/Rte_Al_TE2_TaskSchM_Core0_0_20ms
        OpEventGetInhibitionStatus_GetInhibitionStatus_CL_CN_CAN00_d9752b68: RteEventRef=OpEventGetInhibitionStatus_GetInhibitionStatus_CL_CN_CAN00_d9752b68
        OpEventGetInhibitionStatus_GetInhibitionStatus_CW_CN_CAN00_d9752b68: RteEventRef=OpEventGetInhibitionStatus_GetInhibitionStatus_CW_CN_CAN00_d9752b68
        OpEventLimitECUToNoComMode_LimitECUToNoComMode_modeLimitation: RteEventRef=OpEventLimitECUToNoComMode_LimitECUToNoComMode_modeLimitation
        OpEventReadInhibitCounter_ReadInhibitCounter_modeLimitation: RteEventRef=OpEventReadInhibitCounter_ReadInhibitCounter_modeLimitation
        OpEventResetInhibitCounter_ResetInhibitCounter_modeLimitation: RteEventRef=OpEventResetInhibitCounter_ResetInhibitCounter_modeLimitation
        OpEventSetECUGroupClassification_SetECUGroupClassification_modeLimitation: RteEventRef=OpEventSetECUGroupClassification_SetECUGroupClassification_modeLimitation
        OpEventLimitChannelToNoComMode_LimitChannelToNoComMode_CL_CN_CAN00_d9752b68: RteEventRef=OpEventLimitChannelToNoComMode_LimitChannelToNoComMode_CL_CN_CAN00_d9752b68
        OpEventPreventWakeUp_PreventWakeUp_CW_CN_CAN00_d9752b68: RteEventRef=OpEventPreventWakeUp_PreventWakeUp_CW_CN_CAN00_d9752b68
        OpEventRequestComMode_RequestComMode_UR_CN_CAN00_4124aacb: RteEventRef=OpEventRequestComMode_RequestComMode_UR_CN_CAN00_4124aacb
        OpEventGetCurrentComMode_GetCurrentComMode_UR_CN_CAN00_4124aacb: RteEventRef=OpEventGetCurrentComMode_GetCurrentComMode_UR_CN_CAN00_4124aacb
        OpEventGetMaxComMode_GetMaxComMode_UR_CN_CAN00_4124aacb: RteEventRef=OpEventGetMaxComMode_GetMaxComMode_UR_CN_CAN00_4124aacb
        OpEventGetRequestedComMode_GetRequestedComMode_UR_CN_CAN00_4124aacb: RteEventRef=OpEventGetRequestedComMode_GetRequestedComMode_UR_CN_CAN00_4124aacb
    6 x RteBswModuleInstance:
      Can: RteBswImplementationRef=Can_Impl, RteBswModuleConfigurationRef=Can
        3 x RteBswEventToTaskMapping, all with RteBswImmediateRestart=false, RteBswMappedToTaskRef=Os/TaskSchM_Core0, RteBswUsedOsEventRef=Rte_Ev_Cyclic2_TaskSchM_Core0_0_10ms, RteBswUsedOsAlarmRef=Os/Rte_Al_TE2_TaskSchM_Core0_0_10ms:
          Can_MainFunction_BusOffTimingEvent0: RteBswPositionInTask=5, RteBswEventRef=Can_MainFunction_BusOffTimingEvent0
          Can_MainFunction_WakeupTimingEvent0: RteBswPositionInTask=7, RteBswEventRef=Can_MainFunction_WakeupTimingEvent0
          Can_MainFunction_ModeTimingEvent0: RteBswPositionInTask=6, RteBswEventRef=Can_MainFunction_ModeTimingEvent0
        7 x RteBswExclusiveAreaImpl, all with RteExclusiveAreaImplMechanism=ALL_INTERRUPT_BLOCKING:
          CAN_EXCLUSIVE_AREA_{0..6}: RteBswExclusiveAreaRef=CAN_EXCLUSIVE_AREA_{0..6}
      CanIf: RteBswImplementationRef=CanIf_Impl, RteBswModuleConfigurationRef=CanIf
        8 x RteBswExclusiveAreaImpl, all with RteExclusiveAreaImplMechanism=ALL_INTERRUPT_BLOCKING:
          CANIF_EXCLUSIVE_AREA_{0..7}: RteBswExclusiveAreaRef=CANIF_EXCLUSIVE_AREA_{0..7}
      CanSM: RteBswImplementationRef=CanSM_Impl, RteBswModuleConfigurationRef=CanSM
        CanSM_MainFunctionTimingEvent0 (RteBswEventToTaskMapping):
          RteBswImmediateRestart = false
          RteBswPositionInTask = 4
          RteBswEventRef = CanSM_MainFunctionTimingEvent0
          RteBswMappedToTaskRef = Os/TaskSchM_Core0
          RteBswUsedOsEventRef = Rte_Ev_Cyclic2_TaskSchM_Core0_0_10ms
          RteBswUsedOsAlarmRef = Os/Rte_Al_TE2_TaskSchM_Core0_0_10ms
        6 x RteBswExclusiveAreaImpl, all with RteExclusiveAreaImplMechanism=ALL_INTERRUPT_BLOCKING:
          CANSM_EXCLUSIVE_AREA_{1..6}: RteBswExclusiveAreaRef=CANSM_EXCLUSIVE_AREA_{1..6}
      Com: RteBswImplementationRef=Com_Impl, RteBswModuleConfigurationRef=Com
        Com_MainFunctionTxTimingEvent0 (RteBswEventToTaskMapping):
          RteBswImmediateRestart = false
          RteBswPositionInTask = 10
          RteBswEventRef = Com_MainFunctionTxTimingEvent0
          RteBswMappedToTaskRef = Os/TaskSchM_Core0
          RteBswUsedOsEventRef = Rte_Ev_Cyclic2_TaskSchM_Core0_0_10ms
          RteBswUsedOsAlarmRef = Os/Rte_Al_TE2_TaskSchM_Core0_0_10ms
        Com_MainFunctionRxTimingEvent0 (RteBswEventToTaskMapping):
          RteBswImmediateRestart = false
          RteBswPositionInTask = 9
          RteBswEventRef = Com_MainFunctionRxTimingEvent0
          RteBswMappedToTaskRef = Os/TaskSchM_Core0
          RteBswUsedOsEventRef = Rte_Ev_Cyclic2_TaskSchM_Core0_0_10ms
          RteBswUsedOsAlarmRef = Os/Rte_Al_TE2_TaskSchM_Core0_0_10ms
        3 x RteBswExclusiveAreaImpl, all with RteExclusiveAreaImplMechanism=ALL_INTERRUPT_BLOCKING:
          COM_EXCLUSIVE_AREA_TX: RteBswExclusiveAreaRef=COM_EXCLUSIVE_AREA_TX
          COM_EXCLUSIVE_AREA_RX: RteBswExclusiveAreaRef=COM_EXCLUSIVE_AREA_RX
          COM_EXCLUSIVE_AREA_BOTH: RteBswExclusiveAreaRef=COM_EXCLUSIVE_AREA_BOTH
      ComM: RteBswImplementationRef=ComM_Impl, RteBswModuleConfigurationRef=ComM
        ComM_MainFunction_0TimingEvent0 (RteBswEventToTaskMapping):
          RteBswImmediateRestart = false
          RteBswPositionInTask = 8
          RteBswEventRef = ComM_MainFunction_0TimingEvent0
          RteBswMappedToTaskRef = Os/TaskSchM_Core0
          RteBswUsedOsEventRef = Rte_Ev_Cyclic2_TaskSchM_Core0_0_20ms
          RteBswUsedOsAlarmRef = Os/Rte_Al_TE2_TaskSchM_Core0_0_20ms
        COMM_EXCLUSIVE_AREA_0 (RteBswExclusiveAreaImpl): RteExclusiveAreaImplMechanism=ALL_INTERRUPT_BLOCKING, RteBswExclusiveAreaRef=COMM_EXCLUSIVE_AREA_0
        COMM_EXCLUSIVE_AREA_1 (RteBswExclusiveAreaImpl): RteExclusiveAreaImplMechanism=ALL_INTERRUPT_BLOCKING, RteBswExclusiveAreaRef=COMM_EXCLUSIVE_AREA_1
      PduR: RteBswImplementationRef=PduR_Impl, RteBswModuleConfigurationRef=PduR
        PDUR_EXCLUSIVE_AREA_0 (RteBswExclusiveAreaImpl): RteExclusiveAreaImplMechanism=ALL_INTERRUPT_BLOCKING, RteBswExclusiveAreaRef=PDUR_EXCLUSIVE_AREA_0
  module config Mcu: implementation-config-variant=VARIANT-PRE-COMPILE
    McuGeneralConfiguration: McuDevErrorDetect=false, McuGetRamStateApi=false, McuInitClock=true, McuNoPll=true, McuPerformResetApi=false, McuVersionInfoApi=false
    McuModuleConfiguration: McuClockSrcFailureNotification=DISABLED, McuNumberOfMcuModes=1, McuRamSectors=1
      McuClockSettingConfig: McuClockSettingId=1
        McuClockReferencePoint: McuClockReferencePointFrequency=20000000
      McuModeSettingConf: McuMode=1
    McuPublishedInformation
      McuResetReasonConf: McuResetReason=0
  module config Com: implementation-config-variant=VARIANT-PRE-COMPILE, module-description=Com_Impl
    ComGeneration:
      ComOutOfBoundsWriteProtectionStrategy = NONE
      ComOutOfBoundsWriteSanitizer = false
      ComOutOfBoundsReadSanitizer = false
      ComReduceConstantData2Define = false
      ComBoolDataInArrayOfStructStrategy = BOOLEAN
      ComDeduplicateIndirectedData = true
      ComDataDeduplicationStrategy = WITH_CAST
      ComReduceBoolDataByNegationThreshold = 2
      ComReduceBoolDataByNumericalComparisonThreshold = 2
      ComReduceBoolDataByNumericalRelationThreshold = 2
      ComReduceBoolDataByNumericalOperandStrategy = WITH_ANY_VALUE
      ComReduceNumericalDataByOffsetThreshold = 2
      ComReduceNumericalDataByArraySubtractionThreshold = 2
      ComReduceDataByStreaming = false
      ComShortSymbols = false
      ComInterfacesForDeactivatedData = false
      ComReferringKeysInComments = false
    ComOptimization:
      ComTxCyclicProcessingISRLockThreshold = 1
      ComTxDeadlineMonitoringISRLockThreshold = 1
      ComTxProcessingISRLockThreshold = 1
      ComRxDeadlineMonitoringISRLockThreshold = 1
      ComRxDeferredProcessingISRLockThreshold = 1
      ComGatewayProcessingISRLockThreshold = 1
      ComGatewayDescriptionProcessingISRLockThreshold = 1
      ComIPduGroupISRLockThreshold = 1
    ComConfig: ComConfigurationId=0, ComRxDeferredNotificationCacheSize=0, ComRxImmediateNotificationCacheSize=0
      ComTimeBase: ComRxTimeBase=0.01, ComTxTimeBase=0.01, ComGwTimeBase=0.01
      T1_RxMsg_oCAN00_c2c93374_Rx (ComIPdu):
        ComIPduDirection = RECEIVE
        ComIPduType = NORMAL
        ComIPduHandleId = 0
        ComIPduSignalProcessing = DEFERRED
        ComIPduCancellationSupport = false
        ComIPduCallout = T1_AppReceive
        ComIPduGroupRef = iECU_oCAN00_Rx_a30130d6
        ComIPduSignalRef = New_Signal_7_oT1_RxMsg_oCAN00_8f249b77_Rx
        ComPduIdRef = EcucPduCollection/T1_RxMsg_oCAN00_c2c93374_Rx
      iECU_oCAN00_Tx_f55b9750 (ComIPduGroup): ComIPduGroupHandleId=1
      New_Signal_6_oT1_TxMsg_oCAN00_8f4b8876_Tx (ComSignal):
        ComBitPosition = 0
        ComBitSize = 8
        ComSignalEndianness = LITTLE_ENDIAN
        ComSignalInitValue = 0
        ComSignalType = SINT8
        ComTransferProperty = PENDING
        ComSignalAccess = ACCESS_UNCLEAR
        ComHandleId = 0
        ComSystemTemplateSystemSignalRef = New_Signal_6
      New_Signal_7_oT1_RxMsg_oCAN00_8f249b77_Rx (ComSignal):
        ComBitPosition = 0
        ComBitSize = 8
        ComSignalEndianness = LITTLE_ENDIAN
        ComSignalInitValue = 1
        ComSignalType = SINT8
        ComSignalAccess = ACCESS_UNCLEAR
        ComHandleId = 0
        ComSystemTemplateSystemSignalRef = New_Signal_7
      T1_TxMsg_oCAN00_2df49694_Tx (ComIPdu):
        ComIPduDirection = SEND
        ComIPduType = NORMAL
        ComIPduHandleId = 0
        ComIPduSignalProcessing = DEFERRED
        ComIPduCancellationSupport = false
        ComIPduGroupRef = iECU_oCAN00_Tx_f55b9750
        ComIPduSignalRef = New_Signal_6_oT1_TxMsg_oCAN00_8f4b8876_Tx
        ComPduIdRef = EcucPduCollection/T1_TxMsg_oCAN00_2df49694_Tx
        ComTxIPdu: ComMinimumDelayTime=0, ComTxIPduUnusedAreasDefault=0
          ComTxModeTrue
            ComTxMode: ComTxModeMode=NONE, ComTxModeTimeOffset=0, ComTxModeTimePeriod=0
          ComTxModeFalse
            ComTxMode: ComTxModeMode=NONE, ComTxModeTimeOffset=0, ComTxModeTimePeriod=0
      iECU_oCAN00_Rx_a30130d6 (ComIPduGroup): ComIPduGroupHandleId=0
    ComGeneral:
      ComConfigurationUseDet = true
      ComEnableSignalGroupArrayApi = false
      ComRetryFailedTransmitRequests = true
      ComSupportedIPduGroups = 2
      ComVersionInfoApi = false
      ComAdvancedIPduCallouts = true
      ComOptimizedIPduGroupHandling = false
      ComMetaDataSupport = false
      ComReceiveSignalMacroAPI = false
      ComDeferredEventCacheSupport = false
      ComMainfunctionTimingDomainSupport = false
      ComDescriptionRoutingCodeGeneration = false
      ComSafeBswChecks = false
  module config ComM: implementation-config-variant=VARIANT-PRE-COMPILE, module-description=ComM_Impl
    ComMGeneral:
      ComMPncIdCounting = COMM_PNC_ID_COUNT_FROM_NM_MESSAGE
      ComMPncSupport = false
      ComMDevErrorDetect = true
      ComMEcuGroupClassification = 3
      ComMModeLimitationEnabled = false
      ComMSynchronousWakeUp = true
      ComMTMinFullComModeDuration = 5
      ComMVersionInfoApi = false
      ComMWakeupInhibitionEnabled = false
      ComMSafeBswChecks = false
      ComMGeneration: ComMOutOfBoundsWriteSanitizer=false, ComMOutOfBoundsReadSanitizer=false
    ComMConfigSet: ComMPncEnabled=false
      CN_CAN00_d9752b68 (ComMChannel):
        ComMBusType = COMM_BUS_TYPE_CAN
        ComMChannelId = 0
        ComMFullCommRequestNotificationEnabled = false
        ComMMainFunctionPeriod = 0.02
        ComMNoCom = false
        ComMNoWakeup = false
        ComMNetworkManagement: ComMNmVariant=NONE, ComMPncNmRequest=false
        CN_CAN00_3ca23bd8 (ComMUserPerChannel): ComMUserChannel=CN_CAN00_4124aacb
      CN_CAN00_4124aacb (ComMUser): ComMUserIdentifier=0, ComMUserModeNotification=false
  module config CanIf: implementation-config-variant=VARIANT-PRE-COMPILE, module-description=CanIf_Impl
    CanIfCtrlDrvCfg_7d254554 (CanIfCtrlDrvCfg): CanIfCtrlDrvTxCancellation=false, CanIfCtrlDrvInitHohConfigRef=CanIfInitHohCfg, CanIfCtrlDrvNameRef=CanGeneral
      CT_CAN00_1adbe8e8 (CanIfCtrlCfg): CanIfCtrlId=0, CanIfCtrlWakeupSupport=false, CanIfCtrlJ1939DynAddrSupport=DISABLED, CanIfCtrlCanCtrlRef=CanConfigSet/CT_CAN00_1adbe8e8
    CanIfDispatchCfg:
      CanIfDispatchUserCtrlBusOffName = CanSM_ControllerBusOff
      CanIfDispatchUserCtrlBusOffUL = CAN_SM
      CanIfDispatchUserCtrlModeIndicationName = CanSM_ControllerModeIndication
      CanIfDispatchUserCtrlModeIndicationUL = CAN_SM
    CanIfInitCfg
      T1_RxMsg_oCAN00_639ed0f2_Rx (CanIfRxPduCfg):
        CanIfRxPduCanId = 1995
        CanIfRxPduCanIdType = STANDARD_CAN
        CanIfRxPduDlc = 8
        CanIfRxPduUserRxIndicationName = PduR_CanIfRxIndication
        CanIfRxPduUserRxIndicationUL = PDUR
        CanIfRxPduId = 0
        CanIfRxPduReadData = false
        CanIfRxPduReadNotifyStatus = false
        CanIfRxPduDlcCheck = true
        CanIfRxPduHrhIdRef = CanIfInitHohCfg/CN_CAN00_30c2e17c_Rx
        CanIfRxPduRef = EcucPduCollection/T1_RxMsg_oCAN00_53752368_Rx
      CHNL_0fb271d2 (CanIfBufferCfg):
        CanIfBufferSize = 1
        CanIfTxBufferHandlingType = PRIO_BY_CANID
        CanIfTxBufferMappedTxPdus = 1
        CanIfTxBufferMaxPduLength = 8
        CanIfBufferHthRef = CanIfInitHohCfg/CN_CAN00_d9752b68_Tx
      CanIfInitHohCfg: CanIfInitRefCfgSet=CanConfigSet
        CN_CAN00_d9752b68_Tx (CanIfHthCfg): CanIfHthCanCtrlIdRef=CanIfCtrlDrvCfg_7d254554/CT_CAN00_1adbe8e8, CanIfHthIdSymRef=CanConfigSet/CN_CAN00_d9752b68_Tx
        CN_CAN00_30c2e17c_Rx (CanIfHrhCfg): CanIfHrhSoftwareFilter=true, CanIfHrhCanCtrlIdRef=CanIfCtrlDrvCfg_7d254554/CT_CAN00_1adbe8e8, CanIfHrhIdSymRef=CanConfigSet/CN_CAN00_30c2e17c_Rx
      T1_TxMsg_oCAN00_102eb41e_Tx (CanIfTxPduCfg):
        CanIfTxPduCanId = 2042
        CanIfTxPduCanIdType = STANDARD_CAN
        CanIfTxPduDlc = 8
        CanIfTxPduUserTxConfirmationName = NULL_PTR
        CanIfTxPduUserTxConfirmationUL = NONE
        CanIfTxPduId = 0
        CanIfTxPduReadNotifyStatus = false
        CanIfTxPduType = STATIC
        CanIfTxPduBufferRef = CanIfInitCfg/CHNL_0fb271d2
        CanIfTxPduRef = EcucPduCollection/T1_TxMsg_oCAN00_ef2c7eaf_Tx
    CanIfPrivateCfg:
      CanIfPrivateSoftwareFilterType = LINEAR
      CanIfPrivateDlcCheck = true
      CanIfSupportTTCAN = false
      CanIfTransceiverMapping = false
      CanIfTransceiverHandling = false
      CanIfSupportExtendedIds = false
      CanIfSupportNmOsek = false
      CanIfTxBufferType = BYTE_QUEUE
      CanIfOptimizeOneController = true
      CanIfWakeupSupport = false
      CanIfStaticFdTxBufferSupport = false
      CanIfRxSearchConsiderMsgType = false
      CanIfMultipleBasicCANTxObjects = false
      CanIfTxBufferFifoSupport = false
      CanIfSetPduReceptionModeSupport = false
      CanIfDataChecksumRxSupport = false
      CanIfDataChecksumTxSupport = false
    CanIfPublicCfg:
      CanIfPublicPnSupport = false
      CanIfPublicCancelTransmitSupport = false
      CanIfPublicDevErrorDetect = true
      CanIfPublicHandleTypeEnum = UINT8
      CanIfPublicMultipleDrvSupport = false
      CanIfPublicNumberOfCanHwUnits = 1
      CanIfPublicReadRxPduDataApi = false
      CanIfPublicReadRxPduNotifyStatusApi = false
      CanIfPublicReadTxPduNotifyStatusApi = false
      CanIfPublicSetDynamicTxIdApi = false
      CanIfPublicTxBuffering = true
      CanIfPublicTxConfirmPollingSupport = false
      CanIfPublicVersionInfoApi = false
      CanIfPublicWakeupCheckValidSupport = false
      CanIfPnWakeupTxPduFilterSupport = false
      CanIfPnTrcvHandlingSupport = false
      CanIfJ1939DynAddrSupport = DISABLED
      CanIfSafeBswChecks = false
      CanIfSetBaudrateApi = false
  module config Can: implementation-config-variant=VARIANT-PRE-COMPILE, module-description=Can_Impl
    CanConfigSet
      CT_CAN00_1adbe8e8 (CanController):
        CanControllerActivation = true
        CanBusoffProcessing = INTERRUPT
        CanControllerBaseAddress = 4026630656
        CanControllerId = 0
        CanRxProcessing = INTERRUPT
        CanTxProcessing = INTERRUPT
        CanWakeupProcessing = INTERRUPT
        CanWakeupSupport = false
        CanWakeupSourceId = 0
        CanPhysicalNode = Node0
        CanIOPort = b_001
        CanInterruptPriority = 10
        CanSRC = 0
        CanChannelCanObjectStartIndex = 0
        CanNumberOfCANObj = 7
        CanSrcTos = CPU0
        CanInterruptGroupPriority = 0
        CanClockFrequency = 20000000
        CanControllerDefaultBaudrate = CanControllerBaudrateConfig
        CanControllerSystemRef = CT_CAN00
        CanWakeupSourceRef = EcuMCommonConfiguration/CN_CAN00_d9752b68
        CanCpuClockRef = McuClockReferencePoint
        CanControllerBaudrateConfig:
          CanControllerBaudRate = 500
          CanControllerBaudRateConfigID = 0
          CanControllerPropSeg = 3
          CanControllerSeg1 = 2
          CanControllerSeg2 = 2
          CanControllerSyncJumpWidth = 1
          CanBaudrateClock = 20000
          CanBaudratePrescaler = 5
          CanBaudrateDiv8 = false
        CanFilterMask: CanFilterMaskValue=0, CanFilterCodeValue=0, IsLocked=false
      CN_CAN00_d9752b68_Tx (CanHardwareObject):
        CanHandleType = BASIC
        CanIdValue = 0
        CanObjectType = TRANSMIT
        CanIdType = STANDARD
        CanObjectId = 0
        CanHwProcessing = false
        CanObjectHwSize = 1
        CanObjectHwHandle = 0
        CanMaxDataLen = 8
        CanFdPaddingValue = 0
        CanObjectMultiplexedTransmission = false
        CanControllerRef = CanConfigSet/CT_CAN00_1adbe8e8
      CN_CAN00_30c2e17c_Rx (CanHardwareObject):
        CanHandleType = BASIC
        CanIdType = STANDARD
        CanIdValue = 0
        CanObjectType = RECEIVE
        CanObjectId = 1
        CanHwProcessing = false
        CanObjectHwSize = 2
        CanObjectHwHandle = 1
        CanMaxDataLen = 8
        CanFdPaddingValue = 0
        CanObjectMultiplexedTransmission = false
        CanControllerRef = CanConfigSet/CT_CAN00_1adbe8e8
        CanFilterMaskRef = CanFilterMask
    CanGeneral:
      CanIndex = 0
      CanChangeBaudrateApi = false
      CanDevErrorDetection = true
      CanHardwareCancellation = false
      CanIdenticalIdCancellation = false
      CanMainFunctionBusoffPeriod = 0.01
      CanMainFunctionModePeriod = 0.01
      CanMainFunctionWakeupPeriod = 0.01
      CanMultiplexedTransmission = false
      CanSetBaudrateApi = false
      CanTimeoutDuration = 0.01
      CanVersionInfoApi = false
      CanGenericPrecopy = false
      CanHardwareLoopCheck = true
      CanSecureTempBuffer = false
      CanRxFullCANSupport = false
      CanTxFullCANSupport = false
      CanRxBasicCANSupport = true
      CanUseNestedCANInterrupts = false
      CanHardwareCancelByAppl = false
      CanIndividualProcessing = false
      CanGenericConfirmation = false
      CanRxQueue = false
      CanSupportMixedID = false
      CanRxQueueSize = 10
      CanMultipleBasicCANObjects = false
      CanMultipleBasicCANTxObjects = false
      CanHardwareHandleType = UINT8
      CanOptimizeOneController = true
      CanInterruptCategory = CATEGORY2
      CanGetStatus = false
      CanInterruptLock = DRIVER
      CanWakeupSupport = false
      CanRamCheck = None
      CanOverrunNotification = DET
      CanReinitStart = false
      CanGenericPreTransmit = false
      CanFdSupport = NONE
      CanRuntimeMeasurementSupport = false
      CanMaxRxDataLen = 8
      CanMaxTxDataLen = 8
      CanUsePeripheralAccessApi = false
      CanEnableMultipleCanDriver = false
      CanMaxNumberOfHwCANChannels = 4
      CanMaxNumberOfHwCANChannelsR = 2
      CanMaxNumberOfHwCANObj = 256
      CanMaxNumberOfHwCANObjR = 128
      CanClockDividerMode = NORMAL
      CanClockDivider = 1
      CanBaseAddress = 4026630144
      CanBaseAddressR = 4026695680
      CanSrcAddress = 4026763520
      CanSrcAddressR = 4026763584
      CanClockSourceSelection = Fosc
      CanFreezeDisable = false
      CanMirrorModeSupport = false
      CanUseOsInterruptControl = true
      CanRxHwFiFoFullNotification = false
      CanFdIsoSupport = false
      CanFdNiso = false
      CanFdPed = false
      CanSilentModeSupport = false
      CanSafeBswChecks = false
      CanCounterRef = SystemTimer_Core0
      CanMainFunctionRWPeriods
  module config PduR: implementation-config-variant=VARIANT-PRE-COMPILE, module-description=PduR_Impl
    PduRGeneral:
      PduRDevErrorDetect = true
      PduRVersionInfoApi = false
      PduRMetaDataSupport = false
      PduRPduCallback = false
      PduRSwitching = false
      PduRSafeBswChecks = false
      PduREnableDeferredTransmission = false
      PduREnableDeferredReception = false
      PduRGeneration:
        PduROutOfBoundsWriteProtectionStrategy = NONE
        PduROutOfBoundsWriteSanitizer = false
        PduROutOfBoundsReadSanitizer = false
        PduRNumericalDataTypeMinimizationStrategy = WITH_CAST
        PduRReduceConstantData2Define = false
        PduRBoolDataInArrayOfStructStrategy = BITMASKING
        PduRDeduplicateIndirectedData = true
        PduRDataDeduplicationStrategy = WITH_CAST
        PduRReduceBoolDataByNegationThreshold = 2
        PduRReduceBoolDataByNumericalComparisonThreshold = 2
        PduRReduceBoolDataByNumericalRelationThreshold = 2
        PduRReduceBoolDataByNumericalOperandStrategy = WITH_ANY_VALUE
        PduRReduceNumericalDataByOffsetThreshold = 2
        PduRReduceNumericalDataByArraySubtractionThreshold = 2
        PduRReduceDataByStreaming = false
        PduRShortSymbols = false
        PduRInterfacesForDeactivatedData = false
        PduRReferringKeysInComments = false
    PduRRoutingTables: PduRConfigurationId=0
      PduRRoutingTable
        T1_RxMsg_oCAN00_53752368_Rx (PduRRoutingPath): PduRRoutingPathCommunicationType=COMMUNICATION_INTERFACE
          PduRSrcPdu_ab1b6f5d (PduRSrcPdu):
            PduRSourcePduHandleId = 0
            PduRSrcPduDirection = RECEIVE
            PduRSrcPduRef = EcucPduCollection/T1_RxMsg_oCAN00_53752368_Rx
            PduRSrcPduPduRBswModulesRef = PduR/CanIf
          T1_RxMsg_oCAN00_53752368_Rx_ab1b6f5d_Rx (PduRDestPdu):
            PduRDestPduHandleId = 0
            PduRDestPduDirection = RECEIVE
            PduRDestPduRoutingType = API_FORWARDING
            PduRDestPduDataProcessing = IMMEDIATE
            PduRPduLengthHandlingStrategy = UNUSED
            PduRTransmissionConfirmation = false
            PduRDestPduRef = EcucPduCollection/T1_RxMsg_oCAN00_c2c93374_Rx
            PduRDestPduPduRBswModulesRef = PduR/Com
        T1_TxMsg_oCAN00_2df49694_Tx (PduRRoutingPath): PduRRoutingPathCommunicationType=COMMUNICATION_INTERFACE
          T1_TxMsg_oCAN00_ef2c7eaf_Tx (PduRDestPdu):
            PduRDestPduHandleId = 0
            PduRDestPduDirection = TRANSMIT
            PduRDestPduRoutingType = API_FORWARDING
            PduRDestPduDataProcessing = IMMEDIATE
            PduRPduLengthHandlingStrategy = UNUSED
            PduRDestPduDataProvision = PDUR_DIRECT
            PduRTransmissionConfirmation = false
            PduRDestPduRef = EcucPduCollection/T1_TxMsg_oCAN00_ef2c7eaf_Tx
            PduRDestPduPduRBswModulesRef = PduR/CanIf
          PduRSrcPdu_0c40aab2 (PduRSrcPdu):
            PduRSourcePduHandleId = 0
            PduRSrcPduDirection = TRANSMIT
            PduRSrcPduRef = EcucPduCollection/T1_TxMsg_oCAN00_2df49694_Tx
            PduRSrcPduPduRBswModulesRef = PduR/Com
    CanIf (PduRBswModules):
      PduRCancelReceive = false
      PduRCancelTransmit = false
      PduRChangeParameterRequestApi = false
      PduRCommunicationInterface = true
      PduRLowerModule = true
      PduRTransportProtocol = false
      PduRTriggertransmit = false
      PduRTxConfirmation = false
      PduRUpperModule = false
      PduRUseTag = false
      PduRBswModuleRef = CanIf
    Com (PduRBswModules):
      PduRCancelReceive = false
      PduRCancelTransmit = false
      PduRChangeParameterRequestApi = false
      PduRCommunicationInterface = true
      PduRLowerModule = false
      PduRTransportProtocol = false
      PduRTriggertransmit = false
      PduRTxConfirmation = false
      PduRUpperModule = true
      PduRUseTag = false
      PduRBswModuleRef = Com
  module config CanSM: implementation-config-variant=VARIANT-PRE-COMPILE, module-description=CanSM_Impl
    CanSMConfiguration: CanSMModeRequestRepetitionMax=10, CanSMModeRequestRepetitionTime=0.1
      CHNL_0fb271d2 (CanSMManagerNetwork):
        CanSMBorCounterL1ToL2 = 5
        CanSMBorTimeL1 = 1
        CanSMBorTimeL2 = 3
        CanSMBorTimeTxEnsured = 5
        CanSMBorTxConfirmationPolling = false
        CanSMComMNetworkHandleRef = ComMConfigSet/CN_CAN00_d9752b68
        CT_CAN00_b0339efb (CanSMController): CanSMControllerId=CanIfCtrlDrvCfg_7d254554/CT_CAN00_1adbe8e8
    CanSMGeneral: CanSMDevErrorDetect=true, CanSMMainFunctionTimePeriod=0.01, CanSMVersionInfoApi=false, CanSMBorCheckLevel=false, CanSMSetBaudrateApi=false
      CanSMGeneration: CanSMOutOfBoundsWriteSanitizer=false, CanSMOutOfBoundsReadSanitizer=false
