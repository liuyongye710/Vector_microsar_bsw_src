AUTOSAR XML (schema 4-2-1)
package /InitialEcuC
  ecuc value collection InitialEcuC: ecuc-values=[Can, CanIf, CanSM, Com, ComM, EcuC, EcuM, PduR]
  module config Can
    CanConfigSet
      CT_CAN00_1adbe8e8 (CanController):
        CanControllerActivation = true
        CanControllerDefaultBaudrate = CanControllerBaudrateConfig
        CanControllerSystemRef = CT_CAN00
        CanWakeupSourceRef = EcuMCommonConfiguration/CN_CAN00_d9752b68
        CanControllerBaudrateConfig
      CN_CAN00_30c2e17c_Rx (CanHardwareObject): CanHandleType=BASIC, CanIdType=STANDARD, CanIdValue=0, CanObjectType=RECEIVE, CanControllerRef=CanConfigSet/CT_CAN00_1adbe8e8
      CN_CAN00_d9752b68_Tx (CanHardwareObject): CanHandleType=BASIC, CanIdValue=0, CanObjectType=TRANSMIT, CanControllerRef=CanConfigSet/CT_CAN00_1adbe8e8
    CanGeneral: CanIndex=0
  module config CanIf
    CanIfCtrlDrvCfg_7d254554 (CanIfCtrlDrvCfg): CanIfCtrlDrvInitHohConfigRef=CanIfInitHohCfg, CanIfCtrlDrvNameRef=CanGeneral
      CT_CAN00_1adbe8e8 (CanIfCtrlCfg): CanIfCtrlCanCtrlRef=CanConfigSet/CT_CAN00_1adbe8e8
    CanIfInitCfg
      CHNL_0fb271d2 (CanIfBufferCfg): CanIfBufferSize=0, CanIfBufferHthRef=CanIfInitHohCfg/CN_CAN00_d9752b68_Tx
      CanIfInitHohCfg: CanIfInitRefCfgSet=CanConfigSet
        CN_CAN00_30c2e17c_Rx (CanIfHrhCfg): CanIfHrhCanCtrlIdRef=CanIfCtrlDrvCfg_7d254554/CT_CAN00_1adbe8e8, CanIfHrhIdSymRef=CanConfigSet/CN_CAN00_30c2e17c_Rx
        CN_CAN00_d9752b68_Tx (CanIfHthCfg): CanIfHthCanCtrlIdRef=CanIfCtrlDrvCfg_7d254554/CT_CAN00_1adbe8e8, CanIfHthIdSymRef=CanConfigSet/CN_CAN00_d9752b68_Tx
      T1_RxMsg_oCAN00_639ed0f2_Rx (CanIfRxPduCfg):
        CanIfRxPduCanId = 1995
        CanIfRxPduCanIdType = STANDARD_CAN
        CanIfRxPduDlc = 8
        CanIfRxPduUserRxIndicationName = PduR_CanIfRxIndication
        CanIfRxPduUserRxIndicationUL = PDUR
        CanIfRxPduHrhIdRef = CanIfInitHohCfg/CN_CAN00_30c2e17c_Rx
        CanIfRxPduRef = EcucPduCollection/T1_RxMsg_oCAN00_53752368_Rx
      T1_TxMsg_oCAN00_102eb41e_Tx (CanIfTxPduCfg):
        CanIfTxPduCanId = 2042
        CanIfTxPduCanIdType = STANDARD_CAN
        CanIfTxPduDlc = 8
        CanIfTxPduUserTxConfirmationName = PduR_CanIfTxConfirmation
        CanIfTxPduUserTxConfirmationUL = PDUR
        CanIfTxPduBufferRef = CanIfInitCfg/CHNL_0fb271d2
        CanIfTxPduRef = EcucPduCollection/T1_TxMsg_oCAN00_ef2c7eaf_Tx
    CanIfPrivateCfg: CanIfPrivateSoftwareFilterType=LINEAR
    CanIfPublicCfg: CanIfPublicPnSupport=false
  module config CanSM
    CanSMConfiguration
      CHNL_0fb271d2 (CanSMManagerNetwork): CanSMComMNetworkHandleRef=ComMConfigSet/CN_CAN00_d9752b68
        CT_CAN00_b0339efb (CanSMController): CanSMControllerId=CanIfCtrlDrvCfg_7d254554/CT_CAN00_1adbe8e8
  module config Com
    ComConfig
      T1_RxMsg_oCAN00_c2c93374_Rx (ComIPdu):
        ComIPduDirection = RECEIVE
        ComIPduType = NORMAL
        ComIPduGroupRef = iECU_oCAN00_Rx_a30130d6
        ComIPduSignalRef = New_Signal_7_oT1_RxMsg_oCAN00_8f249b77_Rx
        ComPduIdRef = EcucPduCollection/T1_RxMsg_oCAN00_c2c93374_Rx
      T1_TxMsg_oCAN00_2df49694_Tx (ComIPdu):
        ComIPduDirection = SEND
        ComIPduType = NORMAL
        ComIPduGroupRef = iECU_oCAN00_Tx_f55b9750
        ComIPduSignalRef = New_Signal_6_oT1_TxMsg_oCAN00_8f4b8876_Tx
        ComPduIdRef = EcucPduCollection/T1_TxMsg_oCAN00_2df49694_Tx
        ComTxIPdu: ComMinimumDelayTime=0, ComTxIPduUnusedAreasDefault=0
          ComTxModeFalse
            ComTxMode: ComTxModeMode=PERIODIC, ComTxModeTimeOffset=0, ComTxModeTimePeriod=0
          ComTxModeTrue
            ComTxMode: ComTxModeMode=PERIODIC, ComTxModeTimeOffset=0, ComTxModeTimePeriod=0
      iECU_oCAN00_Rx_a30130d6 (ComIPduGroup)
      iECU_oCAN00_Tx_f55b9750 (ComIPduGroup)
      New_Signal_6_oT1_TxMsg_oCAN00_8f4b8876_Tx (ComSignal):
        ComBitPosition = 0
        ComBitSize = 8
        ComSignalEndianness = LITTLE_ENDIAN
        ComSignalInitValue = 0
        ComSignalType = SINT8
        ComTransferProperty = PENDING
        ComSystemTemplateSystemSignalRef = New_Signal_6
      New_Signal_7_oT1_RxMsg_oCAN00_8f249b77_Rx (ComSignal):
        ComBitPosition = 0
        ComBitSize = 8
        ComSignalEndianness = LITTLE_ENDIAN
        ComSignalInitValue = 1
        ComSignalType = SINT8
        ComSystemTemplateSystemSignalRef = New_Signal_7
    ComGeneral
  module config ComM
    ComMConfigSet: ComMPncEnabled=false
      CN_CAN00_d9752b68 (ComMChannel): ComMBusType=COMM_BUS_TYPE_CAN, ComMChannelId=0
        ComMNetworkManagement: ComMNmVariant=NONE
        CN_CAN00_3ca23bd8 (ComMUserPerChannel): ComMUserChannel=CN_CAN00_4124aacb
      CN_CAN00_4124aacb (ComMUser): ComMUserIdentifier=0
    ComMGeneral: ComMPncIdCounting=COMM_PNC_ID_COUNT_FROM_NM_MESSAGE, ComMPncSupport=false
  module config EcuC
    EcucPduCollection: PduIdTypeEnum=UINT8, PduLengthTypeEnum=UINT8
      4 x Pdu, all with PduLength=8:
        T1_RxMsg_oCAN00_53752368_Rx: SysTPduToFrameMappingRef=T1_RxMsg
        T1_RxMsg_oCAN00_c2c93374_Rx
        T1_TxMsg_oCAN00_2df49694_Tx
        T1_TxMsg_oCAN00_ef2c7eaf_Tx: SysTPduToFrameMappingRef=T1_TxMsg
  module config EcuM
    EcuMConfiguration
      EcuMCommonConfiguration
        EcuMDriverInitListOne
        EcuMDriverRestartList
        CN_CAN00_d9752b68 (EcuMWakeupSource): EcuMWakeupSourceId=5, EcuMComMChannelRef=ComMConfigSet/CN_CAN00_d9752b68
      EcuMFlexConfiguration: EcuMFlexModuleConfigurationRef=CanConfigSet
  module config PduR
    PduRGeneral
    PduRRoutingTables
      PduRRoutingTable
        T1_RxMsg_oCAN00_53752368_Rx (PduRRoutingPath)
          T1_RxMsg_oCAN00_53752368_Rx_ab1b6f5d_Rx (PduRDestPdu): PduRDestPduRef=EcucPduCollection/T1_RxMsg_oCAN00_c2c93374_Rx
          PduRSrcPdu_ab1b6f5d (PduRSrcPdu): PduRSrcPduRef=EcucPduCollection/T1_RxMsg_oCAN00_53752368_Rx
        T1_TxMsg_oCAN00_2df49694_Tx (PduRRoutingPath)
          T1_TxMsg_oCAN00_ef2c7eaf_Tx (PduRDestPdu): PduRDestPduRef=EcucPduCollection/T1_TxMsg_oCAN00_ef2c7eaf_Tx
          PduRSrcPdu_0c40aab2 (PduRSrcPdu): PduRSrcPduRef=EcucPduCollection/T1_TxMsg_oCAN00_2df49694_Tx
