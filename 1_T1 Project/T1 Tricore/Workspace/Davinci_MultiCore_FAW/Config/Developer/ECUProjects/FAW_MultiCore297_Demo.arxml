AUTOSAR XML (schema 00044)
package /ECUCompositionTypes
  composition sw component type ECU_Composition
    component CpAp_FAWDemo_Core{0..2}: type=CtAp_FAWDemo_Core{0..2}
package /EndToEndProtections
  end to end protection set EndToEndProtectionSet
package /VehicleProject
  system System
    root-software-compositions:
      root sw composition prototype EcuSwComposition: software-composition=ECU_Composition
