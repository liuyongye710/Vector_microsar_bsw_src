AUTOSAR XML (schema 00044)
package /ComponentTypes
  application sw component type CtAp_FAWDemo_Core1
    behavior CtAp_FAWDemo_Core1_InternalBehavior
      9 x timing event:
        TMT_Runnable200ms_Core1: start-on-event=Runnable200ms_Core1, period=0.2
        TMT_Runnable10ms_Core1: start-on-event=Runnable10ms_Core1, period=0.01
        TMT_Runnable20ms_Core1: start-on-event=Runnable20ms_Core1, period=0.02
        TMT_Runnable100ms_Core1: start-on-event=Runnable100ms_Core1, period=0.1
        TMT_Runnable50ms_Core1: start-on-event=Runnable50ms_Core1, period=0.05
        TMT_Runnable1ms_Core1: start-on-event=Runnable1ms_Core1, period=0.001
        TMT_Runnable5ms_Core1: start-on-event=Runnable5ms_Core1, period=0.005
        TMT_Runnable500ms_Core1: start-on-event=Runnable500ms_Core1, period=0.5
        TMT_Runnable1000ms_Core1: start-on-event=Runnable1000ms_Core1, period=1
      9 x runnable:
        Runnable200ms_Core1
        Runnable10ms_Core1
        Runnable20ms_Core1
        Runnable100ms_Core1
        Runnable50ms_Core1
        Runnable1ms_Core1
        Runnable5ms_Core1
        Runnable500ms_Core1
        Runnable1000ms_Core1
  swc implementation CtAp_FAWDemo_Core1_Implementation: behavior=CtAp_FAWDemo_Core1_InternalBehavior
