AUTOSAR XML (schema 00044)
package /ComponentTypes
  application sw component type CtAp_FAWDemo_Core0
    require port ComM_UserRequest: required-com-specs=[GetRequestedComMode, GetMaxComMode, GetCurrentComMode, RequestComMode], required-interface=ComM_UserRequest
    behavior CtAp_FAWDemo_Core0_InternalBehavior
      9 x timing event:
        TMT_Runnable200ms_Core0: start-on-event=Runnable200ms_Core0, period=0.2
        TMT_Runnable1ms_Core0: start-on-event=Runnable1ms_Core0, period=0.001
        TMT_Runnable5ms_Core0: start-on-event=Runnable5ms_Core0, period=0.005
        TMT_Runnable10ms_Core0: start-on-event=Runnable10ms_Core0, period=0.01
        TMT_Runnable20ms_Core0: start-on-event=Runnable20ms_Core0, period=0.02
        TMT_Runnable50ms_Core0: start-on-event=Runnable50ms_Core0, period=0.05
        TMT_Runnable100ms_Core0: start-on-event=Runnable100ms_Core0, period=0.1
        TMT_Runnable1000ms_Core0: start-on-event=Runnable1000ms_Core0, period=1
        TMT_Runnable500ms_Core0: start-on-event=Runnable500ms_Core0, period=0.5
      9 x runnable:
        Runnable200ms_Core0
        Runnable1ms_Core0
          sync call SC_ComM_UserRequest_RequestComMode: operation=ComM_UserRequest.RequestComMode
        Runnable5ms_Core0
        Runnable10ms_Core0
        Runnable20ms_Core0
        Runnable50ms_Core0
        Runnable100ms_Core0
        Runnable1000ms_Core0
        Runnable500ms_Core0
  swc implementation CtAp_FAWDemo_Core0_Implementation: behavior=CtAp_FAWDemo_Core0_InternalBehavior
