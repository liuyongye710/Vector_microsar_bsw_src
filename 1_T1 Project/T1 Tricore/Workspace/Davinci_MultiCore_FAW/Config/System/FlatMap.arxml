AUTOSAR XML (schema 4-2-1)
package /COM/VECTOR/CFG/WORKFLOW/SYSDESC/SYNC
  flat map FLATMAP
    flat instance descriptor CpAp_FAWDemo_Core{0..2}: upstream-reference=EcuSwComposition.CpAp_FAWDemo_Core{0..2}, ecu-extract-reference=COMPOSITIONTYPE.CpAp_FAWDemo_Core{0..2}
