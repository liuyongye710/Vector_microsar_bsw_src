AUTOSAR XML (schema 00044)
package /COM/VECTOR/CFG/WORKFLOW/SYSDESC/SYNC
  system SYSTEM: category=ECU_EXTRACT
    system mapping MAPPINGS
    root-software-compositions:
      root sw composition prototype COMPOSITIONTYPE: flat-map=FLATMAP, software-composition=COMPOSITIONTYPE
  composition sw component type COMPOSITIONTYPE  # UB:Derived from original system description
    10 x component:
      BswM: type=BswM
      Det: type=Det
      EcuM: type=EcuM
      Os_OsCore{0..2}_swc: type=Os_OsCore{0..2}_swc
      CpAp_FAWDemo_Core{0..2}: type=CtAp_FAWDemo_Core{0..2}
      ComM: type=ComM
    connect ComM.UR_CN_CAN00_4124aacb -> CpAp_FAWDemo_Core0.ComM_UserRequest
  end to end protection set E2EPROTECTIONSET
  port interface mapping set PORTINTERFACEMAPPINGSET
