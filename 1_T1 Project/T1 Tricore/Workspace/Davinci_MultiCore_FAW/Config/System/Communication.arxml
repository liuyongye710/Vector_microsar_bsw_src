AUTOSAR XML (schema 4-2-1)
package /VehicleProject
  system System
package /Cluster
  can cluster CAN00: protocol-name=CAN  # ATD
    can physical channel CHNL: comm-connectors=CN_CAN00
      frame T1_RxMsg_oCAN00: id 0x7CB, to iECU, frame-length=8, can-addressing-mode=STANDARD
        pdu T1_RxMsg_oCAN00: length=8, minimum-delay=0, transmission-mode-false-timing=cyclic-timing={time-offset=0, time-period=0}, transmission-mode-true-timing=cyclic-timing={time-offset=0, time-period=0}, unused-bit-pattern=0
          signal New_Signal_7_oT1_RxMsg_oCAN00: start 0, 8 bit, little-endian, init-value=1, base-type=sint8, compu-method=CM_New_Signal_7, data-constr=DC_New_Signal_7, transfer-property=PENDING, to iECU
      frame T1_TxMsg_oCAN00: id 0x7FA, from iECU, frame-length=8, can-addressing-mode=STANDARD
        pdu T1_TxMsg_oCAN00: length=8, minimum-delay=0, transmission-mode-false-timing=cyclic-timing={time-offset=0, time-period=0}, transmission-mode-true-timing=cyclic-timing={time-offset=0, time-period=0}, unused-bit-pattern=0
          signal New_Signal_6_oT1_TxMsg_oCAN00: start 0, 8 bit, little-endian, init-value=0, base-type=sint8, compu-method=CM_New_Signal_6, data-constr=DC_New_Signal_6, transfer-property=PENDING
package /ECU
  ecu instance iECU: associated-com-i-pdu-group=[iECU_oCAN00_Rx, iECU_oCAN00_Tx]
    can communication controller CT_CAN00
    can communication connector CN_CAN00: comm-controller=CT_CAN00
package /IPDUGroup
  i signal i pdu group iECU_oCAN00_Rx: communication-direction=IN, i-signal-i-pdus=T1_RxMsg_oCAN00
  i signal i pdu group iECU_oCAN00_Tx: communication-direction=OUT, i-signal-i-pdus=T1_TxMsg_oCAN00
