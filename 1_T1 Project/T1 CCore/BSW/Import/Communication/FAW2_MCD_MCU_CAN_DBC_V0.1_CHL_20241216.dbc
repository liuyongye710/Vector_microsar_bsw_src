VERSION "HNNBNNNYNNNNNNNNNNNNNNNNNNNNNNNNNNNNNNNNNN/4>*%%/4/'%**4NNN///"

NS_ :

BS_:

BU_: Tester MCU

BO_ 2042 GL_Rx_REQ: 8 Tester
 SG_ GL_Rx_REQ : 0|64@1+ (1,0) [0|0] ""  MCU

BO_ 1995 GL_Tx_RES: 8 MCU
 SG_ GL_Tx_RES : 0|64@1+ (1,0) [0|0] ""  Tester

BO_ 1966 XCP_DAQ_13: 8 MCU
 SG_ XCP_DAQ_13 : 0|64@1+ (1,0) [0|0] ""  Tester

BO_ 1965 XCP_DAQ_12: 8 MCU
 SG_ XCP_DAQ_12 : 0|64@1+ (1,0) [0|0] ""  Tester

BO_ 1964 XCP_DAQ_11: 8 MCU
 SG_ XCP_DAQ_11 : 0|64@1+ (1,0) [0|0] ""  Tester

BO_ 1963 XCP_DAQ_10: 8 MCU
 SG_ XCP_DAQ_10 : 0|64@1+ (1,0) [0|0] ""  Tester

BO_ 1960 XCP_DAQ_7: 8 MCU
 SG_ XCP_DAQ_7 : 0|64@1+ (1,0) [0|0] ""  Tester

BO_ 1962 XCP_DAQ_9: 8 MCU
 SG_ XCP_DAQ_9 : 0|64@1+ (1,0) [0|0] ""  Tester

BO_ 1961 XCP_DAQ_8: 8 MCU
 SG_ XCP_DAQ_8 : 0|64@1+ (1,0) [0|0] ""  Tester

BO_ 1959 XCP_DAQ_6: 8 MCU
 SG_ XCP_DAQ_6 : 0|64@1+ (1,0) [0|0] ""  Tester

BO_ 1958 XCP_DAQ_5: 8 MCU
 SG_ XCP_DAQ_5 : 0|64@1+ (1,0) [0|0] ""  Tester

BO_ 1957 XCP_DAQ_4: 8 MCU
 SG_ XCP_DAQ_4 : 0|64@1+ (1,0) [0|0] ""  Tester

BO_ 1956 XCP_DAQ_3: 8 MCU
 SG_ XCP_DAQ_3 : 0|64@1+ (1,0) [0|0] ""  Tester

BO_ 1955 XCP_DAQ_2: 8 MCU
 SG_ XCP_DAQ_2 : 0|64@1+ (1,0) [0|0] ""  Tester

BO_ 1954 XCP_DAQ_1: 8 MCU
 SG_ XCP_DAQ_1 : 0|64@1+ (1,0) [0|0] ""  Tester

BO_ 1953 XCP_Response: 8 MCU
 SG_ XCP_Response_Signal : 0|64@1+ (1,0) [0|0] ""  Tester

BO_ 1952 XCP_Request: 8 Tester
 SG_ XCP_Request_Signal : 0|64@1+ (1,0) [0|0] ""  MCU

BO_ 2564550641 MCU_Rx_Data_2: 8 Tester
 SG_ EMS_Rx_STmin_2 m3 : 23|8@0+ (1,0) [0|255] ""  MCU
 SG_ EMS_Rx_SN_2 m2 : 3|4@0+ (1,0) [0|15] ""  MCU
 SG_ EMS_Rx_SF_DL_2 m0 : 3|4@0+ (1,0) [0|15] ""  MCU
 SG_ EMS_Rx_N_PCItype_2 M : 7|4@0+ (1,0) [0|15] ""  MCU
 SG_ EMS_Rx_FS_2 m3 : 3|4@0+ (1,0) [0|15] ""  MCU
 SG_ EMS_Rx_FF_DL_2 m1 : 3|12@0+ (1,0) [0|0] ""  MCU
 SG_ EMS_Rx_BS_2 m3 : 15|8@0+ (1,0) [0|255] ""  MCU

BO_ 2564485105 MCU_Rx_Data_1: 8 Tester
 SG_ EMS_Rx_STmin_1 m3 : 23|8@0+ (1,0) [0|255] ""  MCU
 SG_ EMS_Rx_SN_1 m2 : 3|4@0+ (1,0) [0|15] ""  MCU
 SG_ EMS_Rx_SF_DL_1 m0 : 3|4@0+ (1,0) [0|15] ""  MCU
 SG_ EMS_Rx_N_PCItype_1 M : 7|4@0+ (1,0) [0|15] ""  MCU
 SG_ EMS_Rx_FS_1 m3 : 3|4@0+ (1,0) [0|15] ""  MCU
 SG_ EMS_Rx_FF_DL_1 m1 : 3|12@0+ (1,0) [0|0] ""  MCU
 SG_ EMS_Rx_BS_1 m3 : 15|8@0+ (1,0) [0|255] ""  MCU

BO_ 2564485615 MCU_Tx_Data: 8 MCU
 SG_ MCU_Tx_STmin m3 : 23|8@0+ (1,0) [0|255] ""  Tester
 SG_ MCU_Tx_BS m3 : 15|8@0+ (1,0) [0|255] ""  Tester
 SG_ MCU_Tx_FS m3 : 3|4@0+ (1,0) [0|15] ""  Tester
 SG_ MCU_Tx_SN m2 : 3|4@0+ (1,0) [0|15] ""  Tester
 SG_ MCU_Tx_FF_DL m1 : 3|12@0+ (1,0) [0|0] ""  Tester
 SG_ MCU_Tx_SF_DL m0 : 3|4@0+ (1,0) [0|15] ""  Tester
 SG_ MCU_Tx_N_PCItype M : 7|4@0+ (1,0) [0|15] ""  Tester

CM_ BU_ MCU "Engine Management System";
BA_DEF_ SG_  "GenSigEnvVarType" ENUM  "int","float","undef";
BA_DEF_ BU_  "ILUsed" ENUM  "No","Yes";
BA_DEF_ BU_  "TpTxIdentifier" HEX 0 419430399;
BA_DEF_ BU_  "TpRxIdentifier" HEX 0 419430399;
BA_DEF_ BU_  "TpCanBus" INT 1 2;
BA_DEF_  "GenEnvVarEndingDsp" STRING ;
BA_DEF_  "GenEnvVarEndingSnd" STRING ;
BA_DEF_  "GenEnvVarPrefix" STRING ;
BA_DEF_  "NmBaseAddress" HEX 0 2047;
BA_DEF_  "NmMessageCount" INT 0 255;
BA_DEF_ BO_  "SingleFrame" INT 0 1;
BA_DEF_ BO_  "GenMsgRequestable" INT 0 1;
BA_DEF_ BU_  "NmStationAddress" HEX 0 65535;
BA_DEF_ BU_  "NodeLayerModules" STRING ;
BA_DEF_ SG_  "GenSigSendType" ENUM  "Cyclic","OnWrite","OnWriteWithRepetition","OnChange","OnChangeWithRepetition","IfActive","IfActiveWithRepetition","NoSigSendType";
BA_DEF_ BO_  "GenMsgSendType" ENUM  "Cyclic","NotUsed","NotUsed","NotUsed","NotUsed","Cyclic","NotUsed","IfActive","NoMsgSendType";
BA_DEF_ BO_  "GenMsgILSupport" ENUM  "No","Yes";
BA_DEF_ BO_  "DiagResponse" ENUM  "No","Yes";
BA_DEF_ BO_  "DiagRequest" ENUM  "No","Yes";
BA_DEF_ BO_  "DiagState" ENUM  "No","Yes";
BA_DEF_ BO_  "CanTpSTmin" INT 0 0;
BA_DEF_ BO_  "CanTpFcFrameId" HEX 0 2147483647;
BA_DEF_ BO_  "VFrameFormat" ENUM  "StandardCAN","ExtendedCAN","reserved","J1939PG";
BA_DEF_ BU_  "NmAsrCanMsgReducedTime" INT 0 65535;
BA_DEF_  "NmAsrBaseAddress" HEX 0 2047;
BA_DEF_  "NmAsrMessageCount" INT 1 256;
BA_DEF_  "BusType" STRING ;
BA_DEF_  "Baudrate" INT 0 1000000;
BA_DEF_  "NmAsrWaitBusSleepTime" INT 0 65535;
BA_DEF_  "NmAsrTimeoutTime" INT 0 65535;
BA_DEF_  "NmAsrRepeatMessageTime" INT 0 65535;
BA_DEF_  "NmAsrCanMsgCycleTime" INT 0 65535;
BA_DEF_  "ProtocolType" STRING ;
BA_DEF_  "DBName" STRING ;
BA_DEF_DEF_  "GenSigEnvVarType" "undef";
BA_DEF_DEF_  "ILUsed" "No";
BA_DEF_DEF_  "TpTxIdentifier" 0;
BA_DEF_DEF_  "TpRxIdentifier" 0;
BA_DEF_DEF_  "TpCanBus" 1;
BA_DEF_DEF_  "GenEnvVarEndingDsp" "Dsp_";
BA_DEF_DEF_  "GenEnvVarEndingSnd" "_";
BA_DEF_DEF_  "GenEnvVarPrefix" "Env";
BA_DEF_DEF_  "NmBaseAddress" 1024;
BA_DEF_DEF_  "NmMessageCount" 128;
BA_DEF_DEF_  "SingleFrame" 1;
BA_DEF_DEF_  "GenMsgRequestable" 1;
BA_DEF_DEF_  "NmStationAddress" 0;
BA_DEF_DEF_  "NodeLayerModules" "CANoeILNLVector.dll";
BA_DEF_DEF_  "GenSigSendType" "Cyclic";
BA_DEF_DEF_  "GenMsgSendType" "Cyclic";
BA_DEF_DEF_  "GenMsgILSupport" "No";
BA_DEF_DEF_  "DiagResponse" "No";
BA_DEF_DEF_  "DiagRequest" "No";
BA_DEF_DEF_  "DiagState" "No";
BA_DEF_DEF_  "CanTpSTmin" 1;
BA_DEF_DEF_  "CanTpFcFrameId" 2147483647;
BA_DEF_DEF_  "VFrameFormat" "J1939PG";
BA_DEF_DEF_  "NmAsrCanMsgReducedTime" 50;
BA_DEF_DEF_  "NmAsrBaseAddress" 1280;
BA_DEF_DEF_  "NmAsrMessageCount" 128;
BA_DEF_DEF_  "BusType" "CAN";
BA_DEF_DEF_  "Baudrate" 500000;
BA_DEF_DEF_  "NmAsrWaitBusSleepTime" 750;
BA_DEF_DEF_  "NmAsrTimeoutTime" 1000;
BA_DEF_DEF_  "NmAsrRepeatMessageTime" 400;
BA_DEF_DEF_  "NmAsrCanMsgCycleTime" 100;
BA_DEF_DEF_  "ProtocolType" "*";
BA_DEF_DEF_  "DBName" "";
BA_ "Baudrate" 250000;
BA_ "DBName" "FAW_MCD_MCU";
BA_ "NmStationAddress" BU_ Tester 241;
BA_ "NmStationAddress" BU_ MCU 239;
BA_ "NodeLayerModules" BU_ MCU "";
BA_ "TpRxIdentifier" BU_ MCU 416940273;
BA_ "TpTxIdentifier" BU_ MCU 417001728;
BA_ "ILUsed" BU_ MCU 1;
BA_ "GenMsgILSupport" BO_ 2042 1;
BA_ "GenMsgSendType" BO_ 2042 8;
BA_ "VFrameFormat" BO_ 2042 0;
BA_ "GenMsgILSupport" BO_ 1995 1;
BA_ "GenMsgSendType" BO_ 1995 8;
BA_ "VFrameFormat" BO_ 1995 0;
BA_ "VFrameFormat" BO_ 1966 0;
BA_ "GenMsgSendType" BO_ 1966 8;
BA_ "VFrameFormat" BO_ 1965 0;
BA_ "GenMsgSendType" BO_ 1965 8;
BA_ "VFrameFormat" BO_ 1964 0;
BA_ "GenMsgSendType" BO_ 1964 8;
BA_ "VFrameFormat" BO_ 1963 0;
BA_ "GenMsgSendType" BO_ 1963 8;
BA_ "VFrameFormat" BO_ 1960 0;
BA_ "GenMsgSendType" BO_ 1960 8;
BA_ "VFrameFormat" BO_ 1962 0;
BA_ "GenMsgSendType" BO_ 1962 8;
BA_ "VFrameFormat" BO_ 1961 0;
BA_ "GenMsgSendType" BO_ 1961 8;
BA_ "VFrameFormat" BO_ 1959 0;
BA_ "GenMsgSendType" BO_ 1959 8;
BA_ "VFrameFormat" BO_ 1958 0;
BA_ "GenMsgSendType" BO_ 1958 8;
BA_ "VFrameFormat" BO_ 1957 0;
BA_ "GenMsgSendType" BO_ 1957 8;
BA_ "VFrameFormat" BO_ 1956 0;
BA_ "GenMsgSendType" BO_ 1956 8;
BA_ "VFrameFormat" BO_ 1955 0;
BA_ "GenMsgSendType" BO_ 1955 8;
BA_ "VFrameFormat" BO_ 1954 0;
BA_ "GenMsgSendType" BO_ 1954 8;
BA_ "VFrameFormat" BO_ 1953 0;
BA_ "GenMsgSendType" BO_ 1953 8;
BA_ "VFrameFormat" BO_ 1952 0;
BA_ "GenMsgSendType" BO_ 1952 8;
BA_ "DiagState" BO_ 2564550641 1;
BA_ "GenMsgSendType" BO_ 2564550641 8;
BA_ "VFrameFormat" BO_ 2564550641 1;
BA_ "DiagRequest" BO_ 2564485105 1;
BA_ "GenMsgSendType" BO_ 2564485105 8;
BA_ "VFrameFormat" BO_ 2564485105 1;
BA_ "DiagResponse" BO_ 2564485615 1;
BA_ "GenMsgSendType" BO_ 2564485615 8;
BA_ "VFrameFormat" BO_ 2564485615 1;
BA_ "GenSigSendType" SG_ 2042 GL_Rx_REQ 1;
BA_ "GenSigSendType" SG_ 1995 GL_Tx_RES 1;
BA_ "GenSigSendType" SG_ 1966 XCP_DAQ_13 7;
BA_ "GenSigSendType" SG_ 1965 XCP_DAQ_12 7;
BA_ "GenSigSendType" SG_ 1964 XCP_DAQ_11 7;
BA_ "GenSigSendType" SG_ 1963 XCP_DAQ_10 7;
BA_ "GenSigSendType" SG_ 1960 XCP_DAQ_7 7;
BA_ "GenSigSendType" SG_ 1962 XCP_DAQ_9 7;
BA_ "GenSigSendType" SG_ 1961 XCP_DAQ_8 7;
BA_ "GenSigSendType" SG_ 1959 XCP_DAQ_6 7;
BA_ "GenSigSendType" SG_ 1958 XCP_DAQ_5 7;
BA_ "GenSigSendType" SG_ 1957 XCP_DAQ_4 7;
BA_ "GenSigSendType" SG_ 1956 XCP_DAQ_3 7;
BA_ "GenSigSendType" SG_ 1955 XCP_DAQ_2 7;
BA_ "GenSigSendType" SG_ 1954 XCP_DAQ_1 7;
BA_ "GenSigSendType" SG_ 1953 XCP_Response_Signal 7;
BA_ "GenSigSendType" SG_ 1952 XCP_Request_Signal 7;
VAL_ 2564550641 EMS_Rx_N_PCItype_2 15 "Reserved" 14 "Reserved" 13 "Reserved" 12 "Reserved" 11 "Reserved" 10 "Reserved" 9 "Reserved" 8 "Reserved" 7 "Reserved" 6 "Reserved" 5 "Reserved" 4 "Reserved" 3 "3" 2 "2" 1 "1" 0 "0" ;
VAL_ 2564485105 EMS_Rx_N_PCItype_1 15 "Reserved" 14 "Reserved" 13 "Reserved" 12 "Reserved" 11 "Reserved" 10 "Reserved" 9 "Reserved" 8 "Reserved" 7 "Reserved" 6 "Reserved" 5 "Reserved" 4 "Reserved" 3 "3" 2 "2" 1 "1" 0 "0" ;
VAL_ 2564485615 MCU_Tx_N_PCItype 15 "Reserved" 14 "Reserved" 13 "Reserved" 12 "Reserved" 11 "Reserved" 10 "Reserved" 9 "Reserved" 8 "Reserved" 7 "Reserved" 6 "Reserved" 5 "Reserved" 4 "Reserved" 3 "3" 2 "2" 1 "1" 0 "0" ;
