AUTOSAR XML
package /ActiveEcuC
  module config Can
    CanConfigSet: import=NONE
      5 x CanController, all with import=COMM_IMPORT, CanBusoffProcessing=INTERRUPT, CanRxProcessing=INTERRUPT, CanTxProcessing=INTERRUPT, CanWakeupProcessing=INTERRUPT, CanControllerDefaultBaudrate=CanControllerBaudrateConfig:
        CAN_Matrix_DCDC_V0_1_20250414_VR82BV: CanControllerId=0
          CanControllerBaudrateConfig:
            import = COMM_IMPORT
            CanControllerBaudRate = 500
            CanControllerBaudRateConfigID = 0
            CanControllerPropSeg = 7
            CanControllerSeg1 = 8
            CanControllerSeg2 = 4
            CanControllerSyncJumpWidth = 4
        CanController1: CanControllerId=1
          CanControllerBaudrateConfig:
            import = COMM_IMPORT
            CanControllerBaudRate = 500
            CanControllerBaudRateConfigID = 0
            CanControllerPropSeg = 7
            CanControllerSeg1 = 8
            CanControllerSeg2 = 4
            CanControllerSyncJumpWidth = 4
        FAW_MCD_MCU_CAN_V1_4_1_D3_sO0: CanControllerId=2
          CanControllerBaudrateConfig:
            import = COMM_IMPORT
            CanControllerBaudRate = 500
            CanControllerBaudRateConfigID = 0
            CanControllerPropSeg = 7
            CanControllerSeg1 = 8
            CanControllerSeg2 = 4
            CanControllerSyncJumpWidth = 4
        FAW2_MCD_MCU_CAN_DBC_V0_1_CHL_20241216_Voxyrf: CanControllerId=3
          CanControllerBaudrateConfig:
            import = COMM_IMPORT
            CanControllerBaudRate = 250
            CanControllerBaudRateConfigID = 0
            CanControllerPropSeg = 7
            CanControllerSeg1 = 8
            CanControllerSeg2 = 4
            CanControllerSyncJumpWidth = 4
        FAW3_HVAC_V2_0DBC_OjcG_c: CanControllerId=4
          CanControllerBaudrateConfig:
            import = COMM_IMPORT
            CanControllerBaudRate = 500
            CanControllerBaudRateConfigID = 0
            CanControllerPropSeg = 7
            CanControllerSeg1 = 8
            CanControllerSeg2 = 4
            CanControllerSyncJumpWidth = 4
      18 x CanHardwareObject, all with import=COMM_IMPORT, CanIdType=MIXED:
        DCDC_Status_CAN0_Rx: CanHandleType=BASIC, CanObjectId=0, CanObjectType=RECEIVE, CanControllerRef=CAN_Matrix_DCDC_V0_1_20250414_VR82BV
          CanHwFilter: import=COMM_IMPORT, CanHwFilterMask=536870911
        AMT3_CAN2_Rx: CanHandleType=BASIC, CanObjectId=1, CanObjectType=RECEIVE, CanControllerRef=FAW_MCD_MCU_CAN_V1_4_1_D3_sO0
          CanHwFilter: import=COMM_IMPORT, CanHwFilterMask=536870911
        CCVSHCU_CAN2_Rx: CanHandleType=BASIC, CanObjectId=2, CanObjectType=RECEIVE, CanControllerRef=FAW_MCD_MCU_CAN_V1_4_1_D3_sO0
          CanHwFilter: import=COMM_IMPORT, CanHwFilterMask=536870911
        EEC2HCU_ETC1_CAN2_Rx: CanHandleType=BASIC, CanObjectId=3, CanObjectType=RECEIVE, CanControllerRef=FAW_MCD_MCU_CAN_V1_4_1_D3_sO0
          CanHwFilter: import=COMM_IMPORT, CanHwFilterMask=536870911
        ETC2_SC_CAN2_Rx: CanHandleType=BASIC, CanObjectId=4, CanObjectType=RECEIVE, CanControllerRef=FAW_MCD_MCU_CAN_V1_4_1_D3_sO0
          CanHwFilter: import=COMM_IMPORT, CanHwFilterMask=536870911
        HCUMCU_CAN2_Rx: CanHandleType=BASIC, CanObjectId=5, CanObjectType=RECEIVE, CanControllerRef=FAW_MCD_MCU_CAN_V1_4_1_D3_sO0
          CanHwFilter: import=COMM_IMPORT, CanHwFilterMask=536870911
        TC_TSC_CAN2_Rx: CanHandleType=BASIC, CanObjectId=6, CanObjectType=RECEIVE, CanControllerRef=FAW_MCD_MCU_CAN_V1_4_1_D3_sO0
          CanHwFilter: import=COMM_IMPORT, CanHwFilterMask=536870911
        MCU_Rx_Data_1_CAN3_Rx: CanHandleType=FULL, CanObjectId=7, CanObjectType=RECEIVE, CanControllerRef=FAW2_MCD_MCU_CAN_DBC_V0_1_CHL_20241216_Voxyrf
          CanHwFilter: import=COMM_IMPORT, CanHwFilterMask=536870911
        MCU_Rx_Data_2_CAN3_Rx: CanHandleType=FULL, CanObjectId=8, CanObjectType=RECEIVE, CanControllerRef=FAW2_MCD_MCU_CAN_DBC_V0_1_CHL_20241216_Voxyrf
          CanHwFilter: import=COMM_IMPORT, CanHwFilterMask=536870911
        XCP_Request_CAN3_Rx: CanHandleType=FULL, CanObjectId=9, CanObjectType=RECEIVE, CanControllerRef=FAW2_MCD_MCU_CAN_DBC_V0_1_CHL_20241216_Voxyrf
          CanHwFilter: import=COMM_IMPORT, CanHwFilterMask=536870911
        GL_Rx_REQ_CAN3_Rx: CanHandleType=FULL, CanObjectId=10, CanObjectType=RECEIVE, CanControllerRef=FAW2_MCD_MCU_CAN_DBC_V0_1_CHL_20241216_Voxyrf
          CanHwFilter: import=COMM_IMPORT, CanHwFilterMask=536870911
        HCU_OPCU_DCDC_CAN4_Rx: CanHandleType=BASIC, CanObjectId=11, CanObjectType=RECEIVE, CanControllerRef=FAW3_HVAC_V2_0DBC_OjcG_c
          CanHwFilter: import=COMM_IMPORT, CanHwFilterMask=536870911
        HCU_APCU_3_CAN4_Rx: CanHandleType=BASIC, CanObjectId=12, CanObjectType=RECEIVE, CanControllerRef=FAW3_HVAC_V2_0DBC_OjcG_c
          CanHwFilter: import=COMM_IMPORT, CanHwFilterMask=536870911
        BMS5_MCU2_CAN4_Rx: CanHandleType=BASIC, CanObjectId=13, CanObjectType=RECEIVE, CanControllerRef=FAW3_HVAC_V2_0DBC_OjcG_c
          CanHwFilter: import=COMM_IMPORT, CanHwFilterMask=536870911
        CAN0_Tx: CanHandleType=BASIC, CanObjectId=14, CanObjectType=TRANSMIT, CanControllerRef=CAN_Matrix_DCDC_V0_1_20250414_VR82BV
        CAN2_Tx: CanHandleType=BASIC, CanObjectId=15, CanObjectType=TRANSMIT, CanControllerRef=FAW_MCD_MCU_CAN_V1_4_1_D3_sO0
        CAN3_Tx: CanHandleType=BASIC, CanObjectId=16, CanObjectType=TRANSMIT, CanControllerRef=FAW2_MCD_MCU_CAN_DBC_V0_1_CHL_20241216_Voxyrf
        CAN4_Tx: CanHandleType=BASIC, CanObjectId=17, CanObjectType=TRANSMIT, CanControllerRef=FAW3_HVAC_V2_0DBC_OjcG_c
    CanGeneral: import=NONE
