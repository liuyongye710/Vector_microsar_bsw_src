AUTOSAR XML
package /ActiveEcuC
  module config EcuC
    EcucConfigSet: import=NONE
      EcucPduCollection: import=NONE
        63 x Pdu, all with import=COMM_IMPORT:
          MCU1_D3_sO0: PduLength=8
          ECMCU_D3_sO0: MetaDataLength=0, PduLength=34
          MCU3_D3_sO0: PduLength=8
          MCU{21..23}_D3_sO0: PduLength=8
          DM1MCU_D3_sO0: MetaDataLength=0, PduLength=48
          DM1MCU2_D3_sO0: MetaDataLength=0, PduLength=48
          MCU2_D3_sO0: PduLength=8
          TPCMBAMMCU2_D3_sO0: MetaDataLength=4, PduLength=8
          TPDTMCU2_D3_sO0: MetaDataLength=4, PduLength=8
          TPCMBAMMCU_D3_sO0: MetaDataLength=4, PduLength=8
          TPDTMCU_D3_sO0: MetaDataLength=4, PduLength=8
          TSC1Mtr_D3_sO0: PduLength=8
          EEC2HCU_D3_sO0: PduLength=8
          CCVSHCU_D3_sO0: PduLength=8
          TC1_D3_sO0: PduLength=8
          TC1Handle_D3_sO0: PduLength=8
          ETC1_D3_sO0: PduLength=8
          ETC2_D3_sO0: PduLength=8
          AMT3_D3_sO0: PduLength=8
          HCUMCU_D3_sO0: PduLength=8
          HCUMCU2_D3_sO0: PduLength=8
          SC_D3_sO0: PduLength=8
          TSC1Mtr2_D3_sO0: PduLength=8
          GL_Tx_RES_Voxyrf: PduLength=8
          XCP_Response_Voxyrf: PduLength=8
          MCU_Tx_Data_Voxyrf: PduLength=8
          GL_Rx_REQ_Voxyrf: PduLength=8
          XCP_Request_Voxyrf: PduLength=8
          MCU_Rx_Data_2_Voxyrf: PduLength=8
          MCU_Rx_Data_1_Voxyrf: PduLength=8
          DCDC_Cmd1_VR82BV: PduLength=8
          DCDC_Status{1..3}_VR82BV: PduLength=8
          APCU1_OjcG_c: PduLength=8
          APCU2_OjcG_c: PduLength=8
          DM1APCU_OjcG_c: MetaDataLength=0, PduLength=48
          DCDC1_OjcG_c: PduLength=8
          DM1DCDC_OjcG_c: MetaDataLength=0, PduLength=48
          DM1OPCU_OjcG_c: MetaDataLength=0, PduLength=48
          OPCU1_OjcG_c: PduLength=8
          OPCU2_OjcG_c: PduLength=8
          RelayState_OjcG_c: PduLength=8
          RelayState2_OjcG_c: PduLength=8
          IMCU1PTU_OjcG_c: PduLength=8
          MECU1Reserved_OjcG_c: PduLength=8
          DM1PTU_OjcG_c: MetaDataLength=0, PduLength=48
          TPCMBAMDCDC_OjcG_c: MetaDataLength=4, PduLength=8
          TPDTDCDC_OjcG_c: MetaDataLength=4, PduLength=8
          TPCMBAMOPCU_OjcG_c: MetaDataLength=4, PduLength=8
          TPDTOPCU_OjcG_c: MetaDataLength=4, PduLength=8
          TPCMBAMAPCU_OjcG_c: MetaDataLength=4, PduLength=8
          TPDTAPCU_OjcG_c: MetaDataLength=4, PduLength=8
          TPCMBAMPTU_OjcG_c: MetaDataLength=4, PduLength=8
          TPDTPTU_OjcG_c: MetaDataLength=4, PduLength=8
          HCUDCDC_OjcG_c: PduLength=8
          HCUAPCU_OjcG_c: PduLength=8
          HCUOPCU_OjcG_c: PduLength=8
          HCU3_OjcG_c: PduLength=8
          BMS5_OjcG_c: PduLength=8
          MCU2_OjcG_c: PduLength=8
    EcucHardware: import=NONE
      3 x EcucCoreDefinition, all with import=NONE:
        OsCore_CORE{0..2}: EcucCoreId={0..2}
    EcucPartitionCollection: import=NONE
      4 x EcucPartition, all with import=NONE:
        EcucPartitionASILA: EcucPartitionASILBswModuleExecution=A
        EcucPartitionASILB: EcucPartitionASILBswModuleExecution=B
        EcucPartitionASILC: EcucPartitionASILBswModuleExecution=C
        EcucPartitionQM: EcucPartitionASILBswModuleExecution=QM
