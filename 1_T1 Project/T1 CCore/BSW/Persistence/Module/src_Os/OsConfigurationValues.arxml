AUTOSAR XML
package /ActiveEcuC
  module config Os
    26 x OsAlarm, all with import=NONE, OsAlarmAccessingApplication=SystemApplication_OsCore_Core0, OsAlarmAccessingApplication=SystemApplication_OsCore_Core1, OsAlarmAccessingApplication=SystemApplication_OsCore_Core2:
      Rte_Al_TE_Task_2ms_Core0_QM_2ms: OsAlarmAccessingApplication=App_Application_Core0_QM, OsAlarmCounterRef=SystemTimer_Core0
        OsAlarmAction: import=NONE
          OsAlarmActivateTask: import=NONE, OsAlarmActivateTaskRef=Task_2ms_Core0_QM
      Rte_Al_TE_Task_10ms_Core0_QM_10ms: OsAlarmAccessingApplication=App_Application_Core0_QM, OsAlarmCounterRef=SystemTimer_Core0
        OsAlarmAction: import=NONE
          OsAlarmActivateTask: import=NONE, OsAlarmActivateTaskRef=Task_10ms_Core0_QM
      Rte_Al_TE_Task_20ms_Core0_QM_20ms: OsAlarmAccessingApplication=App_Application_Core0_QM, OsAlarmCounterRef=SystemTimer_Core0
        OsAlarmAction: import=NONE
          OsAlarmActivateTask: import=NONE, OsAlarmActivateTaskRef=Task_20ms_Core0_QM
      Rte_Al_TE_Task_50ms_Core0_QM_50ms: OsAlarmAccessingApplication=App_Application_Core0_QM, OsAlarmCounterRef=SystemTimer_Core0
        OsAlarmAction: import=NONE
          OsAlarmActivateTask: import=NONE, OsAlarmActivateTaskRef=Task_50ms_Core0_QM
      Rte_Al_TE_Task_100ms_Core0_QM_100ms: OsAlarmAccessingApplication=App_Application_Core0_QM, OsAlarmCounterRef=SystemTimer_Core0
        OsAlarmAction: import=NONE
          OsAlarmActivateTask: import=NONE, OsAlarmActivateTaskRef=Task_100ms_Core0_QM
      Rte_Al_TE_Task_200ms_Core0_QM_200ms: OsAlarmAccessingApplication=App_Application_Core0_QM, OsAlarmCounterRef=SystemTimer_Core0
        OsAlarmAction: import=NONE
          OsAlarmActivateTask: import=NONE, OsAlarmActivateTaskRef=Task_200ms_Core0_QM
      Rte_Al_TE_Task_500ms_Core0_QM_500ms: OsAlarmAccessingApplication=App_Application_Core0_QM, OsAlarmCounterRef=SystemTimer_Core0
        OsAlarmAction: import=NONE
          OsAlarmActivateTask: import=NONE, OsAlarmActivateTaskRef=Task_500ms_Core0_QM
      Rte_Al_TE_Task_1000ms_Core0_QM_1000ms: OsAlarmAccessingApplication=App_Application_Core0_QM, OsAlarmCounterRef=SystemTimer_Core0
        OsAlarmAction: import=NONE
          OsAlarmActivateTask: import=NONE, OsAlarmActivateTaskRef=Task_1000ms_Core0_QM
      Rte_Al_TE_Task_5ms_Core1_QM_5ms: OsAlarmAccessingApplication=App_Application_Core1_QM, OsAlarmCounterRef=SystemTimer_Core1
        OsAlarmAction: import=NONE
          OsAlarmActivateTask: import=NONE, OsAlarmActivateTaskRef=Task_5ms_Core1_QM
      Rte_Al_TE_Task_10ms_Core1_QM_10ms: OsAlarmAccessingApplication=App_Application_Core1_QM, OsAlarmCounterRef=SystemTimer_Core1
        OsAlarmAction: import=NONE
          OsAlarmActivateTask: import=NONE, OsAlarmActivateTaskRef=Task_10ms_Core1_QM
      Rte_Al_TE_Task_20ms_Core1_QM_20ms: OsAlarmAccessingApplication=App_Application_Core1_QM, OsAlarmCounterRef=SystemTimer_Core1
        OsAlarmAction: import=NONE
          OsAlarmActivateTask: import=NONE, OsAlarmActivateTaskRef=Task_20ms_Core1_QM
      Rte_Al_TE_Task_50ms_Core1_QM_50ms: OsAlarmAccessingApplication=App_Application_Core1_QM, OsAlarmCounterRef=SystemTimer_Core1
        OsAlarmAction: import=NONE
          OsAlarmActivateTask: import=NONE, OsAlarmActivateTaskRef=Task_50ms_Core1_QM
      Rte_Al_TE_Task_100ms_Core1_QM_100ms: OsAlarmAccessingApplication=App_Application_Core1_QM, OsAlarmCounterRef=SystemTimer_Core1
        OsAlarmAction: import=NONE
          OsAlarmActivateTask: import=NONE, OsAlarmActivateTaskRef=Task_100ms_Core1_QM
      Rte_Al_TE_Task_200ms_Core1_QM_200ms: OsAlarmAccessingApplication=App_Application_Core1_QM, OsAlarmCounterRef=SystemTimer_Core1
        OsAlarmAction: import=NONE
          OsAlarmActivateTask: import=NONE, OsAlarmActivateTaskRef=Task_200ms_Core1_QM
      Rte_Al_TE_Task_500ms_Core1_QM_500ms: OsAlarmAccessingApplication=App_Application_Core1_QM, OsAlarmCounterRef=SystemTimer_Core1
        OsAlarmAction: import=NONE
          OsAlarmActivateTask: import=NONE, OsAlarmActivateTaskRef=Task_500ms_Core1_QM
      Rte_Al_TE_Task_1000ms_Core1_QM_1000ms: OsAlarmAccessingApplication=App_Application_Core1_QM, OsAlarmCounterRef=SystemTimer_Core1
        OsAlarmAction: import=NONE
          OsAlarmActivateTask: import=NONE, OsAlarmActivateTaskRef=Task_1000ms_Core1_QM
      Rte_Al_TE_Task_1ms_Core2_QM_1ms: OsAlarmAccessingApplication=App_Application_Core2_QM, OsAlarmCounterRef=SystemTimer_Core2
        OsAlarmAction: import=NONE
          OsAlarmActivateTask: import=NONE, OsAlarmActivateTaskRef=Task_1ms_Core2_QM
      Rte_Al_TE_Task_5ms_Core2_QM_5ms: OsAlarmAccessingApplication=App_Application_Core2_QM, OsAlarmCounterRef=SystemTimer_Core2
        OsAlarmAction: import=NONE
          OsAlarmActivateTask: import=NONE, OsAlarmActivateTaskRef=Task_5ms_Core2_QM
      Rte_Al_TE_Task_10ms_Core2_QM_10ms: OsAlarmAccessingApplication=App_Application_Core2_QM, OsAlarmCounterRef=SystemTimer_Core2
        OsAlarmAction: import=NONE
          OsAlarmActivateTask: import=NONE, OsAlarmActivateTaskRef=Task_10ms_Core2_QM
      Rte_Al_TE_Task_20ms_Core2_QM_20ms: OsAlarmAccessingApplication=App_Application_Core2_QM, OsAlarmCounterRef=SystemTimer_Core2
        OsAlarmAction: import=NONE
          OsAlarmActivateTask: import=NONE, OsAlarmActivateTaskRef=Task_20ms_Core2_QM
      Rte_Al_TE_Task_50ms_Core2_QM_50ms: OsAlarmAccessingApplication=App_Application_Core2_QM, OsAlarmCounterRef=SystemTimer_Core2
        OsAlarmAction: import=NONE
          OsAlarmActivateTask: import=NONE, OsAlarmActivateTaskRef=Task_50ms_Core2_QM
      Rte_Al_TE_Task_100ms_Core2_QM_100ms: OsAlarmAccessingApplication=App_Application_Core2_QM, OsAlarmCounterRef=SystemTimer_Core2
        OsAlarmAction: import=NONE
          OsAlarmActivateTask: import=NONE, OsAlarmActivateTaskRef=Task_100ms_Core2_QM
      Rte_Al_TE_Task_200ms_Core2_QM_200ms: OsAlarmAccessingApplication=App_Application_Core2_QM, OsAlarmCounterRef=SystemTimer_Core2
        OsAlarmAction: import=NONE
          OsAlarmActivateTask: import=NONE, OsAlarmActivateTaskRef=Task_200ms_Core2_QM
      Rte_Al_TE_Task_500ms_Core2_QM_500ms: OsAlarmAccessingApplication=App_Application_Core2_QM, OsAlarmCounterRef=SystemTimer_Core2
        OsAlarmAction: import=NONE
          OsAlarmActivateTask: import=NONE, OsAlarmActivateTaskRef=Task_500ms_Core2_QM
      Rte_Al_TE_Task_1000ms_Core2_QM_1000ms: OsAlarmAccessingApplication=App_Application_Core2_QM, OsAlarmCounterRef=SystemTimer_Core2
        OsAlarmAction: import=NONE
          OsAlarmActivateTask: import=NONE, OsAlarmActivateTaskRef=Task_1000ms_Core2_QM
      Rte_Al_TE_Task_4ms_Core2_QM_4ms: OsAlarmAccessingApplication=App_Application_Core2_QM, OsAlarmCounterRef=SystemTimer_Core2
        OsAlarmAction: import=NONE
          OsAlarmActivateTask: import=NONE, OsAlarmActivateTaskRef=Task_4ms_Core2_QM
    OS_APPMODE_ANY (OsAppMode): import=NONE
    OSDEFAULTAPPMODE (OsAppMode): import=NONE
    6 x OsApplication, all with import=NONE, OsTrusted=true:
      SystemApplication_OsCore_Core0: OsAppCounterRef=SystemTimer_Core0, OsAppCounterRef=Os_Monitor_Counter, OsAppIsrRef=CounterIsr_SystemTimer_Core0, OsAppIsrRef=MultiCommIsr_OsCore_Core0, OsAppIsrRef=Os_Monitor_Isr, OsAppIsrRef=GTM_ATOM10, OsAppIsrRef=SIUL_External_Interrupt_0, OsAppIsrRef=SIUL_External_Interrupt_1, OsAppIsrRef=EDMA_CH80, OsAppTaskRef=Default_Init_Task_Core0, OsAppTaskRef=Idle_Task_Core0, OsApplicationCoreRef=OsCore_CORE0
      App_Application_Core0_QM: OsAppAlarmRef=Rte_Al_TE_Task_10ms_Core0_QM_10ms, OsAppAlarmRef=Rte_Al_TE_Task_20ms_Core0_QM_20ms, OsAppAlarmRef=Rte_Al_TE_Task_50ms_Core0_QM_50ms, OsAppAlarmRef=Rte_Al_TE_Task_100ms_Core0_QM_100ms, OsAppAlarmRef=Rte_Al_TE_Task_200ms_Core0_QM_200ms, OsAppAlarmRef=Rte_Al_TE_Task_500ms_Core0_QM_500ms, OsAppAlarmRef=Rte_Al_TE_Task_1000ms_Core0_QM_1000ms, OsAppAlarmRef=Rte_Al_TE_Task_2ms_Core0_QM_2ms, OsAppTaskRef=Task_Init_Core0_QM, OsAppTaskRef=Task_10ms_Core0_QM, OsAppTaskRef=Task_20ms_Core0_QM, OsAppTaskRef=Task_50ms_Core0_QM, OsAppTaskRef=Task_100ms_Core0_QM, OsAppTaskRef=Task_200ms_Core0_QM, OsAppTaskRef=Task_500ms_Core0_QM, OsAppTaskRef=Task_1000ms_Core0_QM, OsAppTaskRef=Task_2ms_Core0_QM, OsApplicationCoreRef=OsCore_CORE0
      SystemApplication_OsCore_Core1: OsAppCounterRef=SystemTimer_Core1, OsAppIsrRef=CounterIsr_SystemTimer_Core1, OsAppIsrRef=MultiCommIsr_OsCore_Core1, OsAppIsrRef=GTM_ATOM40, OsAppTaskRef=Default_Init_Task_Core1, OsAppTaskRef=Idle_Task_Core1, OsApplicationCoreRef=OsCore_CORE1
      App_Application_Core1_QM: OsAppAlarmRef=Rte_Al_TE_Task_5ms_Core1_QM_5ms, OsAppAlarmRef=Rte_Al_TE_Task_10ms_Core1_QM_10ms, OsAppAlarmRef=Rte_Al_TE_Task_20ms_Core1_QM_20ms, OsAppAlarmRef=Rte_Al_TE_Task_50ms_Core1_QM_50ms, OsAppAlarmRef=Rte_Al_TE_Task_100ms_Core1_QM_100ms, OsAppAlarmRef=Rte_Al_TE_Task_200ms_Core1_QM_200ms, OsAppAlarmRef=Rte_Al_TE_Task_500ms_Core1_QM_500ms, OsAppAlarmRef=Rte_Al_TE_Task_1000ms_Core1_QM_1000ms, OsAppTaskRef=Task_Init_Core1_QM, OsAppTaskRef=Task_5ms_Core1_QM, OsAppTaskRef=Task_10ms_Core1_QM, OsAppTaskRef=Task_20ms_Core1_QM, OsAppTaskRef=Task_50ms_Core1_QM, OsAppTaskRef=Task_100ms_Core1_QM, OsAppTaskRef=Task_200ms_Core1_QM, OsAppTaskRef=Task_500ms_Core1_QM, OsAppTaskRef=Task_1000ms_Core1_QM, OsApplicationCoreRef=OsCore_CORE1
      SystemApplication_OsCore_Core2: OsAppCounterRef=SystemTimer_Core2, OsAppIsrRef=CounterIsr_SystemTimer_Core2, OsAppIsrRef=MultiCommIsr_OsCore_Core2, OsAppIsrRef=FlashDone_Isr, OsAppIsrRef=PIT0_CH4, OsAppIsrRef=PIT0_CH5, OsAppIsrRef=PIT0_CH6, OsAppIsrRef=Can1_Isr, OsAppIsrRef=Can2_Isr, OsAppIsrRef=Can3_Isr, OsAppIsrRef=Can4_Isr, OsAppIsrRef=Adc89_Grp0_Isr, OsAppIsrRef=Adc89_Grp1_Isr, OsAppIsrRef=Adc89_Grp2_Isr, OsAppIsrRef=Adc89_Grp3_Isr, OsAppIsrRef=Adc89_Grp4_Isr, OsAppIsrRef=Adc89_Grp5_Isr, OsAppTaskRef=Default_Init_Task_Core2, OsAppTaskRef=Idle_Task_Core2, OsApplicationCoreRef=OsCore_CORE2
      App_Application_Core2_QM: OsAppAlarmRef=Rte_Al_TE_Task_1ms_Core2_QM_1ms, OsAppAlarmRef=Rte_Al_TE_Task_5ms_Core2_QM_5ms, OsAppAlarmRef=Rte_Al_TE_Task_10ms_Core2_QM_10ms, OsAppAlarmRef=Rte_Al_TE_Task_20ms_Core2_QM_20ms, OsAppAlarmRef=Rte_Al_TE_Task_50ms_Core2_QM_50ms, OsAppAlarmRef=Rte_Al_TE_Task_100ms_Core2_QM_100ms, OsAppAlarmRef=Rte_Al_TE_Task_200ms_Core2_QM_200ms, OsAppAlarmRef=Rte_Al_TE_Task_500ms_Core2_QM_500ms, OsAppAlarmRef=Rte_Al_TE_Task_1000ms_Core2_QM_1000ms, OsAppAlarmRef=Rte_Al_TE_Task_4ms_Core2_QM_4ms, OsAppTaskRef=Task_Init_Core2_QM, OsAppTaskRef=Task_1ms_Core2_QM, OsAppTaskRef=Task_4ms_Core2_QM, OsAppTaskRef=Task_5ms_Core2_QM, OsAppTaskRef=Task_10ms_Core2_QM, OsAppTaskRef=Task_20ms_Core2_QM, OsAppTaskRef=Task_50ms_Core2_QM, OsAppTaskRef=Task_100ms_Core2_QM, OsAppTaskRef=Task_200ms_Core2_QM, OsAppTaskRef=Task_500ms_Core2_QM, OsAppTaskRef=Task_1000ms_Core2_QM, OsApplicationCoreRef=OsCore_CORE2
    3 x OsCore, all with import=NONE:
      OsCore0: OsCoreStartFunction=_start, OsCoreWithAutostart=false, OsMasterCore=false, OsCoreEcucIdRef=OsCore_CORE0, OsCoreIdleTaskRef=Idle_Task_Core0, OsCoreInitTaskRef=Default_Init_Task_Core0, OsCoreSystemApplicationRef=SystemApplication_OsCore_Core0, OsCorePhysicalRef=OsPhysicalCore0, OsCoreMultiCommIsrRef=MultiCommIsr_OsCore_Core0
        OsCoreStacks:
          import = NONE
          OsCoreErrorStackSize = 2048
          OsCoreInitStackSize = 4096
          OsCoreKernelStackSize = 2048
          OsCoreProtectionStackSize = 2048
          OsCoreShutdownStackSize = 2048
          OsCoreStartupStackSize = 2048
        OsCoreMonitors: import=NONE, OsCoreMonitorCounterRef=Os_Monitor_Counter
      OsCore1: OsCoreStartFunction=_start, OsCoreWithAutostart=false, OsMasterCore=false, OsCoreEcucIdRef=OsCore_CORE1, OsCoreIdleTaskRef=Idle_Task_Core1, OsCoreInitTaskRef=Default_Init_Task_Core1, OsCoreSystemApplicationRef=SystemApplication_OsCore_Core1, OsCorePhysicalRef=OsPhysicalCore1, OsCoreMultiCommIsrRef=MultiCommIsr_OsCore_Core1
        OsCoreStacks:
          import = NONE
          OsCoreErrorStackSize = 2048
          OsCoreInitStackSize = 4096
          OsCoreKernelStackSize = 2048
          OsCoreProtectionStackSize = 2048
          OsCoreShutdownStackSize = 2048
          OsCoreStartupStackSize = 2048
        OsCoreMonitors: import=NONE, OsCoreMonitorCounterRef=Os_Monitor_Counter
      OsCore2: OsCoreWithAutostart=true, OsMasterCore=true, OsCoreEcucIdRef=OsCore_CORE2, OsCoreIdleTaskRef=Idle_Task_Core2, OsCoreInitTaskRef=Default_Init_Task_Core2, OsCoreSystemApplicationRef=SystemApplication_OsCore_Core2, OsCorePhysicalRef=OsPhysicalCore2, OsCoreMultiCommIsrRef=MultiCommIsr_OsCore_Core2
        OsCoreStacks:
          import = NONE
          OsCoreErrorStackSize = 2048
          OsCoreInitStackSize = 4096
          OsCoreKernelStackSize = 2048
          OsCoreProtectionStackSize = 2048
          OsCoreShutdownStackSize = 2048
          OsCoreStartupStackSize = 2048
        OsCoreMonitors: import=NONE, OsCoreMonitorCounterRef=Os_Monitor_Counter
    4 x OsCounter, all with import=NONE, OsCounterMinCycle=1, OsCounterTicksPerBase=1, OsCounterType=HARDWARE, OsSecondsPerTick=0.001:
      SystemTimer_Core0: OsCounterMaxAllowedValue=1073741823, OsCounterAccessingApplication=SystemApplication_OsCore_Core0, OsCounterAccessingApplication=App_Application_Core0_QM
        OsDriver: import=NONE, OsDriverHardwareTimerChannelRef=OsHardwareTimerChannel_Pit_Core0, OsDriverIsrRef=CounterIsr_SystemTimer_Core0
        OsTimeConstant0 (OsTimeConstant): import=NONE, OsTimeValue=80000
      SystemTimer_Core1: OsCounterMaxAllowedValue=1073741823, OsCounterAccessingApplication=SystemApplication_OsCore_Core1, OsCounterAccessingApplication=App_Application_Core1_QM
        OsDriver: import=NONE, OsDriverHardwareTimerChannelRef=OsHardwareTimerChannel_Pit_Core1, OsDriverIsrRef=CounterIsr_SystemTimer_Core1
        OsTimeConstant0 (OsTimeConstant): import=NONE, OsTimeValue=80000
      SystemTimer_Core2: OsCounterMaxAllowedValue=1073741823, OsCounterAccessingApplication=SystemApplication_OsCore_Core2, OsCounterAccessingApplication=App_Application_Core2_QM
        OsDriver: import=NONE, OsDriverHardwareTimerChannelRef=OsHardwareTimerChannel_Pit_Core2, OsDriverIsrRef=CounterIsr_SystemTimer_Core2
        OsTimeConstant0 (OsTimeConstant): import=NONE, OsTimeValue=80000
      Os_Monitor_Counter: OsCounterMaxAllowedValue=4294967295, OsCounterAccessingApplication=SystemApplication_OsCore_Core0, OsCounterAccessingApplication=App_Application_Core0_QM
        OsDriver: import=NONE, OsDriverHardwareTimerChannelRef=OsHardwareTimerChannel_Hrt_Core0, OsDriverIsrRef=Os_Monitor_Isr
        OsTimeConstant0 (OsTimeConstant): import=NONE, OsTimeValue=64000
    26 x OsIsr, all with import=NONE:
      CounterIsr_SystemTimer_Core0: OsIsrCategory=CATEGORY_2, OsIsrInterruptSource=226, OsIsrInterruptPriority=59, OsIsrStackSize=1024, OsIsrCallBackFunctionName=OS_PIT
      CounterIsr_SystemTimer_Core1: OsIsrCategory=CATEGORY_2, OsIsrInterruptSource=227, OsIsrInterruptPriority=59, OsIsrStackSize=1024, OsIsrCallBackFunctionName=OS_PIT
      CounterIsr_SystemTimer_Core2: OsIsrCategory=CATEGORY_2, OsIsrInterruptSource=228, OsIsrInterruptPriority=59, OsIsrStackSize=1024, OsIsrCallBackFunctionName=OS_PIT
      MultiCommIsr_OsCore_Core{0..2}: OsIsrCategory=CATEGORY_2, OsIsrInterruptSource={0..2}, OsIsrInterruptPriority=5, OsIsrStackSize=1024, OsIsrCallBackFunctionName=Os_MultiCoreServer_Handler
      Adc89_Grp0_Isr: OsIsrCategory=CATEGORY_2, OsIsrInterruptSource=989, OsIsrInterruptPriority=54, OsIsrStackSize=2048, OsIsrCallBackFunctionName=ADC89_GRP0
      Adc89_Grp1_Isr: OsIsrCategory=CATEGORY_2, OsIsrInterruptSource=990, OsIsrInterruptPriority=54, OsIsrStackSize=2048, OsIsrCallBackFunctionName=ADC89_GRP1
      Adc89_Grp2_Isr: OsIsrCategory=CATEGORY_2, OsIsrInterruptSource=991, OsIsrInterruptPriority=54, OsIsrStackSize=1024, OsIsrCallBackFunctionName=ADC89_GRP2
      Adc89_Grp3_Isr: OsIsrCategory=CATEGORY_2, OsIsrInterruptSource=992, OsIsrInterruptPriority=54, OsIsrStackSize=1024, OsIsrCallBackFunctionName=ADC89_GRP3
      Adc89_Grp4_Isr: OsIsrCategory=CATEGORY_2, OsIsrInterruptSource=993, OsIsrInterruptPriority=54, OsIsrStackSize=1024, OsIsrCallBackFunctionName=ADC89_GRP4
      Adc89_Grp5_Isr: OsIsrCategory=CATEGORY_2, OsIsrInterruptSource=994, OsIsrInterruptPriority=54, OsIsrStackSize=1024, OsIsrCallBackFunctionName=ADC89_GRP5
      Can1_Isr: OsIsrCategory=CATEGORY_2, OsIsrInterruptSource=688, OsIsrInterruptPriority=11, OsIsrStackSize=1024, OsIsrCallBackFunctionName=Can1_Isr_Handler
      Can2_Isr: OsIsrCategory=CATEGORY_2, OsIsrInterruptSource=445, OsIsrInterruptPriority=12, OsIsrStackSize=1024, OsIsrCallBackFunctionName=Can2_Isr_Handler
      Can3_Isr: OsIsrCategory=CATEGORY_2, OsIsrInterruptSource=447, OsIsrInterruptPriority=13, OsIsrStackSize=1024, OsIsrCallBackFunctionName=Can3_Isr_Handler
      Can4_Isr: OsIsrCategory=CATEGORY_2, OsIsrInterruptSource=449, OsIsrInterruptPriority=14, OsIsrStackSize=1024, OsIsrCallBackFunctionName=Can4_Isr_Handler
      FlashDone_Isr: OsIsrCategory=CATEGORY_2, OsIsrInterruptSource=185, OsIsrInterruptPriority=22, OsIsrStackSize=1024, OsIsrCallBackFunctionName=FLASH_Cmd_Done_ISR
      Os_Monitor_Isr: OsIsrCategory=CATEGORY_2, OsIsrInterruptSource=36, OsIsrInterruptPriority=9, OsIsrStackSize=1024, OsIsrCallBackFunctionName=OS_HRT
      PIT0_CH4: OsIsrCategory=CATEGORY_2, OsIsrInterruptSource=230, OsIsrInterruptPriority=38, OsIsrStackSize=1024, OsIsrCallBackFunctionName=PIT0_CH4_ISR
      PIT0_CH5: OsIsrCategory=CATEGORY_2, OsIsrInterruptSource=231, OsIsrInterruptPriority=38, OsIsrStackSize=1024, OsIsrCallBackFunctionName=PIT0_CH5_ISR
      PIT0_CH6: OsIsrCategory=CATEGORY_2, OsIsrInterruptSource=232, OsIsrInterruptPriority=38, OsIsrStackSize=1024, OsIsrCallBackFunctionName=PIT0_CH6_ISR
      GTM_ATOM10: OsIsrCategory=CATEGORY_1, OsIsrInterruptSource=841, OsIsrInterruptPriority=60, OsIsrStackSize=1024, OsIsrCallBackFunctionName=GTM_ATOM10_ISRfunc
      GTM_ATOM40: OsIsrCategory=CATEGORY_1, OsIsrInterruptSource=853, OsIsrInterruptPriority=60, OsIsrStackSize=4096, OsIsrCallBackFunctionName=GTM_ATOM40_ISRfunc
      SIUL_External_Interrupt_0: OsIsrCategory=CATEGORY_1, OsIsrInterruptSource=243, OsIsrInterruptPriority=61, OsIsrStackSize=1024, OsIsrCallBackFunctionName=SIUL_External_0_ISRFunc
      SIUL_External_Interrupt_1: OsIsrCategory=CATEGORY_1, OsIsrInterruptSource=244, OsIsrInterruptPriority=61, OsIsrStackSize=1024, OsIsrCallBackFunctionName=SIUL_External_1_ISRFunc
      EDMA_CH80: OsIsrCategory=CATEGORY_1, OsIsrInterruptSource=133, OsIsrInterruptPriority=60, OsIsrStackSize=1024, OsIsrCallBackFunctionName=EDMA_Ch80_IRQHandler
    OsOS: import=NONE, OsNumberOfCores=3, OsScalabilityClass=SC1, OsStackMonitoring=true, OsFpuUsage=ALL, OsMonitorEnable=true
      OsHooks: import=NONE, OsErrorHook=true, OsProtectionHook=false, OsShutdownHook=true, OsStartupHook=false
    OsPublishedInformation: import=NONE
      CCFC3008: import=NONE
        3 x OsPhysicalCore, all with import=NONE:
          OsPhysicalCore0: OsPhysicalCoreId=0
            OsPhysicalCoreMpu0 (OsPhysicalCoreMpu): import=NONE, OsPhysicalCoreMpuId=0, OsPhysicalCoreMpuType=DATA, OsPhysicalCoreMpuMaxRegions=12
          OsPhysicalCore1: OsPhysicalCoreId=1
            OsPhysicalCoreMpu1 (OsPhysicalCoreMpu): import=NONE, OsPhysicalCoreMpuId=0, OsPhysicalCoreMpuType=DATA, OsPhysicalCoreMpuMaxRegions=12
          OsPhysicalCore2: OsPhysicalCoreId=2
            OsPhysicalCoreMpu2 (OsPhysicalCoreMpu): import=NONE, OsPhysicalCoreMpuId=0, OsPhysicalCoreMpuType=DATA, OsPhysicalCoreMpuMaxRegions=12
        4 x OsHardwareTimer, all with import=NONE:
          OsHardwareTimer_Pit0: OsHardwareTimerUnit=PIT, OsHardwareTimerId=0
            3 x OsHardwareTimerChannel, all with import=NONE:
              OsHardwareTimerChannel_Pit_Core{0..2}: OsHardwareTimerChannelId={0..2}
          OsHardwareTimer_Pit1: OsHardwareTimerUnit=PIT, OsHardwareTimerId=1
          OsHardwareTimer_Hrt0: OsHardwareTimerUnit=HRT, OsHardwareTimerId=0
            3 x OsHardwareTimerChannel, all with import=NONE:
              OsHardwareTimerChannel_Hrt_Core{0..2}: OsHardwareTimerChannelId={0..2}
          OsHardwareTimer_Hrt1: OsHardwareTimerUnit=HRT, OsHardwareTimerId=1
            3 x OsHardwareTimerChannel, all with import=NONE:
              OsHardwareTimerChannel_Tp_Core{0..2}: OsHardwareTimerChannelId={0..2}
    3 x OsResource, all with import=NONE:
      Core{0..2}_Task_OsResource{0..2}: OsResourceAccessingApplication=App_Application_Core{0..2}_QM
    35 x OsTask, all with import=NONE, OsTaskActivation=100, OsTaskType=BASIC:
      Default_Init_Task_Core0: OsTaskPriority=100, OsTaskSchedule=NON, OsTaskStackSize=1024, OsTaskAccessingApplication=SystemApplication_OsCore_Core0, OsTaskAccessingApplication=App_Application_Core0_QM
        OsTaskAutostart: import=NONE, OsTaskAppModeRef=OS_APPMODE_ANY
      Idle_Task_Core0: OsTaskPriority=0, OsTaskSchedule=FULL, OsTaskStackSize=2048, OsTaskAccessingApplication=SystemApplication_OsCore_Core0, OsTaskAccessingApplication=App_Application_Core0_QM
        OsTaskAutostart: import=NONE, OsTaskAppModeRef=OS_APPMODE_ANY
      Task_Init_Core0_QM: OsTaskPriority=99, OsTaskSchedule=NON, OsTaskStackSize=1024, OsTaskAccessingApplication=SystemApplication_OsCore_Core0, OsTaskAccessingApplication=App_Application_Core0_QM
      Task_2ms_Core0_QM: OsTaskPriority=97, OsTaskSchedule=FULL, OsTaskStackSize=4096, OsTaskAccessingApplication=SystemApplication_OsCore_Core0, OsTaskAccessingApplication=App_Application_Core0_QM, OsTaskResourceRef=Core0_Task_OsResource0
      Task_10ms_Core0_QM: OsTaskPriority=96, OsTaskSchedule=FULL, OsTaskStackSize=4096, OsTaskAccessingApplication=SystemApplication_OsCore_Core0, OsTaskAccessingApplication=App_Application_Core0_QM
      Task_20ms_Core0_QM: OsTaskPriority=95, OsTaskSchedule=FULL, OsTaskStackSize=1024, OsTaskAccessingApplication=SystemApplication_OsCore_Core0, OsTaskAccessingApplication=App_Application_Core0_QM
      Task_50ms_Core0_QM: OsTaskPriority=94, OsTaskSchedule=FULL, OsTaskStackSize=1024, OsTaskAccessingApplication=SystemApplication_OsCore_Core0, OsTaskAccessingApplication=App_Application_Core0_QM
      Task_100ms_Core0_QM: OsTaskPriority=93, OsTaskSchedule=FULL, OsTaskStackSize=1024, OsTaskAccessingApplication=SystemApplication_OsCore_Core0, OsTaskAccessingApplication=App_Application_Core0_QM
      Task_200ms_Core0_QM: OsTaskPriority=92, OsTaskSchedule=FULL, OsTaskStackSize=1024, OsTaskAccessingApplication=SystemApplication_OsCore_Core0, OsTaskAccessingApplication=App_Application_Core0_QM
      Task_500ms_Core0_QM: OsTaskPriority=91, OsTaskSchedule=FULL, OsTaskStackSize=1024, OsTaskAccessingApplication=SystemApplication_OsCore_Core0, OsTaskAccessingApplication=App_Application_Core0_QM
      Task_1000ms_Core0_QM: OsTaskPriority=90, OsTaskSchedule=FULL, OsTaskStackSize=1024, OsTaskAccessingApplication=SystemApplication_OsCore_Core0, OsTaskAccessingApplication=App_Application_Core0_QM
      Default_Init_Task_Core1: OsTaskPriority=100, OsTaskSchedule=NON, OsTaskStackSize=1024, OsTaskAccessingApplication=SystemApplication_OsCore_Core1, OsTaskAccessingApplication=App_Application_Core1_QM
        OsTaskAutostart: import=NONE, OsTaskAppModeRef=OS_APPMODE_ANY
      Idle_Task_Core1: OsTaskPriority=0, OsTaskSchedule=FULL, OsTaskStackSize=2048, OsTaskAccessingApplication=SystemApplication_OsCore_Core1, OsTaskAccessingApplication=App_Application_Core1_QM
        OsTaskAutostart: import=NONE, OsTaskAppModeRef=OS_APPMODE_ANY
      Task_Init_Core1_QM: OsTaskPriority=99, OsTaskSchedule=NON, OsTaskStackSize=1024, OsTaskAccessingApplication=SystemApplication_OsCore_Core1, OsTaskAccessingApplication=App_Application_Core1_QM
      Task_5ms_Core1_QM: OsTaskPriority=97, OsTaskSchedule=FULL, OsTaskStackSize=1024, OsTaskAccessingApplication=SystemApplication_OsCore_Core1, OsTaskAccessingApplication=App_Application_Core1_QM, OsTaskResourceRef=Core1_Task_OsResource1
      Task_10ms_Core1_QM: OsTaskPriority=96, OsTaskSchedule=FULL, OsTaskStackSize=1024, OsTaskAccessingApplication=SystemApplication_OsCore_Core1, OsTaskAccessingApplication=App_Application_Core1_QM
      Task_20ms_Core1_QM: OsTaskPriority=95, OsTaskSchedule=FULL, OsTaskStackSize=1024, OsTaskAccessingApplication=SystemApplication_OsCore_Core1, OsTaskAccessingApplication=App_Application_Core1_QM
      Task_50ms_Core1_QM: OsTaskPriority=94, OsTaskSchedule=FULL, OsTaskStackSize=1024, OsTaskAccessingApplication=SystemApplication_OsCore_Core1, OsTaskAccessingApplication=App_Application_Core1_QM
      Task_100ms_Core1_QM: OsTaskPriority=93, OsTaskSchedule=FULL, OsTaskStackSize=1024, OsTaskAccessingApplication=SystemApplication_OsCore_Core1, OsTaskAccessingApplication=App_Application_Core1_QM
      Task_200ms_Core1_QM: OsTaskPriority=92, OsTaskSchedule=FULL, OsTaskStackSize=1024, OsTaskAccessingApplication=SystemApplication_OsCore_Core1, OsTaskAccessingApplication=App_Application_Core1_QM
      Task_500ms_Core1_QM: OsTaskPriority=91, OsTaskSchedule=FULL, OsTaskStackSize=1024, OsTaskAccessingApplication=SystemApplication_OsCore_Core1, OsTaskAccessingApplication=App_Application_Core1_QM
      Task_1000ms_Core1_QM: OsTaskPriority=90, OsTaskSchedule=FULL, OsTaskStackSize=1024, OsTaskAccessingApplication=SystemApplication_OsCore_Core1, OsTaskAccessingApplication=App_Application_Core1_QM
      Default_Init_Task_Core2: OsTaskPriority=100, OsTaskSchedule=NON, OsTaskStackSize=1024, OsTaskAccessingApplication=SystemApplication_OsCore_Core2, OsTaskAccessingApplication=App_Application_Core2_QM
        OsTaskAutostart: import=NONE, OsTaskAppModeRef=OS_APPMODE_ANY
      Idle_Task_Core2: OsTaskPriority=0, OsTaskSchedule=FULL, OsTaskStackSize=1024, OsTaskAccessingApplication=SystemApplication_OsCore_Core2, OsTaskAccessingApplication=App_Application_Core2_QM
        OsTaskAutostart: import=NONE, OsTaskAppModeRef=OS_APPMODE_ANY
      Task_Init_Core2_QM: OsTaskPriority=99, OsTaskSchedule=NON, OsTaskStackSize=1024, OsTaskAccessingApplication=SystemApplication_OsCore_Core2, OsTaskAccessingApplication=App_Application_Core2_QM
      Task_1ms_Core2_QM: OsTaskPriority=98, OsTaskSchedule=FULL, OsTaskStackSize=1024, OsTaskAccessingApplication=SystemApplication_OsCore_Core2, OsTaskAccessingApplication=App_Application_Core2_QM
      Task_4ms_Core2_QM: OsTaskPriority=97, OsTaskSchedule=FULL, OsTaskStackSize=1024, OsTaskAccessingApplication=SystemApplication_OsCore_Core2, OsTaskAccessingApplication=App_Application_Core2_QM
      Task_5ms_Core2_QM: OsTaskPriority=96, OsTaskSchedule=FULL, OsTaskStackSize=4096, OsTaskAccessingApplication=SystemApplication_OsCore_Core2, OsTaskAccessingApplication=App_Application_Core2_QM, OsTaskResourceRef=Core2_Task_OsResource2
      Task_10ms_Core2_QM: OsTaskPriority=95, OsTaskSchedule=FULL, OsTaskStackSize=2048, OsTaskAccessingApplication=SystemApplication_OsCore_Core2, OsTaskAccessingApplication=App_Application_Core2_QM
      Task_20ms_Core2_QM: OsTaskPriority=94, OsTaskSchedule=FULL, OsTaskStackSize=1024, OsTaskAccessingApplication=SystemApplication_OsCore_Core2, OsTaskAccessingApplication=App_Application_Core2_QM
      Task_50ms_Core2_QM: OsTaskPriority=93, OsTaskSchedule=FULL, OsTaskStackSize=1024, OsTaskAccessingApplication=SystemApplication_OsCore_Core2, OsTaskAccessingApplication=App_Application_Core2_QM
      Task_100ms_Core2_QM: OsTaskPriority=92, OsTaskSchedule=FULL, OsTaskStackSize=1024, OsTaskAccessingApplication=SystemApplication_OsCore_Core2, OsTaskAccessingApplication=App_Application_Core2_QM
      Task_200ms_Core2_QM: OsTaskPriority=91, OsTaskSchedule=FULL, OsTaskStackSize=1024, OsTaskAccessingApplication=SystemApplication_OsCore_Core2, OsTaskAccessingApplication=App_Application_Core2_QM
      Task_500ms_Core2_QM: OsTaskPriority=90, OsTaskSchedule=FULL, OsTaskStackSize=1024, OsTaskAccessingApplication=SystemApplication_OsCore_Core2, OsTaskAccessingApplication=App_Application_Core2_QM
      Task_1000ms_Core2_QM: OsTaskPriority=89, OsTaskSchedule=FULL, OsTaskStackSize=1024, OsTaskAccessingApplication=SystemApplication_OsCore_Core2, OsTaskAccessingApplication=App_Application_Core2_QM
