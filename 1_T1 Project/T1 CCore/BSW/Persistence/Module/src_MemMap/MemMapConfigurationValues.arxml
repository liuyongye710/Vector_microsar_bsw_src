AUTOSAR XML
package /ActiveEcuC
  module config MemMap
    50 x MemMapAllocation, all with import=NONE:
      BswM
      CanIf
      CanNm
      CanSM
      CanTp
      Com
      ComM
      Crc
      Dcm
      Dem
      Det
      DoIP
      E2E
      EcuM
      EthIf
      EthSM
      Fee
      FiM
      IpduM
      J1939Tp
      LdCom
      LinIf
      LinNm
      LinSM
      MemIf
      Nm
      NvM
      PduR
      Sd
      SoAd
      TcpIp
      UdpNm
      WdgIf
      WdgM
      Xcp
      FrIf
      FrNm
      FrSM
      Rte
      CanTrcv
      StbM
      SomeIpTp
      SomeIpXf
      SecOC
      KeyM
      Csm
      CryIf
      CanTSyn
      EcuC
      NeuLib
