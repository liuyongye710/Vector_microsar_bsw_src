AUTOSAR XML
package /ActiveEcuC
  module config J1939Tp
    J1939TpConfiguration: import=NONE
      6 x J1939TpTxChannel, all with import=COMM_IMPORT, J1939TpTxCancellationSupport=true, J1939TpTxDynamicBlockCalculation=false, J1939TpTxMaxPacketsPerBlock=255, J1939TpTxProtocolType=J1939TP_PROTOCOL_BAM, J1939TpTxRetrySupport=true:
        ECMC_DM1MCU_D3_sO0: J1939TpTxSa=239
          J1939TpTxCmNPdu: import=COMM_IMPORT, J1939TpTxCmNPduTxConfId=8, J1939TpTxCmNPduRef=TPCMBAMMCU_D3_sO0
          J1939TpTxDtNPdu: import=COMM_IMPORT, J1939TpTxDtNPduTxConfId=9, J1939TpTxDtNPduRef=TPDTMCU_D3_sO0
          J1939TpTxPg_ECMC (J1939TpTxPg): import=COMM_IMPORT, J1939TpTxPgDynLength=false, J1939TpTxPgPGN=65251
            J1939TpTxNSdu: import=COMM_IMPORT, J1939TpTxNSduId=1, J1939TpTxNSduRef=ECMCU_D3_sO0
          J1939TpTxPg_DM1MCU (J1939TpTxPg): import=NONE, J1939TpTxPgDynLength=false, J1939TpTxPgPGN=65226
            J1939TpTxNSdu: import=NONE, J1939TpTxNSduId=6, J1939TpTxNSduRef=DM1MCU_D3_sO0
        DM1MCU2_D3_sO0: J1939TpTxSa=240
          J1939TpTxCmNPdu: import=COMM_IMPORT, J1939TpTxCmNPduTxConfId=6, J1939TpTxCmNPduRef=TPCMBAMMCU2_D3_sO0
          J1939TpTxDtNPdu: import=COMM_IMPORT, J1939TpTxDtNPduTxConfId=7, J1939TpTxDtNPduRef=TPDTMCU2_D3_sO0
          J1939TpTxPg: import=COMM_IMPORT, J1939TpTxPgDynLength=false, J1939TpTxPgPGN=65226
            J1939TpTxNSdu: import=COMM_IMPORT, J1939TpTxNSduId=7, J1939TpTxNSduRef=DM1MCU2_D3_sO0
        DM1APCU_OjcG_c: J1939TpTxSa=48
          J1939TpTxCmNPdu: import=COMM_IMPORT, J1939TpTxCmNPduTxConfId=27, J1939TpTxCmNPduRef=TPCMBAMAPCU_OjcG_c
          J1939TpTxDtNPdu: import=COMM_IMPORT, J1939TpTxDtNPduTxConfId=28, J1939TpTxDtNPduRef=TPDTAPCU_OjcG_c
          J1939TpTxPg: import=COMM_IMPORT, J1939TpTxPgDynLength=false, J1939TpTxPgPGN=65226
            J1939TpTxNSdu: import=COMM_IMPORT, J1939TpTxNSduId=30, J1939TpTxNSduRef=DM1APCU_OjcG_c
        DM1DCDC_OjcG_c: J1939TpTxSa=26
          J1939TpTxCmNPdu: import=COMM_IMPORT, J1939TpTxCmNPduTxConfId=23, J1939TpTxCmNPduRef=TPCMBAMDCDC_OjcG_c
          J1939TpTxDtNPdu: import=COMM_IMPORT, J1939TpTxDtNPduTxConfId=24, J1939TpTxDtNPduRef=TPDTDCDC_OjcG_c
          J1939TpTxPg: import=COMM_IMPORT, J1939TpTxPgDynLength=false, J1939TpTxPgPGN=65226
            J1939TpTxNSdu: import=COMM_IMPORT, J1939TpTxNSduId=32, J1939TpTxNSduRef=DM1DCDC_OjcG_c
        DM1OPCU_OjcG_c: J1939TpTxSa=46
          J1939TpTxCmNPdu: import=COMM_IMPORT, J1939TpTxCmNPduTxConfId=25, J1939TpTxCmNPduRef=TPCMBAMOPCU_OjcG_c
          J1939TpTxDtNPdu: import=COMM_IMPORT, J1939TpTxDtNPduTxConfId=26, J1939TpTxDtNPduRef=TPDTOPCU_OjcG_c
          J1939TpTxPg: import=COMM_IMPORT, J1939TpTxPgDynLength=false, J1939TpTxPgPGN=65226
            J1939TpTxNSdu: import=COMM_IMPORT, J1939TpTxNSduId=33, J1939TpTxNSduRef=DM1OPCU_OjcG_c
        DM1PTU_OjcG_c: J1939TpTxSa=96
          J1939TpTxCmNPdu: import=COMM_IMPORT, J1939TpTxCmNPduTxConfId=29, J1939TpTxCmNPduRef=TPCMBAMPTU_OjcG_c
          J1939TpTxDtNPdu: import=COMM_IMPORT, J1939TpTxDtNPduTxConfId=30, J1939TpTxDtNPduRef=TPDTPTU_OjcG_c
          J1939TpTxPg: import=COMM_IMPORT, J1939TpTxPgDynLength=false, J1939TpTxPgPGN=65226
            J1939TpTxNSdu: import=COMM_IMPORT, J1939TpTxNSduId=40, J1939TpTxNSduRef=DM1PTU_OjcG_c
    J1939TpGeneral:
      import = NONE
      J1939TpCancellationSupport = true
      J1939TpDevErrorDetect = true
      J1939TpMainFunctionPeriod = 0.005
      J1939TpTxConfTimeout = 1
      J1939TpVersionInfoApi = true
