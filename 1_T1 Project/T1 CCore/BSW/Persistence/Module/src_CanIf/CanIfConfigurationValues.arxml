AUTOSAR XML
package /ActiveEcuC
  module config CanIf
    Can (CanIfCtrlDrvCfg): import=COMM_IMPORT
      5 x CanIfCtrlCfg:
        CAN_Matrix_DCDC_V0_1_20250414_VR82BV: import=COMM_IMPORT, CanIfCtrlId=0, CanIfCtrlCanCtrlRef=CAN_Matrix_DCDC_V0_1_20250414_VR82BV
        CanIfCtrlCfg1: import=NONE, CanIfCtrlId=1, CanIfCtrlCanCtrlRef=CanController1
        FAW_MCD_MCU_CAN_V1_4_1_D3_sO0: import=COMM_IMPORT, CanIfCtrlId=2, CanIfCtrlCanCtrlRef=FAW_MCD_MCU_CAN_V1_4_1_D3_sO0
        FAW2_MCD_MCU_CAN_DBC_V0_1_CHL_20241216_Voxyrf: import=COMM_IMPORT, CanIfCtrlId=3, CanIfCtrlCanCtrlRef=FAW2_MCD_MCU_CAN_DBC_V0_1_CHL_20241216_Voxyrf
        FAW3_HVAC_V2_0DBC_OjcG_c: import=COMM_IMPORT, CanIfCtrlId=4, CanIfCtrlCanCtrlRef=FAW3_HVAC_V2_0DBC_OjcG_c
    CanIfDispatchCfg:
      import = NONE
      CanIfDispatchUserClearTrcvWufFlagIndicationName = CanSM_ClearTrcvWufFlagIndication
      CanIfDispatchUserClearTrcvWufFlagIndicationUL = CAN_SM
      CanIfDispatchUserConfirmPnAvailabilityName = CanSM_ConfirmPnAvailability
      CanIfDispatchUserConfirmPnAvailabilityUL = CAN_SM
      CanIfDispatchUserCtrlBusOffName = CanSM_ControllerBusOff
      CanIfDispatchUserCtrlBusOffUL = CAN_SM
      CanIfDispatchUserCtrlModeIndicationName = CanSM_ControllerModeIndication
      CanIfDispatchUserCtrlModeIndicationUL = CAN_SM
      CanIfDispatchUserTrcvModeIndicationName = CanSM_TransceiverModeIndication
      CanIfDispatchUserTrcvModeIndicationUL = CAN_SM
      CanIfDispatchUserValidateWakeupEventName = EcuM_ValidateWakeupEvent
      CanIfDispatchUserValidateWakeupEventUL = ECUM
    CanIfInitCfg: import=NONE
      4 x CanIfBufferCfg, all with import=COMM_IMPORT:
        CAN_Matrix_DCDC_V0_1_20250414_VR82BV_Basic_Tx: CanIfBufferSize=2, CanIfBufferHthRef=CAN0_Tx
        FAW_MCD_MCU_CAN_V1_4_1_D3_sO0_Basic_Tx: CanIfBufferSize=13, CanIfBufferHthRef=CAN2_Tx
        FAW2_MCD_MCU_CAN_DBC_V0_1_CHL_20241216_Voxyrf_Basic_Tx: CanIfBufferSize=15, CanIfBufferHthRef=CAN3_Tx
        FAW3_HVAC_V2_0DBC_OjcG_c_Basic_Tx: CanIfBufferSize=21, CanIfBufferHthRef=CAN4_Tx
      CanIfInitHohCfg: import=COMM_IMPORT
        14 x CanIfHrhCfg, all with import=COMM_IMPORT:
          DCDC_Status_CAN0_Rx: CanIfHrhCanCtrlIdRef=CAN_Matrix_DCDC_V0_1_20250414_VR82BV, CanIfHrhIdSymRef=DCDC_Status_CAN0_Rx
          AMT3_CAN2_Rx: CanIfHrhCanCtrlIdRef=FAW_MCD_MCU_CAN_V1_4_1_D3_sO0, CanIfHrhIdSymRef=AMT3_CAN2_Rx
          CCVSHCU_CAN2_Rx: CanIfHrhCanCtrlIdRef=FAW_MCD_MCU_CAN_V1_4_1_D3_sO0, CanIfHrhIdSymRef=CCVSHCU_CAN2_Rx
          EEC2HCU_ETC1_CAN2_Rx: CanIfHrhCanCtrlIdRef=FAW_MCD_MCU_CAN_V1_4_1_D3_sO0, CanIfHrhIdSymRef=EEC2HCU_ETC1_CAN2_Rx
          ETC2_SC_CAN2_Rx: CanIfHrhCanCtrlIdRef=FAW_MCD_MCU_CAN_V1_4_1_D3_sO0, CanIfHrhIdSymRef=ETC2_SC_CAN2_Rx
          HCUMCU_CAN2_Rx: CanIfHrhCanCtrlIdRef=FAW_MCD_MCU_CAN_V1_4_1_D3_sO0, CanIfHrhIdSymRef=HCUMCU_CAN2_Rx
          TC_TSC_CAN2_Rx: CanIfHrhCanCtrlIdRef=FAW_MCD_MCU_CAN_V1_4_1_D3_sO0, CanIfHrhIdSymRef=TC_TSC_CAN2_Rx
          MCU_Rx_Data_1_CAN3_Rx: CanIfHrhCanCtrlIdRef=FAW2_MCD_MCU_CAN_DBC_V0_1_CHL_20241216_Voxyrf, CanIfHrhIdSymRef=MCU_Rx_Data_1_CAN3_Rx
          MCU_Rx_Data_2_CAN3_Rx: CanIfHrhCanCtrlIdRef=FAW2_MCD_MCU_CAN_DBC_V0_1_CHL_20241216_Voxyrf, CanIfHrhIdSymRef=MCU_Rx_Data_2_CAN3_Rx
          XCP_Request_CAN3_Rx: CanIfHrhCanCtrlIdRef=FAW2_MCD_MCU_CAN_DBC_V0_1_CHL_20241216_Voxyrf, CanIfHrhIdSymRef=XCP_Request_CAN3_Rx
          GL_Rx_REQ_CAN3_Rx: CanIfHrhCanCtrlIdRef=FAW2_MCD_MCU_CAN_DBC_V0_1_CHL_20241216_Voxyrf, CanIfHrhIdSymRef=GL_Rx_REQ_CAN3_Rx
          HCU_OPCU_DCDC_CAN4_Rx: CanIfHrhCanCtrlIdRef=FAW3_HVAC_V2_0DBC_OjcG_c, CanIfHrhIdSymRef=HCU_OPCU_DCDC_CAN4_Rx
          HCU_APCU_3_CAN4_Rx: CanIfHrhCanCtrlIdRef=FAW3_HVAC_V2_0DBC_OjcG_c, CanIfHrhIdSymRef=HCU_APCU_3_CAN4_Rx
          BMS5_MCU2_CAN4_Rx: CanIfHrhCanCtrlIdRef=FAW3_HVAC_V2_0DBC_OjcG_c, CanIfHrhIdSymRef=BMS5_MCU2_CAN4_Rx
        4 x CanIfHthCfg, all with import=COMM_IMPORT:
          CAN0_Tx: CanIfHthCanCtrlIdRef=CAN_Matrix_DCDC_V0_1_20250414_VR82BV, CanIfHthIdSymRef=CAN0_Tx
          CAN2_Tx: CanIfHthCanCtrlIdRef=FAW_MCD_MCU_CAN_V1_4_1_D3_sO0, CanIfHthIdSymRef=CAN2_Tx
          CAN3_Tx: CanIfHthCanCtrlIdRef=FAW2_MCD_MCU_CAN_DBC_V0_1_CHL_20241216_Voxyrf, CanIfHthIdSymRef=CAN3_Tx
          CAN4_Tx: CanIfHthCanCtrlIdRef=FAW3_HVAC_V2_0DBC_OjcG_c, CanIfHthIdSymRef=CAN4_Tx
      25 x CanIfRxPduCfg, all with import=COMM_IMPORT, CanIfRxPduDlc=8:
        TSC1Mtr_D3_sO0: CanIfRxPduCanId=201336579, CanIfRxPduCanIdMask=536870911, CanIfRxPduCanIdType=EXTENDED_CAN, CanIfRxPduId=0, CanIfRxPduUserRxIndicationUL=PDUR, CanIfRxPduHrhIdRef=TC_TSC_CAN2_Rx, CanIfRxPduRef=TSC1Mtr_D3_sO0
        EEC2HCU_D3_sO0: CanIfRxPduCanId=217056039, CanIfRxPduCanIdMask=536870911, CanIfRxPduCanIdType=EXTENDED_CAN, CanIfRxPduId=1, CanIfRxPduUserRxIndicationUL=PDUR, CanIfRxPduHrhIdRef=EEC2HCU_ETC1_CAN2_Rx, CanIfRxPduRef=EEC2HCU_D3_sO0
        CCVSHCU_D3_sO0: CanIfRxPduCanId=419361063, CanIfRxPduCanIdMask=536870911, CanIfRxPduCanIdType=EXTENDED_CAN, CanIfRxPduId=2, CanIfRxPduUserRxIndicationUL=PDUR, CanIfRxPduHrhIdRef=CCVSHCU_CAN2_Rx, CanIfRxPduRef=CCVSHCU_D3_sO0
        TC1_D3_sO0: CanIfRxPduCanId=201392935, CanIfRxPduCanIdMask=536870911, CanIfRxPduCanIdType=EXTENDED_CAN, CanIfRxPduId=3, CanIfRxPduUserRxIndicationUL=PDUR, CanIfRxPduHrhIdRef=TC_TSC_CAN2_Rx, CanIfRxPduRef=TC1_D3_sO0
        TC1Handle_D3_sO0: CanIfRxPduCanId=201392133, CanIfRxPduCanIdMask=536870911, CanIfRxPduCanIdType=EXTENDED_CAN, CanIfRxPduId=4, CanIfRxPduUserRxIndicationUL=PDUR, CanIfRxPduHrhIdRef=TC_TSC_CAN2_Rx, CanIfRxPduRef=TC1Handle_D3_sO0
        ETC1_D3_sO0: CanIfRxPduCanId=217055747, CanIfRxPduCanIdMask=536870911, CanIfRxPduCanIdType=EXTENDED_CAN, CanIfRxPduId=5, CanIfRxPduUserRxIndicationUL=PDUR, CanIfRxPduHrhIdRef=EEC2HCU_ETC1_CAN2_Rx, CanIfRxPduRef=ETC1_D3_sO0
        ETC2_D3_sO0: CanIfRxPduCanId=418383107, CanIfRxPduCanIdMask=536870911, CanIfRxPduCanIdType=EXTENDED_CAN, CanIfRxPduId=6, CanIfRxPduUserRxIndicationUL=PDUR, CanIfRxPduHrhIdRef=ETC2_SC_CAN2_Rx, CanIfRxPduRef=ETC2_D3_sO0
        AMT3_D3_sO0: CanIfRxPduCanId=419390723, CanIfRxPduCanIdMask=536870911, CanIfRxPduCanIdType=EXTENDED_CAN, CanIfRxPduId=7, CanIfRxPduUserRxIndicationUL=PDUR, CanIfRxPduHrhIdRef=AMT3_CAN2_Rx, CanIfRxPduRef=AMT3_D3_sO0
        HCUMCU_D3_sO0: CanIfRxPduCanId=201262375, CanIfRxPduCanIdMask=536870911, CanIfRxPduCanIdType=EXTENDED_CAN, CanIfRxPduId=8, CanIfRxPduUserRxIndicationUL=PDUR, CanIfRxPduHrhIdRef=HCUMCU_CAN2_Rx, CanIfRxPduRef=HCUMCU_D3_sO0
        HCUMCU2_D3_sO0: CanIfRxPduCanId=201298727, CanIfRxPduCanIdMask=536870911, CanIfRxPduCanIdType=EXTENDED_CAN, CanIfRxPduId=9, CanIfRxPduUserRxIndicationUL=PDUR, CanIfRxPduHrhIdRef=HCUMCU_CAN2_Rx, CanIfRxPduRef=HCUMCU2_D3_sO0
        SC_D3_sO0: CanIfRxPduCanId=419365415, CanIfRxPduCanIdMask=536870911, CanIfRxPduCanIdType=EXTENDED_CAN, CanIfRxPduId=10, CanIfRxPduUserRxIndicationUL=PDUR, CanIfRxPduHrhIdRef=ETC2_SC_CAN2_Rx, CanIfRxPduRef=SC_D3_sO0
        TSC1Mtr2_D3_sO0: CanIfRxPduCanId=201336580, CanIfRxPduCanIdMask=536870911, CanIfRxPduCanIdType=EXTENDED_CAN, CanIfRxPduId=11, CanIfRxPduUserRxIndicationUL=PDUR, CanIfRxPduHrhIdRef=TC_TSC_CAN2_Rx, CanIfRxPduRef=TSC1Mtr2_D3_sO0
        GL_Rx_REQ_Voxyrf: CanIfRxPduCanId=2042, CanIfRxPduCanIdMask=2047, CanIfRxPduCanIdType=STANDARD_CAN, CanIfRxPduId=12, CanIfRxPduUserRxIndicationName=T1_RxIndication, CanIfRxPduUserRxIndicationUL=CDD, CanIfRxPduHrhIdRef=GL_Rx_REQ_CAN3_Rx, CanIfRxPduRef=GL_Rx_REQ_Voxyrf
        XCP_Request_Voxyrf: CanIfRxPduCanId=1952, CanIfRxPduCanIdMask=2047, CanIfRxPduCanIdType=STANDARD_CAN, CanIfRxPduId=13, CanIfRxPduUserRxIndicationUL=XCP, CanIfRxPduHrhIdRef=XCP_Request_CAN3_Rx, CanIfRxPduRef=XCP_Request_Voxyrf
        MCU_Rx_Data_2_Voxyrf: CanIfRxPduCanId=417066993, CanIfRxPduCanIdMask=536870911, CanIfRxPduCanIdType=EXTENDED_CAN, CanIfRxPduId=14, CanIfRxPduUserRxIndicationUL=CAN_TP, CanIfRxPduHrhIdRef=MCU_Rx_Data_2_CAN3_Rx, CanIfRxPduRef=MCU_Rx_Data_2_Voxyrf
        MCU_Rx_Data_1_Voxyrf: CanIfRxPduCanId=417001457, CanIfRxPduCanIdMask=536870911, CanIfRxPduCanIdType=EXTENDED_CAN, CanIfRxPduId=15, CanIfRxPduUserRxIndicationUL=CAN_TP, CanIfRxPduHrhIdRef=MCU_Rx_Data_1_CAN3_Rx, CanIfRxPduRef=MCU_Rx_Data_1_Voxyrf
        DCDC_Status1_VR82BV: CanIfRxPduCanId=770, CanIfRxPduCanIdMask=2047, CanIfRxPduCanIdType=STANDARD_CAN, CanIfRxPduId=16, CanIfRxPduUserRxIndicationUL=PDUR, CanIfRxPduHrhIdRef=DCDC_Status_CAN0_Rx, CanIfRxPduRef=DCDC_Status1_VR82BV
        DCDC_Status2_VR82BV: CanIfRxPduCanId=771, CanIfRxPduCanIdMask=2047, CanIfRxPduCanIdType=STANDARD_CAN, CanIfRxPduId=17, CanIfRxPduUserRxIndicationUL=PDUR, CanIfRxPduHrhIdRef=DCDC_Status_CAN0_Rx, CanIfRxPduRef=DCDC_Status2_VR82BV
        DCDC_Status3_VR82BV: CanIfRxPduCanId=772, CanIfRxPduCanIdMask=2047, CanIfRxPduCanIdType=STANDARD_CAN, CanIfRxPduId=18, CanIfRxPduUserRxIndicationUL=PDUR, CanIfRxPduHrhIdRef=DCDC_Status_CAN0_Rx, CanIfRxPduRef=DCDC_Status3_VR82BV
        HCUDCDC_OjcG_c: CanIfRxPduCanId=419366695, CanIfRxPduCanIdMask=536870911, CanIfRxPduCanIdType=EXTENDED_CAN, CanIfRxPduId=19, CanIfRxPduUserRxIndicationUL=PDUR, CanIfRxPduHrhIdRef=HCU_OPCU_DCDC_CAN4_Rx, CanIfRxPduRef=HCUDCDC_OjcG_c
        HCUAPCU_OjcG_c: CanIfRxPduCanId=419366951, CanIfRxPduCanIdMask=536870911, CanIfRxPduCanIdType=EXTENDED_CAN, CanIfRxPduId=20, CanIfRxPduUserRxIndicationUL=PDUR, CanIfRxPduHrhIdRef=HCU_APCU_3_CAN4_Rx, CanIfRxPduRef=HCUAPCU_OjcG_c
        HCUOPCU_OjcG_c: CanIfRxPduCanId=419366439, CanIfRxPduCanIdMask=536870911, CanIfRxPduCanIdType=EXTENDED_CAN, CanIfRxPduId=21, CanIfRxPduUserRxIndicationUL=PDUR, CanIfRxPduHrhIdRef=HCU_OPCU_DCDC_CAN4_Rx, CanIfRxPduRef=HCUOPCU_OjcG_c
        HCU3_OjcG_c: CanIfRxPduCanId=419368743, CanIfRxPduCanIdMask=536870911, CanIfRxPduCanIdType=EXTENDED_CAN, CanIfRxPduId=22, CanIfRxPduUserRxIndicationUL=PDUR, CanIfRxPduHrhIdRef=HCU_APCU_3_CAN4_Rx, CanIfRxPduRef=HCU3_OjcG_c
        BMS5_OjcG_c: CanIfRxPduCanId=419379955, CanIfRxPduCanIdMask=536870911, CanIfRxPduCanIdType=EXTENDED_CAN, CanIfRxPduId=23, CanIfRxPduUserRxIndicationUL=PDUR, CanIfRxPduHrhIdRef=BMS5_MCU2_CAN4_Rx, CanIfRxPduRef=BMS5_OjcG_c
        MCU2_OjcG_c: CanIfRxPduCanId=419422191, CanIfRxPduCanIdMask=536870911, CanIfRxPduCanIdType=EXTENDED_CAN, CanIfRxPduId=24, CanIfRxPduUserRxIndicationUL=PDUR, CanIfRxPduHrhIdRef=BMS5_MCU2_CAN4_Rx, CanIfRxPduRef=MCU2_OjcG_c
      31 x CanIfTxPduCfg, all with import=COMM_IMPORT:
        MCU1_D3_sO0: CanIfTxPduCanId=218095343, CanIfTxPduCanIdMask=536870911, CanIfTxPduCanIdType=EXTENDED_CAN, CanIfTxPduId=0, CanIfTxPduType=STATIC, CanIfTxPduUserTxConfirmationUL=PDUR, CanIfTxPduBufferRef=FAW_MCD_MCU_CAN_V1_4_1_D3_sO0_Basic_Tx, CanIfTxPduRef=MCU1_D3_sO0
        MCU3_D3_sO0: CanIfTxPduCanId=419380975, CanIfTxPduCanIdMask=536870911, CanIfTxPduCanIdType=EXTENDED_CAN, CanIfTxPduId=1, CanIfTxPduType=STATIC, CanIfTxPduUserTxConfirmationUL=PDUR, CanIfTxPduBufferRef=FAW_MCD_MCU_CAN_V1_4_1_D3_sO0_Basic_Tx, CanIfTxPduRef=MCU3_D3_sO0
        MCU21_D3_sO0: CanIfTxPduCanId=218095344, CanIfTxPduCanIdMask=536870911, CanIfTxPduCanIdType=EXTENDED_CAN, CanIfTxPduId=2, CanIfTxPduType=STATIC, CanIfTxPduUserTxConfirmationUL=PDUR, CanIfTxPduBufferRef=FAW_MCD_MCU_CAN_V1_4_1_D3_sO0_Basic_Tx, CanIfTxPduRef=MCU21_D3_sO0
        MCU22_D3_sO0: CanIfTxPduCanId=419422192, CanIfTxPduCanIdMask=536870911, CanIfTxPduCanIdType=EXTENDED_CAN, CanIfTxPduId=3, CanIfTxPduType=STATIC, CanIfTxPduUserTxConfirmationUL=PDUR, CanIfTxPduBufferRef=FAW_MCD_MCU_CAN_V1_4_1_D3_sO0_Basic_Tx, CanIfTxPduRef=MCU22_D3_sO0
        MCU23_D3_sO0: CanIfTxPduCanId=419380976, CanIfTxPduCanIdMask=536870911, CanIfTxPduCanIdType=EXTENDED_CAN, CanIfTxPduId=4, CanIfTxPduType=STATIC, CanIfTxPduUserTxConfirmationUL=PDUR, CanIfTxPduBufferRef=FAW_MCD_MCU_CAN_V1_4_1_D3_sO0_Basic_Tx, CanIfTxPduRef=MCU23_D3_sO0
        MCU2_D3_sO0: CanIfTxPduCanId=419422191, CanIfTxPduCanIdMask=536870911, CanIfTxPduCanIdType=EXTENDED_CAN, CanIfTxPduId=5, CanIfTxPduType=STATIC, CanIfTxPduUserTxConfirmationUL=PDUR, CanIfTxPduBufferRef=FAW_MCD_MCU_CAN_V1_4_1_D3_sO0_Basic_Tx, CanIfTxPduRef=MCU2_D3_sO0
        TPCMBAMMCU2_D3_sO0: CanIfTxPduCanId=485294064, CanIfTxPduCanIdMask=536870911, CanIfTxPduCanIdType=EXTENDED_CAN, CanIfTxPduId=6, CanIfTxPduType=DYNAMIC, CanIfTxPduUserTxConfirmationUL=J1939TP, CanIfTxPduBufferRef=FAW_MCD_MCU_CAN_V1_4_1_D3_sO0_Basic_Tx, CanIfTxPduRef=TPCMBAMMCU2_D3_sO0
        TPDTMCU2_D3_sO0: CanIfTxPduCanId=485228528, CanIfTxPduCanIdMask=536870911, CanIfTxPduCanIdType=EXTENDED_CAN, CanIfTxPduId=7, CanIfTxPduType=DYNAMIC, CanIfTxPduUserTxConfirmationUL=J1939TP, CanIfTxPduBufferRef=FAW_MCD_MCU_CAN_V1_4_1_D3_sO0_Basic_Tx, CanIfTxPduRef=TPDTMCU2_D3_sO0
        TPCMBAMMCU_D3_sO0: CanIfTxPduCanId=485294063, CanIfTxPduCanIdMask=536870911, CanIfTxPduCanIdType=EXTENDED_CAN, CanIfTxPduId=8, CanIfTxPduType=DYNAMIC, CanIfTxPduUserTxConfirmationUL=J1939TP, CanIfTxPduBufferRef=FAW_MCD_MCU_CAN_V1_4_1_D3_sO0_Basic_Tx, CanIfTxPduRef=TPCMBAMMCU_D3_sO0
        TPDTMCU_D3_sO0: CanIfTxPduCanId=485228527, CanIfTxPduCanIdMask=536870911, CanIfTxPduCanIdType=EXTENDED_CAN, CanIfTxPduId=9, CanIfTxPduType=DYNAMIC, CanIfTxPduUserTxConfirmationUL=J1939TP, CanIfTxPduBufferRef=FAW_MCD_MCU_CAN_V1_4_1_D3_sO0_Basic_Tx, CanIfTxPduRef=TPDTMCU_D3_sO0
        GL_Tx_RES_Voxyrf: CanIfTxPduCanId=1995, CanIfTxPduCanIdMask=2047, CanIfTxPduCanIdType=STANDARD_CAN, CanIfTxPduId=10, CanIfTxPduType=STATIC, CanIfTxPduUserTxConfirmationName=T1_TxConfirmation, CanIfTxPduUserTxConfirmationUL=CDD, CanIfTxPduBufferRef=FAW2_MCD_MCU_CAN_DBC_V0_1_CHL_20241216_Voxyrf_Basic_Tx, CanIfTxPduRef=GL_Tx_RES_Voxyrf
        XCP_Response_Voxyrf: CanIfTxPduCanId=1953, CanIfTxPduCanIdMask=2047, CanIfTxPduCanIdType=STANDARD_CAN, CanIfTxPduId=11, CanIfTxPduType=STATIC, CanIfTxPduUserTxConfirmationUL=XCP, CanIfTxPduBufferRef=FAW2_MCD_MCU_CAN_DBC_V0_1_CHL_20241216_Voxyrf_Basic_Tx, CanIfTxPduRef=XCP_Response_Voxyrf
        MCU_Tx_Data_Voxyrf: CanIfTxPduCanId=417001967, CanIfTxPduCanIdMask=536870911, CanIfTxPduCanIdType=EXTENDED_CAN, CanIfTxPduId=12, CanIfTxPduType=STATIC, CanIfTxPduUserTxConfirmationUL=CAN_TP, CanIfTxPduBufferRef=FAW2_MCD_MCU_CAN_DBC_V0_1_CHL_20241216_Voxyrf_Basic_Tx, CanIfTxPduRef=MCU_Tx_Data_Voxyrf
        DCDC_Cmd1_VR82BV: CanIfTxPduCanId=768, CanIfTxPduCanIdMask=2047, CanIfTxPduCanIdType=STANDARD_CAN, CanIfTxPduId=13, CanIfTxPduType=STATIC, CanIfTxPduUserTxConfirmationUL=PDUR, CanIfTxPduBufferRef=CAN_Matrix_DCDC_V0_1_20250414_VR82BV_Basic_Tx, CanIfTxPduRef=DCDC_Cmd1_VR82BV
        APCU1_OjcG_c: CanIfTxPduCanId=419424304, CanIfTxPduCanIdMask=536870911, CanIfTxPduCanIdType=EXTENDED_CAN, CanIfTxPduId=14, CanIfTxPduType=STATIC, CanIfTxPduUserTxConfirmationUL=PDUR, CanIfTxPduBufferRef=FAW3_HVAC_V2_0DBC_OjcG_c_Basic_Tx, CanIfTxPduRef=APCU1_OjcG_c
        APCU2_OjcG_c: CanIfTxPduCanId=419424560, CanIfTxPduCanIdMask=536870911, CanIfTxPduCanIdType=EXTENDED_CAN, CanIfTxPduId=15, CanIfTxPduType=STATIC, CanIfTxPduUserTxConfirmationUL=PDUR, CanIfTxPduBufferRef=FAW3_HVAC_V2_0DBC_OjcG_c_Basic_Tx, CanIfTxPduRef=APCU2_OjcG_c
        DCDC1_OjcG_c: CanIfTxPduCanId=419423002, CanIfTxPduCanIdMask=536870911, CanIfTxPduCanIdType=EXTENDED_CAN, CanIfTxPduId=16, CanIfTxPduType=STATIC, CanIfTxPduUserTxConfirmationUL=PDUR, CanIfTxPduBufferRef=FAW3_HVAC_V2_0DBC_OjcG_c_Basic_Tx, CanIfTxPduRef=DCDC1_OjcG_c
        OPCU1_OjcG_c: CanIfTxPduCanId=419422254, CanIfTxPduCanIdMask=536870911, CanIfTxPduCanIdType=EXTENDED_CAN, CanIfTxPduId=17, CanIfTxPduType=STATIC, CanIfTxPduUserTxConfirmationUL=PDUR, CanIfTxPduBufferRef=FAW3_HVAC_V2_0DBC_OjcG_c_Basic_Tx, CanIfTxPduRef=OPCU1_OjcG_c
        OPCU2_OjcG_c: CanIfTxPduCanId=419422510, CanIfTxPduCanIdMask=536870911, CanIfTxPduCanIdType=EXTENDED_CAN, CanIfTxPduId=18, CanIfTxPduType=STATIC, CanIfTxPduUserTxConfirmationUL=PDUR, CanIfTxPduBufferRef=FAW3_HVAC_V2_0DBC_OjcG_c_Basic_Tx, CanIfTxPduRef=OPCU2_OjcG_c
        RelayState_OjcG_c: CanIfTxPduCanId=419424096, CanIfTxPduCanIdMask=536870911, CanIfTxPduCanIdType=EXTENDED_CAN, CanIfTxPduId=19, CanIfTxPduType=STATIC, CanIfTxPduUserTxConfirmationUL=PDUR, CanIfTxPduBufferRef=FAW3_HVAC_V2_0DBC_OjcG_c_Basic_Tx, CanIfTxPduRef=RelayState_OjcG_c
        RelayState2_OjcG_c: CanIfTxPduCanId=419411040, CanIfTxPduCanIdMask=536870911, CanIfTxPduCanIdType=EXTENDED_CAN, CanIfTxPduId=20, CanIfTxPduType=STATIC, CanIfTxPduUserTxConfirmationUL=PDUR, CanIfTxPduBufferRef=FAW3_HVAC_V2_0DBC_OjcG_c_Basic_Tx, CanIfTxPduRef=RelayState2_OjcG_c
        IMCU1PTU_OjcG_c: CanIfTxPduCanId=419367264, CanIfTxPduCanIdMask=536870911, CanIfTxPduCanIdType=EXTENDED_CAN, CanIfTxPduId=21, CanIfTxPduType=STATIC, CanIfTxPduUserTxConfirmationUL=PDUR, CanIfTxPduBufferRef=FAW3_HVAC_V2_0DBC_OjcG_c_Basic_Tx, CanIfTxPduRef=IMCU1PTU_OjcG_c
        MECU1Reserved_OjcG_c: CanIfTxPduCanId=419425632, CanIfTxPduCanIdMask=536870911, CanIfTxPduCanIdType=EXTENDED_CAN, CanIfTxPduId=22, CanIfTxPduType=STATIC, CanIfTxPduUserTxConfirmationUL=PDUR, CanIfTxPduBufferRef=FAW3_HVAC_V2_0DBC_OjcG_c_Basic_Tx, CanIfTxPduRef=MECU1Reserved_OjcG_c
        TPCMBAMDCDC_OjcG_c: CanIfTxPduCanId=485293850, CanIfTxPduCanIdMask=536870911, CanIfTxPduCanIdType=EXTENDED_CAN, CanIfTxPduId=23, CanIfTxPduType=DYNAMIC, CanIfTxPduUserTxConfirmationUL=J1939TP, CanIfTxPduBufferRef=FAW3_HVAC_V2_0DBC_OjcG_c_Basic_Tx, CanIfTxPduRef=TPCMBAMDCDC_OjcG_c
        TPDTDCDC_OjcG_c: CanIfTxPduCanId=485228314, CanIfTxPduCanIdMask=536870911, CanIfTxPduCanIdType=EXTENDED_CAN, CanIfTxPduId=24, CanIfTxPduType=DYNAMIC, CanIfTxPduUserTxConfirmationUL=J1939TP, CanIfTxPduBufferRef=FAW3_HVAC_V2_0DBC_OjcG_c_Basic_Tx, CanIfTxPduRef=TPDTDCDC_OjcG_c
        TPCMBAMOPCU_OjcG_c: CanIfTxPduCanId=485293870, CanIfTxPduCanIdMask=536870911, CanIfTxPduCanIdType=EXTENDED_CAN, CanIfTxPduId=25, CanIfTxPduType=DYNAMIC, CanIfTxPduUserTxConfirmationUL=J1939TP, CanIfTxPduBufferRef=FAW3_HVAC_V2_0DBC_OjcG_c_Basic_Tx, CanIfTxPduRef=TPCMBAMOPCU_OjcG_c
        TPDTOPCU_OjcG_c: CanIfTxPduCanId=485228334, CanIfTxPduCanIdMask=536870911, CanIfTxPduCanIdType=EXTENDED_CAN, CanIfTxPduId=26, CanIfTxPduType=DYNAMIC, CanIfTxPduUserTxConfirmationUL=J1939TP, CanIfTxPduBufferRef=FAW3_HVAC_V2_0DBC_OjcG_c_Basic_Tx, CanIfTxPduRef=TPDTOPCU_OjcG_c
        TPCMBAMAPCU_OjcG_c: CanIfTxPduCanId=485293872, CanIfTxPduCanIdMask=536870911, CanIfTxPduCanIdType=EXTENDED_CAN, CanIfTxPduId=27, CanIfTxPduType=DYNAMIC, CanIfTxPduUserTxConfirmationUL=J1939TP, CanIfTxPduBufferRef=FAW3_HVAC_V2_0DBC_OjcG_c_Basic_Tx, CanIfTxPduRef=TPCMBAMAPCU_OjcG_c
        TPDTAPCU_OjcG_c: CanIfTxPduCanId=485228336, CanIfTxPduCanIdMask=536870911, CanIfTxPduCanIdType=EXTENDED_CAN, CanIfTxPduId=28, CanIfTxPduType=DYNAMIC, CanIfTxPduUserTxConfirmationUL=J1939TP, CanIfTxPduBufferRef=FAW3_HVAC_V2_0DBC_OjcG_c_Basic_Tx, CanIfTxPduRef=TPDTAPCU_OjcG_c
        TPCMBAMPTU_OjcG_c: CanIfTxPduCanId=485293920, CanIfTxPduCanIdMask=536870911, CanIfTxPduCanIdType=EXTENDED_CAN, CanIfTxPduId=29, CanIfTxPduType=DYNAMIC, CanIfTxPduUserTxConfirmationUL=J1939TP, CanIfTxPduBufferRef=FAW3_HVAC_V2_0DBC_OjcG_c_Basic_Tx, CanIfTxPduRef=TPCMBAMPTU_OjcG_c
        TPDTPTU_OjcG_c: CanIfTxPduCanId=485228384, CanIfTxPduCanIdMask=536870911, CanIfTxPduCanIdType=EXTENDED_CAN, CanIfTxPduId=30, CanIfTxPduType=DYNAMIC, CanIfTxPduUserTxConfirmationUL=J1939TP, CanIfTxPduBufferRef=FAW3_HVAC_V2_0DBC_OjcG_c_Basic_Tx, CanIfTxPduRef=TPDTPTU_OjcG_c
    CanIfPrivateCfg:
      import = NONE
      CanIfPrivateDlcCheck = false
      CanIfPrivateSoftwareFilterType = INDEX
      CanIfPrivateDlcCheckSpecialCA = true
      CanIfPrivateAckErrCheckSpecialCA = false
      CanIfPrivateASR403Support = false
      CanIfPrivateASR431Support = true
    CanIfPublicCfg:
      import = NONE
      CanIfMetaDataSupport = true
      CanIfPublicCddHeaderFile = T1_Can.h
      CanIfPublicDevErrorDetect = false
      CanIfPublicIcomSupport = false
      CanIfPublicMultipleDrvSupport = true
      CanIfPublicPnSupport = false
      CanIfPublicTxBuffering = true
      CanIfPublicTxConfirmPollingSupport = false
      CanIfPublicVersionInfoApi = true
      CanIfPublicWakeupCheckValidByNM = false
      CanIfPublicWakeupCheckValidSupport = false
      CanIfSetBaudrateApi = false
      CanIfTriggerTransmitSupport = true
      CanIfWakeupSupport = false
