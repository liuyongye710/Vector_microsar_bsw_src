AUTOSAR XML
package /ActiveEcuC
  module config Lin
