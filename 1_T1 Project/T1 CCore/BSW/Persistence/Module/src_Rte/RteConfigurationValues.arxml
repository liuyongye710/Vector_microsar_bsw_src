AUTOSAR XML
package /ActiveEcuC
  module config Rte
    RteBswGeneral: import=NONE
    36 x RteBswModuleInstance, all with import=NONE:
      Ea
        Ea_MainFunction (RteBswEventToTaskMapping): import=NONE
      BswM
        BswM_MainFunction (RteBswEventToTaskMapping): import=NONE, RteBswUsedOsAlarmRef=Rte_Al_TE_Task_5ms_Core2_QM_5ms, RteBswUsedOsEventRef=Task_5ms_Core2_QM
        BSWM_EXCLUSIVE_AREA_0 (RteBswExclusiveAreaImpl): import=NONE
      CanIf
        CanIf_MainFunction (RteBswEventToTaskMapping): import=NONE
        CANIF_EXCLUSIVE_AREA_0 (RteBswExclusiveAreaImpl): import=NONE
      CanNm
        CanNm_MainFunction (RteBswEventToTaskMapping): import=NONE
        7 x RteBswExclusiveAreaImpl, all with import=NONE:
          CANNM_EXCLUSIVE_AREA_{0..6}
      CanSM
        CanSM_MainFunction (RteBswEventToTaskMapping): import=NONE, RteBswUsedOsAlarmRef=Rte_Al_TE_Task_5ms_Core2_QM_5ms, RteBswUsedOsEventRef=Task_5ms_Core2_QM
      CanTp
        CanTp_MainFunction (RteBswEventToTaskMapping): import=NONE, RteBswUsedOsAlarmRef=Rte_Al_TE_Task_5ms_Core2_QM_5ms, RteBswUsedOsEventRef=Task_5ms_Core2_QM
      CanTrcv
        CanTrcv_MainFunction (RteBswEventToTaskMapping): import=NONE
        CanTrcv_MainFunctionDiagnostics (RteBswEventToTaskMapping): import=NONE
      Com
        3 x RteBswEventToTaskMapping, all with import=NONE:
          Com_MainFunctionRouteSignals
          Com_MainFunctionRx
          Com_MainFunctionTx
      ComM
        4 x RteBswEventToTaskMapping, all with import=NONE, RteBswUsedOsAlarmRef=Rte_Al_TE_Task_5ms_Core2_QM_5ms, RteBswUsedOsEventRef=Task_5ms_Core2_QM:
          ComM_MainFunction_{0..3}
      Csm
        Csm_MainFunction (RteBswEventToTaskMapping): import=NONE
      Dcm
        Dcm_MainFunction (RteBswEventToTaskMapping): import=NONE, RteBswUsedOsAlarmRef=Rte_Al_TE_Task_10ms_Core2_QM_10ms, RteBswUsedOsEventRef=Task_10ms_Core2_QM
        DCM_EXCLUSIVE_AREA_0 (RteBswExclusiveAreaImpl): import=NONE
      Dem
        Dem_MainFunction (RteBswEventToTaskMapping): import=NONE, RteBswUsedOsAlarmRef=Rte_Al_TE_Task_10ms_Core2_QM_10ms, RteBswUsedOsEventRef=Task_10ms_Core2_QM
        DEM_EXCLUSIVE_AREA_0 (RteBswExclusiveAreaImpl): import=NONE
      DoIP
        DoIP_MainFunction (RteBswEventToTaskMapping): import=NONE
        DOIP_EXCLUSIVE_AREA_0 (RteBswExclusiveAreaImpl): import=NONE
      EcuM
        EcuM_MainFunction (RteBswEventToTaskMapping): import=NONE, RteBswUsedOsAlarmRef=Rte_Al_TE_Task_5ms_Core2_QM_5ms, RteBswUsedOsEventRef=Task_5ms_Core2_QM
      EthIf
        3 x RteBswEventToTaskMapping, all with import=NONE:
          EthIf_MainFunctionRx
          EthIf_MainFunctionState
          EthIf_MainFunctionTx
      EthSM
        EthSM_MainFunction (RteBswEventToTaskMapping): import=NONE
      EthTrcv
        EthTrcv_MainFunction (RteBswEventToTaskMapping): import=NONE
      Fee
        Fee_MainFunction (RteBswEventToTaskMapping): import=NONE, RteBswUsedOsAlarmRef=Rte_Al_TE_Task_1ms_Core2_QM_1ms, RteBswUsedOsEventRef=Task_1ms_Core2_QM
      FiM
        FiM_MainFunction (RteBswEventToTaskMapping): import=NONE
        FIM_EXCLUSIVE_AREA_0 (RteBswExclusiveAreaImpl): import=NONE
      IpduM
        IpduM_MainFunctionRx (RteBswEventToTaskMapping): import=NONE
        IpduM_MainFunctionTx (RteBswEventToTaskMapping): import=NONE
        IPDUM_EXCLUSIVE_AREA_0 (RteBswExclusiveAreaImpl): import=NONE
      J1939Dcm
        J1939Dcm_MainFunction (RteBswEventToTaskMapping): import=NONE
      J1939Nm
        J1939Nm_MainFunction (RteBswEventToTaskMapping): import=NONE
        J1939NM_EXCLUSIVE_AREA_0 (RteBswExclusiveAreaImpl): import=NONE
      J1939Rm
        J1939Rm_MainFunction (RteBswEventToTaskMapping): import=NONE
      J1939Tp
        J1939Tp_MainFunction (RteBswEventToTaskMapping): import=NONE, RteBswUsedOsAlarmRef=Rte_Al_TE_Task_5ms_Core2_QM_5ms, RteBswUsedOsEventRef=Task_5ms_Core2_QM
      KeyM
        KeyM_MainFunction (RteBswEventToTaskMapping): import=NONE
      LinSM
        LinSM_MainFunction (RteBswEventToTaskMapping): import=NONE
      Nm
        Nm_MainFunction (RteBswEventToTaskMapping): import=NONE
        NM_EXCLUSIVE_AREA_0 (RteBswExclusiveAreaImpl): import=NONE
        NM_EXCLUSIVE_AREA_1 (RteBswExclusiveAreaImpl): import=NONE
      NvM
        NvM_MainFunction (RteBswEventToTaskMapping): import=NONE, RteBswUsedOsAlarmRef=Rte_Al_TE_Task_1ms_Core2_QM_1ms, RteBswUsedOsEventRef=Task_1ms_Core2_QM
      OsekNm
        OsekNm_MainFunction (RteBswEventToTaskMapping): import=NONE
        OSEKNM_EXCLUSIVE_AREA_0 (RteBswExclusiveAreaImpl): import=NONE
      Sd
        Sd_MainFunction (RteBswEventToTaskMapping): import=NONE
      SecOC
        SecOC_MainFunctionRx (RteBswEventToTaskMapping): import=NONE
        SecOC_MainFunctionTx (RteBswEventToTaskMapping): import=NONE
      SoAd
        SoAd_MainFunction (RteBswEventToTaskMapping): import=NONE
        SOAD_EXCLUSIVE_AREA_0 (RteBswExclusiveAreaImpl): import=NONE
      SomeIpTp
        SomeIpTp_MainFunctionRx (RteBswEventToTaskMapping): import=NONE
        SomeIpTp_MainFunctionTx (RteBswEventToTaskMapping): import=NONE
        SOMEIPTP_EXCLUSIVE_AREA_0 (RteBswExclusiveAreaImpl): import=NONE
      TcpIp
        TcpIp_MainFunction (RteBswEventToTaskMapping): import=NONE
      WdgM
        WdgM_MainFunction (RteBswEventToTaskMapping): import=NONE
      Xcp
        Xcp_MainFunction (RteBswEventToTaskMapping): import=NONE, RteBswUsedOsAlarmRef=Rte_Al_TE_Task_10ms_Core2_QM_10ms, RteBswUsedOsEventRef=Task_10ms_Core2_QM
        XCP_EXCLUSIVE_AREA_0 (RteBswExclusiveAreaImpl): import=NONE
    RteGeneration: import=NONE, OsVersion=true, RteMultiCoreSyncEnabled=false
    IoHwAb (RteSwComponentInstance): import=NONE
      69 x RteEventToTaskMapping, all with import=NONE:
        BswM_CheckShutDown_MainFunction: RteMappedToTaskRef=Task_10ms_Core2_QM, RteUsedOsAlarmRef=Rte_Al_TE_Task_10ms_Core2_QM_10ms
        CDS_Mainfunction: RteMappedToTaskRef=Task_10ms_Core2_QM, RteUsedOsAlarmRef=Rte_Al_TE_Task_10ms_Core2_QM_10ms
        Com_MainFunctionRx: RteMappedToTaskRef=Task_5ms_Core2_QM, RteUsedOsAlarmRef=Rte_Al_TE_Task_5ms_Core2_QM_5ms
        Com_MainFunctionTx: RteMappedToTaskRef=Task_5ms_Core2_QM, RteUsedOsAlarmRef=Rte_Al_TE_Task_5ms_Core2_QM_5ms
        Dsm_MainFunction: RteMappedToTaskRef=Task_10ms_Core2_QM, RteUsedOsAlarmRef=Rte_Al_TE_Task_10ms_Core2_QM_10ms
        EcuM_StartupTwo
        Fls_MainFunction: RteMappedToTaskRef=Task_1ms_Core2_QM, RteUsedOsAlarmRef=Rte_Al_TE_Task_1ms_Core2_QM_1ms
        Rte_Start
        Runnable1000ms_Core{0..2}: RteMappedToTaskRef=Task_1000ms_Core{0..2}_QM, RteUsedOsAlarmRef=Rte_Al_TE_Task_1000ms_Core{0..2}_QM_1000ms
        Runnable100ms_Core{0..2}: RteMappedToTaskRef=Task_100ms_Core{0..2}_QM, RteUsedOsAlarmRef=Rte_Al_TE_Task_100ms_Core{0..2}_QM_100ms
        Runnable10ms_Core{0..2}: RteMappedToTaskRef=Task_10ms_Core{0..2}_QM, RteUsedOsAlarmRef=Rte_Al_TE_Task_10ms_Core{0..2}_QM_10ms
        Runnable1ms_Core2: RteMappedToTaskRef=Task_1ms_Core2_QM, RteUsedOsAlarmRef=Rte_Al_TE_Task_1ms_Core2_QM_1ms
        Runnable200ms_Core{0..2}: RteMappedToTaskRef=Task_200ms_Core{0..2}_QM, RteUsedOsAlarmRef=Rte_Al_TE_Task_200ms_Core{0..2}_QM_200ms
        Runnable20ms_Core{0..2}: RteMappedToTaskRef=Task_20ms_Core{0..2}_QM, RteUsedOsAlarmRef=Rte_Al_TE_Task_20ms_Core{0..2}_QM_20ms
        Runnable2ms_Core0: RteMappedToTaskRef=Task_2ms_Core0_QM, RteUsedOsAlarmRef=Rte_Al_TE_Task_2ms_Core0_QM_2ms
        Runnable4ms_Core2: RteMappedToTaskRef=Task_4ms_Core2_QM, RteUsedOsAlarmRef=Rte_Al_TE_Task_4ms_Core2_QM_4ms
        Runnable500ms_Core{0..2}: RteMappedToTaskRef=Task_500ms_Core{0..2}_QM, RteUsedOsAlarmRef=Rte_Al_TE_Task_500ms_Core{0..2}_QM_500ms
        Runnable50ms_Core{0..2}: RteMappedToTaskRef=Task_50ms_Core{0..2}_QM, RteUsedOsAlarmRef=Rte_Al_TE_Task_50ms_Core{0..2}_QM_50ms
        Runnable5ms_Core1: RteMappedToTaskRef=Task_5ms_Core1_QM, RteUsedOsAlarmRef=Rte_Al_TE_Task_5ms_Core1_QM_5ms
        Runnable5ms_Core2: RteMappedToTaskRef=Task_5ms_Core2_QM, RteUsedOsAlarmRef=Rte_Al_TE_Task_5ms_Core2_QM_5ms
        RunnableInit_Core{0..2}
        SchM_Init
        Test_Runnable_Core0_1000ms: RteMappedToTaskRef=Task_1000ms_Core0_QM, RteUsedOsAlarmRef=Rte_Al_TE_Task_1000ms_Core0_QM_1000ms
        Test_Runnable_Core0_100ms: RteMappedToTaskRef=Task_100ms_Core0_QM, RteUsedOsAlarmRef=Rte_Al_TE_Task_100ms_Core0_QM_100ms
        Test_Runnable_Core0_10ms: RteMappedToTaskRef=Task_10ms_Core0_QM, RteUsedOsAlarmRef=Rte_Al_TE_Task_10ms_Core0_QM_10ms
        Test_Runnable_Core0_200ms: RteMappedToTaskRef=Task_200ms_Core0_QM, RteUsedOsAlarmRef=Rte_Al_TE_Task_200ms_Core0_QM_200ms
        Test_Runnable_Core0_20ms: RteMappedToTaskRef=Task_20ms_Core0_QM, RteUsedOsAlarmRef=Rte_Al_TE_Task_20ms_Core0_QM_20ms
        Test_Runnable_Core0_2ms: RteMappedToTaskRef=Task_2ms_Core0_QM, RteUsedOsAlarmRef=Rte_Al_TE_Task_2ms_Core0_QM_2ms
        Test_Runnable_Core0_500ms: RteMappedToTaskRef=Task_500ms_Core0_QM, RteUsedOsAlarmRef=Rte_Al_TE_Task_500ms_Core0_QM_500ms
        Test_Runnable_Core0_50ms: RteMappedToTaskRef=Task_50ms_Core0_QM, RteUsedOsAlarmRef=Rte_Al_TE_Task_50ms_Core0_QM_50ms
        Test_Runnable_Core0_DefaultInit
        Test_Runnable_Core0_Init
        Test_Runnable_Core1_1000ms: RteMappedToTaskRef=Task_1000ms_Core1_QM, RteUsedOsAlarmRef=Rte_Al_TE_Task_1000ms_Core1_QM_1000ms
        Test_Runnable_Core1_100ms: RteMappedToTaskRef=Task_100ms_Core1_QM, RteUsedOsAlarmRef=Rte_Al_TE_Task_100ms_Core1_QM_100ms
        Test_Runnable_Core1_10ms: RteMappedToTaskRef=Task_10ms_Core1_QM, RteUsedOsAlarmRef=Rte_Al_TE_Task_10ms_Core1_QM_10ms
        Test_Runnable_Core1_200ms: RteMappedToTaskRef=Task_200ms_Core1_QM, RteUsedOsAlarmRef=Rte_Al_TE_Task_200ms_Core1_QM_200ms
        Test_Runnable_Core1_20ms: RteMappedToTaskRef=Task_20ms_Core1_QM, RteUsedOsAlarmRef=Rte_Al_TE_Task_20ms_Core1_QM_20ms
        Test_Runnable_Core1_500ms: RteMappedToTaskRef=Task_500ms_Core1_QM, RteUsedOsAlarmRef=Rte_Al_TE_Task_500ms_Core1_QM_500ms
        Test_Runnable_Core1_50ms: RteMappedToTaskRef=Task_50ms_Core1_QM, RteUsedOsAlarmRef=Rte_Al_TE_Task_50ms_Core1_QM_50ms
        Test_Runnable_Core1_5ms: RteMappedToTaskRef=Task_5ms_Core1_QM, RteUsedOsAlarmRef=Rte_Al_TE_Task_5ms_Core1_QM_5ms
        Test_Runnable_Core1_DefaultInit
        Test_Runnable_Core1_Init
        Test_Runnable_Core2_1000ms: RteMappedToTaskRef=Task_1000ms_Core2_QM, RteUsedOsAlarmRef=Rte_Al_TE_Task_1000ms_Core2_QM_1000ms
        Test_Runnable_Core2_100ms: RteMappedToTaskRef=Task_100ms_Core2_QM, RteUsedOsAlarmRef=Rte_Al_TE_Task_100ms_Core2_QM_100ms
        Test_Runnable_Core2_10ms: RteMappedToTaskRef=Task_10ms_Core2_QM, RteUsedOsAlarmRef=Rte_Al_TE_Task_10ms_Core2_QM_10ms
        Test_Runnable_Core2_1ms: RteMappedToTaskRef=Task_1ms_Core2_QM, RteUsedOsAlarmRef=Rte_Al_TE_Task_1ms_Core2_QM_1ms
        Test_Runnable_Core2_200ms: RteMappedToTaskRef=Task_200ms_Core2_QM, RteUsedOsAlarmRef=Rte_Al_TE_Task_200ms_Core2_QM_200ms
        Test_Runnable_Core2_20ms: RteMappedToTaskRef=Task_20ms_Core2_QM, RteUsedOsAlarmRef=Rte_Al_TE_Task_20ms_Core2_QM_20ms
        Test_Runnable_Core2_500ms: RteMappedToTaskRef=Task_500ms_Core2_QM, RteUsedOsAlarmRef=Rte_Al_TE_Task_500ms_Core2_QM_500ms
        Test_Runnable_Core2_50ms: RteMappedToTaskRef=Task_50ms_Core2_QM, RteUsedOsAlarmRef=Rte_Al_TE_Task_50ms_Core2_QM_50ms
        Test_Runnable_Core2_5ms: RteMappedToTaskRef=Task_5ms_Core2_QM, RteUsedOsAlarmRef=Rte_Al_TE_Task_5ms_Core2_QM_5ms
        Test_Runnable_Core2_DefaultInit
        Test_Runnable_Core2_Init
