AUTOSAR XML
package /ActiveEcuC
  module config ComM
    ComMConfigSet: import=NONE, ComMPncEnabled=false
      4 x ComMChannel, all with import=COMM_IMPORT, ComMBusType=COMM_BUS_TYPE_CAN, ComMMainFunctionPeriod=0.005, ComMNoCom=false, ComMNoWakeup=false:
        CAN_MatrixDCDCV0120250305_VR82BV: ComMChannelId=0
          ComMNetworkManagement: import=COMM_IMPORT, ComMNmLightTimeout=0.1, ComMNmVariant=LIGHT, ComMPncNmRequest=false
          CAN_MatrixDCDCV0120250305_VR82BV (ComMUserPerChannel): import=COMM_IMPORT, ComMUserChannel=CAN_MatrixDCDCV0120250305_VR82BV
        FAW_PTCAN_MCU_V141_D3_sO0: ComMChannelId=1
          ComMNetworkManagement: import=COMM_IMPORT, ComMNmLightTimeout=0.1, ComMNmVariant=LIGHT, ComMPncNmRequest=false
          FAW_PTCAN_MCU_V141_D3_sO0 (ComMUserPerChannel): import=COMM_IMPORT, ComMUserChannel=FAW_PTCAN_MCU_V141_D3_sO0
        FAW_MCD_MCU_Voxyrf: ComMChannelId=2
          ComMNetworkManagement: import=COMM_IMPORT, ComMNmLightTimeout=0.1, ComMNmVariant=LIGHT, ComMPncNmRequest=false
          FAW_MCD_MCU_Voxyrf (ComMUserPerChannel): import=COMM_IMPORT, ComMUserChannel=FAW_MCD_MCU_Voxyrf
        FAW__HVACDCDC2__V20DBC_OjcG_c: ComMChannelId=3
          ComMNetworkManagement: import=COMM_IMPORT, ComMNmLightTimeout=0.1, ComMNmVariant=LIGHT, ComMPncNmRequest=false
          FAW__HVACDCDC2__V20DBC_OjcG_c (ComMUserPerChannel): import=COMM_IMPORT, ComMUserChannel=FAW__HVACDCDC2__V20DBC_OjcG_c
      4 x ComMUser, all with import=COMM_IMPORT:
        CAN_MatrixDCDCV0120250305_VR82BV: ComMUserIdentifier=0
        FAW_PTCAN_MCU_V141_D3_sO0: ComMUserIdentifier=1
        FAW_MCD_MCU_Voxyrf: ComMUserIdentifier=2
        FAW__HVACDCDC2__V20DBC_OjcG_c: ComMUserIdentifier=3
    ComMGeneral:
      import = NONE
      ComMDevErrorDetect = false
      ComMModeLimitationEnabled = false
      ComMNmPassiveModeEnable = false
      ComMPncGatewayEnabled = false
      ComMPncSupport = false
      ComMSynchronousWakeUp = false
      ComMVersionInfoApi = true
      ComMWakeupInhibitionEnabled = false
      ComMDcmModeIndication = true
