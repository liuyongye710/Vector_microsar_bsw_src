AUTOSAR XML
package /ActiveEcuC
  module config BswM
    BswMConfig0 (BswMConfig): import=NONE, BswMPartitionRef=EcucPartitionQM
      BswMArbitration: import=NONE
        10 x BswMLogicalExpression, all with import=NONE:
          ESH_LE_InitToWakeUp: BswMLogicalOperator=BSWM_AND, BswMArgumentRef=ESH_Cond_StateIsInit
          ESH_LE_WakeUpToRun: BswMLogicalOperator=BSWM_AND, BswMArgumentRef=ESH_Cond_StateIsWakeUp
          ESH_LE_RunToPostRun: BswMLogicalOperator=BSWM_AND, BswMArgumentRef=ESH_Cond_StateIsRun, BswMArgumentRef=ESH_Cond_TimerSelfRunReqTimerExpired, BswMArgumentRef=ESH_LE_ComMNoCom, BswMArgumentRef=ESH_Cond_WakeUpEventInvalid
          ESH_LE_PostRunToPreShutDown: BswMLogicalOperator=BSWM_AND, BswMArgumentRef=ESH_Cond_StateIsPostRun
          ESH_LE_PreShutDownToWaitForNvm: BswMLogicalOperator=BSWM_AND, BswMArgumentRef=ESH_Cond_StateIsPreShutDown
          ESH_LE_WaitForNvmToShutDown: BswMLogicalOperator=BSWM_AND, BswMArgumentRef=ESH_Cond_StateIsWaitForNvm, BswMArgumentRef=ESH_LE_NvmWriteAllJobOk
          ESH_LE_WaitForNvmToWakeUp: BswMLogicalOperator=BSWM_AND, BswMArgumentRef=ESH_Cond_StateIsWaitForNvm, BswMArgumentRef=ESH_Cond_WakeUpEventValid
          ESH_LE_NvmWriteAllJobOk: BswMLogicalOperator=BSWM_OR, BswMArgumentRef=ESH_Cond_TimerNvmWriteAllTimerExpired, BswMArgumentRef=ESH_Cond_NvmWriteCallBackJobOK
          ESH_LE_ComMNoCom: BswMLogicalOperator=BSWM_AND, BswMArgumentRef=ESH_Cond_ComMNoCom_Can1
          ESH_LE_ComMFullCom: BswMLogicalOperator=BSWM_OR, BswMArgumentRef=ESH_Cond_ComMFullCom_Can1
        23 x BswMModeCondition, all with import=NONE:
          ESH_Cond_StateIsInit: BswMConditionType=BSWM_EQUALS, BswMConditionMode=ESH_State
            BswMConditionValue: import=NONE
              BswMBswMode: import=NONE, BswMBswRequestedMode=ESH_State_Init
          ESH_Cond_StateIsWakeUp: BswMConditionType=BSWM_EQUALS, BswMConditionMode=ESH_State
            BswMConditionValue: import=NONE
              BswMBswMode: import=NONE, BswMBswRequestedMode=ESH_State_WakeUp
          ESH_Cond_StateIsRun: BswMConditionType=BSWM_EQUALS, BswMConditionMode=ESH_State
            BswMConditionValue: import=NONE
              BswMBswMode: import=NONE, BswMBswRequestedMode=ESH_State_Run
          ESH_Cond_StateIsPostRun: BswMConditionType=BSWM_EQUALS, BswMConditionMode=ESH_State
            BswMConditionValue: import=NONE
              BswMBswMode: import=NONE, BswMBswRequestedMode=ESH_State_PostRun
          ESH_Cond_StateIsPreShutDown: BswMConditionType=BSWM_EQUALS, BswMConditionMode=ESH_State
            BswMConditionValue: import=NONE
              BswMBswMode: import=NONE, BswMBswRequestedMode=ESH_State_PreShutDown
          ESH_Cond_StateIsWaitForNvm: BswMConditionType=BSWM_EQUALS, BswMConditionMode=ESH_State
            BswMConditionValue: import=NONE
              BswMBswMode: import=NONE, BswMBswRequestedMode=ESH_State_WaitForNvM
          ESH_Cond_StateIsShutDown: BswMConditionType=BSWM_EQUALS, BswMConditionMode=ESH_State
            BswMConditionValue: import=NONE
              BswMBswMode: import=NONE, BswMBswRequestedMode=ESH_State_ShutDown
          ESH_Cond_StateIsWriteNvmPending: BswMConditionType=BSWM_EQUALS_NOT, BswMConditionMode=ESH_Req_WaitNvMWriteAllJobok
            BswMConditionValue: import=NONE
              BswMBswMode: import=NONE, BswMBswRequestedMode=NVM_REQ_PENDING
          ESH_Cond_TimerSelfRunReqTimerExpired: BswMConditionType=BSWM_EQUALS, BswMConditionMode=ESH_Req_SelfRunReqTimer
            BswMConditionValue: import=NONE
              BswMBswMode: import=NONE, BswMBswRequestedMode=BSWM_TIMER_EXPIRED
          ESH_Cond_TimerNvmWriteAllTimerExpired: BswMConditionType=BSWM_EQUALS, BswMConditionMode=ESH_Req_WaitforNvMTimer
            BswMConditionValue: import=NONE
              BswMBswMode: import=NONE, BswMBswRequestedMode=BSWM_TIMER_EXPIRED
          ESH_Cond_TimerNvmCancelWriteAllTimerExpired: BswMConditionType=BSWM_EQUALS, BswMConditionMode=ESH_Req_WaitforNvMTimer
            BswMConditionValue: import=NONE
              BswMBswMode: import=NONE, BswMBswRequestedMode=BSWM_TIMER_EXPIRED
          ESH_Cond_ComMNoCom_Can0: BswMConditionType=BSWM_EQUALS, BswMConditionMode=ESH_Req_ComM_Can0
            BswMConditionValue: import=NONE
              BswMBswMode: import=NONE, BswMBswRequestedMode=COMM_NO_COMMUNICATION
          ESH_Cond_ComMNoCom_Can1: BswMConditionType=BSWM_EQUALS, BswMConditionMode=ESH_Req_ComM_Can1
            BswMConditionValue: import=NONE
              BswMBswMode: import=NONE, BswMBswRequestedMode=COMM_NO_COMMUNICATION
          ESH_Cond_ComMNoCom_Can2: BswMConditionType=BSWM_EQUALS, BswMConditionMode=ESH_Req_ComM_Can2
            BswMConditionValue: import=NONE
              BswMBswMode: import=NONE, BswMBswRequestedMode=COMM_NO_COMMUNICATION
          ESH_Cond_ComMNoCom_Can3: BswMConditionType=BSWM_EQUALS, BswMConditionMode=ESH_Req_ComM_Can3
            BswMConditionValue: import=NONE
              BswMBswMode: import=NONE, BswMBswRequestedMode=COMM_NO_COMMUNICATION
          ESH_Cond_ComMFullCom_Can0: BswMConditionType=BSWM_EQUALS, BswMConditionMode=ESH_Req_ComM_Can0
            BswMConditionValue: import=NONE
              BswMBswMode: import=NONE, BswMBswRequestedMode=COMM_FULL_COMMUNICATION
          ESH_Cond_ComMFullCom_Can1: BswMConditionType=BSWM_EQUALS, BswMConditionMode=ESH_Req_ComM_Can1
            BswMConditionValue: import=NONE
              BswMBswMode: import=NONE, BswMBswRequestedMode=COMM_FULL_COMMUNICATION
          ESH_Cond_ComMFullCom_Can2: BswMConditionType=BSWM_EQUALS, BswMConditionMode=ESH_Req_ComM_Can2
            BswMConditionValue: import=NONE
              BswMBswMode: import=NONE, BswMBswRequestedMode=COMM_FULL_COMMUNICATION
          ESH_Cond_ComMFullCom_Can3: BswMConditionType=BSWM_EQUALS, BswMConditionMode=ESH_Req_ComM_Can3
            BswMConditionValue: import=NONE
              BswMBswMode: import=NONE, BswMBswRequestedMode=COMM_FULL_COMMUNICATION
          ESH_Cond_NvmWriteCallBackJobOK: BswMConditionType=BSWM_EQUALS_NOT, BswMConditionMode=ESH_Req_WaitNvMWriteAllJobok
            BswMConditionValue: import=NONE
              BswMBswMode: import=NONE, BswMBswRequestedMode=NVM_REQ_PENDING
          ESH_Cond_NvmReadCallBackJobOK: BswMConditionType=BSWM_EQUALS, BswMConditionMode=ESH_Req_WaitNvMReadAllJobok
            BswMConditionValue: import=NONE
              BswMBswMode: import=NONE, BswMBswRequestedMode=NVM_REQ_OK
          ESH_Cond_WakeUpEventValid: BswMConditionType=BSWM_EQUALS, BswMConditionMode=ESH_Req_CheckWakeUpEvent
            BswMConditionValue: import=NONE
              BswMBswMode: import=NONE, BswMBswRequestedMode=ESH_ModeWakeUpEventValid
          ESH_Cond_WakeUpEventInvalid: BswMConditionType=BSWM_EQUALS, BswMConditionMode=ESH_Req_CheckWakeUpEvent
            BswMConditionValue: import=NONE
              BswMBswMode: import=NONE, BswMBswRequestedMode=ESH_ModeWakeUpEventInvalid
        11 x BswMModeRequestPort, all with import=NONE:
          ESH_State: BswMRequestProcessing=BSWM_IMMEDIATE, BswMInitArbitration=true
            BswMModeRequestSource: import=NONE
              BswMGenericRequest: import=NONE, BswMModeRequesterId=0
                12 x BswMGenericRequestMode, all with import=NONE:
                  ESH_State_Init: BswMGenericRequestModeValue=0
                  ESH_State_WakeUp: BswMGenericRequestModeValue=1
                  ESH_State_Run: BswMGenericRequestModeValue=2
                  ESH_State_PostRun: BswMGenericRequestModeValue=3
                  ESH_State_WaitForNvM: BswMGenericRequestModeValue=4
                  ESH_State_PreShutDown: BswMGenericRequestModeValue=5
                  ESH_State_Sleep: BswMGenericRequestModeValue=6
                  ESH_State_GoHalt: BswMGenericRequestModeValue=7
                  ESH_State_ShutDown: BswMGenericRequestModeValue=8
                  ESH_State_GoDown: BswMGenericRequestModeValue=9
                  ESH_State_WakeUpFalse: BswMGenericRequestModeValue=10
                  ESH_State_CheckComM: BswMGenericRequestModeValue=11
            BswMModeInitValue: import=NONE, BswMBswModeInitValue=ESH_State_Init
          ESH_Req_SelfRunReqTimer: BswMRequestProcessing=BSWM_DEFERRED
            BswMModeRequestSource: import=NONE
              BswMTimer: import=NONE
            BswMModeInitValue: import=NONE, BswMBswModeInitValue=BSWM_TIMER_STOPPED
          ESH_Req_WaitforNvMTimer: BswMRequestProcessing=BSWM_DEFERRED
            BswMModeRequestSource: import=NONE
              BswMTimer: import=NONE
            BswMModeInitValue: import=NONE, BswMBswModeInitValue=BSWM_TIMER_STOPPED
          ESH_Req_CancelWaitforNvMTimer: BswMRequestProcessing=BSWM_DEFERRED
            BswMModeRequestSource: import=NONE
              BswMTimer: import=NONE
            BswMModeInitValue: import=NONE, BswMBswModeInitValue=BSWM_TIMER_STOPPED
          ESH_Req_WaitNvMReadAllJobok: BswMRequestProcessing=BSWM_DEFERRED
            BswMModeRequestSource: import=NONE
              BswMNvMJobModeIndication: import=NONE, BswMNvmService=NvmReadAll
            BswMModeInitValue: import=NONE, BswMBswModeInitValue=NVM_REQ_NOT_OK
          ESH_Req_WaitNvMWriteAllJobok: BswMRequestProcessing=BSWM_DEFERRED
            BswMModeRequestSource: import=NONE
              BswMNvMJobModeIndication: import=NONE, BswMNvmService=NvmWriteAll
            BswMModeInitValue: import=NONE, BswMBswModeInitValue=NVM_REQ_NOT_OK
          ESH_Req_ComM_Can0: BswMRequestProcessing=BSWM_DEFERRED
            BswMModeRequestSource: import=NONE
              BswMComMIndication: import=NONE, BswMComMChannelRef=CAN_MatrixDCDCV0120250305_VR82BV
            BswMModeInitValue: import=NONE, BswMBswModeInitValue=COMM_NO_COMMUNICATION
          ESH_Req_ComM_Can1: BswMRequestProcessing=BSWM_DEFERRED
            BswMModeRequestSource: import=NONE
              BswMComMIndication: import=NONE, BswMComMChannelRef=FAW_PTCAN_MCU_V141_D3_sO0
            BswMModeInitValue: import=NONE, BswMBswModeInitValue=COMM_NO_COMMUNICATION
          ESH_Req_ComM_Can2: BswMRequestProcessing=BSWM_DEFERRED
            BswMModeRequestSource: import=NONE
              BswMComMIndication: import=NONE, BswMComMChannelRef=FAW_MCD_MCU_Voxyrf
            BswMModeInitValue: import=NONE, BswMBswModeInitValue=COMM_NO_COMMUNICATION
          ESH_Req_ComM_Can3: BswMRequestProcessing=BSWM_DEFERRED
            BswMModeRequestSource: import=NONE
              BswMComMIndication: import=NONE, BswMComMChannelRef=FAW__HVACDCDC2__V20DBC_OjcG_c
            BswMModeInitValue: import=NONE, BswMBswModeInitValue=COMM_NO_COMMUNICATION
          ESH_Req_CheckWakeUpEvent: BswMRequestProcessing=BSWM_DEFERRED
            BswMModeRequestSource: import=NONE
              BswMGenericRequest: import=NONE, BswMModeRequesterId=1
                ESH_ModeWakeUpEventValid (BswMGenericRequestMode): import=NONE, BswMGenericRequestModeValue=0
                ESH_ModeWakeUpEventInvalid (BswMGenericRequestMode): import=NONE, BswMGenericRequestModeValue=1
            BswMModeInitValue: import=NONE, BswMBswModeInitValue=ESH_ModeWakeUpEventValid
        7 x BswMRule, all with import=NONE:
          ESH_InitToWakeUp: BswMRuleInitState=BSWM_TRUE, BswMRuleExpressionRef=ESH_LE_InitToWakeUp, BswMRuleTrueActionList=ESH_AL_InitToWakeUp
          ESH_WakeUpToRun: BswMRuleInitState=BSWM_FALSE, BswMRuleExpressionRef=ESH_LE_WakeUpToRun, BswMRuleTrueActionList=ESH_AL_WakeUpToRun
          ESH_RunToPostRun: BswMRuleInitState=BSWM_FALSE, BswMRuleExpressionRef=ESH_LE_RunToPostRun, BswMRuleTrueActionList=ESH_AL_RunToPostRun
          ESH_PostRunToPreShutDown: BswMRuleInitState=BSWM_FALSE, BswMRuleExpressionRef=ESH_LE_PostRunToPreShutDown, BswMRuleTrueActionList=ESH_AL_PostRunToPreShutDown
          ESH_PreShutDownToWaitForNvm: BswMRuleInitState=BSWM_FALSE, BswMRuleExpressionRef=ESH_LE_PreShutDownToWaitForNvm, BswMRuleTrueActionList=ESH_AL_PreShutDownToWaitforNvm
          ESH_WaitForNvmToShutDown: BswMRuleInitState=BSWM_FALSE, BswMRuleExpressionRef=ESH_LE_WaitForNvmToShutDown, BswMRuleTrueActionList=ESH_AL_WaitForNvmToShutDown
          ESH_WaitForNvmToWakeup: BswMRuleInitState=BSWM_FALSE, BswMRuleExpressionRef=ESH_LE_WaitForNvmToWakeUp, BswMRuleTrueActionList=ESH_AL_WaitForNvmToWakeUp
      BswMModeControl: import=NONE
        39 x BswMAction, all with import=NONE:
          ESH_Action_Dcm_Init
            BswMAvailableActions: import=NONE
              BswMUserCallout: import=NONE, BswMUserCalloutFunction=void BswM_Dcm_Init(void), BswMUserCode={/n Dcm_Init(NULL_PTR);/n}, BswMHeaderFile=Dcm.h
          ESH_Action_Dem_Init
            BswMAvailableActions: import=NONE
              BswMUserCallout: import=NONE, BswMUserCalloutFunction=void BswM_Dem_Init(void), BswMUserCode={/n Dem_Init(NULL_PTR);/n}
          ESH_Action_Dem_Shutdown
            BswMAvailableActions: import=NONE
              BswMUserCallout: import=NONE, BswMUserCalloutFunction=void BswM_Dcm_Shutdown(void), BswMUserCode={/n Dem_Shutdown();/n}
          ESH_Action_Fee_Init
            BswMAvailableActions: import=NONE
              BswMUserCallout: import=NONE, BswMUserCalloutFunction=void BswM_Fee_Init(void), BswMUserCode={/n Fee_Init(NULL_PTR);/n}
          ESH_Action_CanIf_Init
            BswMAvailableActions: import=NONE
              BswMUserCallout: import=NONE, BswMUserCalloutFunction=void BswM_CanIf_Init(void), BswMUserCode={/n CanIf_Init(NULL_PTR);/n Can_Config_Init();/n}
          ESH_Action_CanSM_Init
            BswMAvailableActions: import=NONE
              BswMUserCallout: import=NONE, BswMUserCalloutFunction=void BswM_CanSM_Init(void), BswMUserCode={/n CanSM_Init(NULL_PTR);/n}
          ESH_Action_CanNm_Init
            BswMAvailableActions: import=NONE
              BswMUserCallout: import=NONE, BswMUserCalloutFunction=void BswM_CanNm_Init(void), BswMUserCode={/n //CanNm_Init(NULL_PTR);/n}
          ESH_Action_CanTp_Init
            BswMAvailableActions: import=NONE
              BswMUserCallout: import=NONE, BswMUserCalloutFunction=void BswM_CanTp_Init(void), BswMUserCode={/n CanTp_Init(NULL_PTR);/n}
          ESH_Action_Com_Init
            BswMAvailableActions: import=NONE
              BswMUserCallout: import=NONE, BswMUserCalloutFunction=void BswM_Com_Init(void), BswMUserCode={/n Com_Init(NULL_PTR);/n}
          ESH_Action_ComM_Init
            BswMAvailableActions: import=NONE
              BswMUserCallout: import=NONE, BswMUserCalloutFunction=void BswM_ComM_Init(void), BswMUserCode={/n ComM_Init(NULL_PTR);/n}, BswMHeaderFile=ComM.h
          ESH_Action_Xcp_Init
            BswMAvailableActions: import=NONE
              BswMUserCallout: import=NONE, BswMUserCalloutFunction=void BswM_XcpInit(void), BswMUserCode={/n Xcp_Init();/n CanXcp_Init();/n}
          ESH_Action_PduR_Init
            BswMAvailableActions: import=NONE
              BswMUserCallout:
                import = NONE
                BswMUserCalloutFunction = void BswM_PduR_Init(void)
                BswMUserCode = {/n PduR_Init(&PduR_PBConfigTable);/n PduR_DisableRouting(1, TRUE);/n}
                BswMHeaderFile = PduR.h
          ESH_Action_J1939Tp_Init
            BswMAvailableActions: import=NONE
              BswMUserCallout: import=NONE, BswMUserCalloutFunction=void BswM_J1939Tp_Init(void), BswMUserCode={/n J1939Tp_Init(NULL_PTR);/n}, BswMHeaderFile=J1939Tp.h
          ESH_Action_CanTrcv_Init
            BswMAvailableActions: import=NONE
              BswMUserCallout: import=NONE, BswMUserCalloutFunction=void BswM_CanTrcv_Init(void), BswMUserCode={/n CanTrcv_Init(NULL_PTR);/n}, BswMHeaderFile=CanTrcv.h
          ESH_Action_CDS_Init
            BswMAvailableActions: import=NONE
              BswMUserCallout: import=NONE, BswMUserCalloutFunction=void BswM_CDS_Init(void), BswMUserCode={/n CDS_Init();/n}
          ESH_Action_NvM_Init
            BswMAvailableActions: import=NONE
              BswMUserCallout: import=NONE, BswMUserCalloutFunction=void BswM_NvM_Init(void), BswMUserCode={/n NvM_Init(NULL_PTR);/n}, BswMHeaderFile=NvM.h
          ESH_Action_NvM_ReadAll
            BswMAvailableActions: import=NONE
              BswMUserCallout:
                import = NONE
                BswMUserCalloutFunction = void BswM_Init_Nvm_Read_All(void)
                BswMUserCode = {/n NvM_ReadAll();/n while((BswM_NvMJobState[0] == NVM_REQ_PENDING))/n {/n NvM_MainFunction();/n Fee_MainFunction();/n Fls_MainFunction();/n }/n memcpy(0x51800000, &dsm_nvm_data[0], 0x8000);/n}
                BswMHeaderFile = string.h
          ESH_Action_NvM_WriteAll
            BswMAvailableActions: import=NONE
              BswMUserCallout:
                import = NONE
                BswMUserCalloutFunction = void BswM_Init_Nvm_Write_All(void)
                BswMUserCode = {/n uint16 i = 0;/n/n memcpy(&dsm_nvm_data[0], 0x51800000, 0x8000);/n /n for(i = NVM_COMPILED_CONFIG_ID; i < NVM_NUM_OF_BLOCK_TOTAL; i++)/n {/n NvM_SetRamBlockStatus(i, TRUE);/n }/n NvM_WriteAll();/n}
          ESH_Action_NvM_CancelWriteAll
            BswMAvailableActions: import=NONE
              BswMUserCallout: import=NONE, BswMUserCalloutFunction=void BswM_Init_Nvm_CancelWrite_All(void), BswMUserCode={/n NvM_CancelWriteAll();/n}
          ESH_Action_SelectShutdownTarget
            BswMAvailableActions: import=NONE
              BswMEcuMSelectShutdownTarget: import=NONE, BswMEcuMShutdownTarget=OFF
          ESH_Action_ShutDown
            BswMAvailableActions: import=NONE
              BswMEcuMGoDown: import=NONE, BswMEcuMUserIdRef=EcuMFlexUserConfig0
          ESH_Action_SwitchStateMode_Run
            BswMAvailableActions: import=NONE
              BswMGenericModeSwitch: import=NONE, NextModeRef=ESH_State_Run
          ESH_Action_SwitchStateMode_PostRun
            BswMAvailableActions: import=NONE
              BswMGenericModeSwitch: import=NONE, NextModeRef=ESH_State_PostRun
          ESH_Action_SwitchStateMode_PreShutDown
            BswMAvailableActions: import=NONE
              BswMGenericModeSwitch: import=NONE, NextModeRef=ESH_State_PreShutDown
          ESH_Action_SwitchStateMode_WaitforNvm
            BswMAvailableActions: import=NONE
              BswMGenericModeSwitch: import=NONE, NextModeRef=ESH_State_WaitForNvM
          ESH_Action_SwitchStateModeShutDown
            BswMAvailableActions: import=NONE
              BswMGenericModeSwitch: import=NONE, NextModeRef=ESH_State_ShutDown
          ESH_Action_SwitchStateMode_WakeUp
            BswMAvailableActions: import=NONE
              BswMGenericModeSwitch: import=NONE, NextModeRef=ESH_State_WakeUp
          ESH_Action_NvmWriteAllTimer_Start
            BswMAvailableActions: import=NONE
              BswMTimerControl: import=NONE, TimerAction=BSWM_TIMER_START, TimerVaule=4000, TimerReference=ESH_Req_WaitforNvMTimer
          ESH_Action_SelfRunReqTimerStart
            BswMAvailableActions: import=NONE
              BswMTimerControl: import=NONE, TimerAction=BSWM_TIMER_START, TimerVaule=250, TimerReference=ESH_Req_SelfRunReqTimer
          ESH_Action_NvmCancelWriteAllTimer_Start
            BswMAvailableActions: import=NONE
              BswMTimerControl: import=NONE, TimerAction=BSWM_TIMER_START, TimerVaule=2000, TimerReference=ESH_Req_CancelWaitforNvMTimer
          ESH_Action_ComMAllowCom_Can1
            BswMAvailableActions: import=NONE
              BswMComMAllowCom: import=NONE, BswMComAllowed=true, BswMComMAllowChannelRef=CAN_MatrixDCDCV0120250305_VR82BV
          ESH_Action_ComMAllowCom_Can2
            BswMAvailableActions: import=NONE
              BswMComMAllowCom: import=NONE, BswMComAllowed=true, BswMComMAllowChannelRef=FAW_PTCAN_MCU_V141_D3_sO0
          ESH_Action_ComMAllowCom_Can3
            BswMAvailableActions: import=NONE
              BswMComMAllowCom: import=NONE, BswMComAllowed=true, BswMComMAllowChannelRef=FAW_MCD_MCU_Voxyrf
          ESH_Action_ComMAllowCom_Can4
            BswMAvailableActions: import=NONE
              BswMComMAllowCom: import=NONE, BswMComAllowed=true, BswMComMAllowChannelRef=FAW__HVACDCDC2__V20DBC_OjcG_c
          ESH_Action_PduGroupControl_On
            BswMAvailableActions: import=NONE
              BswMPduGroupSwitch:
                import = NONE
                BswMEnabledPduGroupRef = CAN_Matrix_DCDC_V0_1_20250414_dbc_VR82BV_Tx
                BswMEnabledPduGroupRef = CAN_Matrix_DCDC_V0_1_20250414_dbc_VR82BV_Rx
                BswMEnabledPduGroupRef = FAW_MCD_MCU_CAN_V1_4_1_dbc_D3_sO0_Tx
                BswMEnabledPduGroupRef = FAW_MCD_MCU_CAN_V1_4_1_dbc_D3_sO0_Rx
                BswMEnabledPduGroupRef = FAW3_HVAC_V2_0DBC_dbc_OjcG_c_Tx
                BswMEnabledPduGroupRef = FAW3_HVAC_V2_0DBC_dbc_OjcG_c_Rx
          ESH_Action_PduGroupControl_Off
            BswMAvailableActions: import=NONE
              BswMPduGroupSwitch:
                import = NONE
                BswMDisabledPduGroupRef = CAN_Matrix_DCDC_V0_1_20250414_dbc_VR82BV_Tx
                BswMDisabledPduGroupRef = CAN_Matrix_DCDC_V0_1_20250414_dbc_VR82BV_Rx
                BswMDisabledPduGroupRef = FAW_MCD_MCU_CAN_V1_4_1_dbc_D3_sO0_Tx
                BswMDisabledPduGroupRef = FAW_MCD_MCU_CAN_V1_4_1_dbc_D3_sO0_Rx
                BswMDisabledPduGroupRef = FAW3_HVAC_V2_0DBC_dbc_OjcG_c_Tx
                BswMDisabledPduGroupRef = FAW3_HVAC_V2_0DBC_dbc_OjcG_c_Rx
          ESH_Action_ComM_FUllCOM
            BswMAvailableActions: import=NONE
              BswMUserCallout:
                import = NONE
                BswMUserCalloutFunction = void BswM_ComMRequestFullComMode(void)
                BswMUserCode = {/n ComM_RequestComMode(0, COMM_FULL_COMMUNICATION);/n ComM_RequestComMode(1, COMM_FULL_COMMUNICATION);/n ComM_RequestComMode(2, COMM_FULL_COMMUNICATION);/n ComM_RequestComMode(3, COMM_FULL_COMMUNICATION);/n}
          ESH_Action_ComM_NOCOM
            BswMAvailableActions: import=NONE
              BswMUserCallout:
                import = NONE
                BswMUserCalloutFunction = void BswM_ComMRequestNoComMode(void)
                BswMUserCode = {/n ComM_RequestComMode(0, COMM_NO_COMMUNICATION);/n ComM_RequestComMode(1, COMM_NO_COMMUNICATION);/n ComM_RequestComMode(2, COMM_NO_COMMUNICATION);/n ComM_RequestComMode(3, COMM_NO_COMMUNICATION);/n}
          ESH_Action_CheckShutDownCond
            BswMAvailableActions: import=NONE
              BswMUserCallout:
                import = NONE
                BswMUserCalloutFunction = void BswM_CheckShutDown_MainFunction(void)
                BswMUserCode = {/n if(0)/n {/n BswM_RequestMode(BSWM_GENERIC_ESH_Req_CheckWakeUpEvent, BSWM_GENERICVALUE_ESH_ModeWakeUpEventValid);/n }/n else/n {/n BswM_RequestMode(BSWM_GENERIC_ESH_Req_CheckWakeUpEvent, BSWM_GENERICVALUE_ESH_ModeWakeUpEventInvalid);/n }/n}
        7 x BswMActionList, all with import=NONE, BswMActionListExecution=BSWM_CONDITION:
          ESH_AL_InitToWakeUp
            17 x BswMActionListItem, all with import=NONE:
              Action_Dcm_Init: BswMActionListItemIndex=1, BswMActionListItemRef=ESH_Action_Dcm_Init
              Action_Fee_Init: BswMActionListItemIndex=2, BswMActionListItemRef=ESH_Action_Fee_Init
              Action_NvM_Init: BswMActionListItemIndex=3, BswMActionListItemRef=ESH_Action_NvM_Init
              Action_NvM_ReadAll: BswMActionListItemIndex=4, BswMActionListItemRef=ESH_Action_NvM_ReadAll
              Action_Xcp_Init: BswMActionListItemIndex=5, BswMActionListItemRef=ESH_Action_Xcp_Init
              Action_CanIf_Init: BswMActionListItemIndex=6, BswMActionListItemRef=ESH_Action_CanIf_Init
              Action_CanTrcv_Init: BswMActionListItemIndex=7, BswMActionListItemRef=ESH_Action_CanTrcv_Init
              Action_CanSM_Init: BswMActionListItemIndex=8, BswMActionListItemRef=ESH_Action_CanSM_Init
              Action_CanNm_Init: BswMActionListItemIndex=9, BswMActionListItemRef=ESH_Action_CanNm_Init
              Action_CanTp_Init: BswMActionListItemIndex=10, BswMActionListItemRef=ESH_Action_CanTp_Init
              Action_Com_Init: BswMActionListItemIndex=11, BswMActionListItemRef=ESH_Action_Com_Init
              Action_ComM_Init: BswMActionListItemIndex=12, BswMActionListItemRef=ESH_Action_ComM_Init
              Action_PduR_Init: BswMActionListItemIndex=13, BswMActionListItemRef=ESH_Action_PduR_Init
              Action_J1939Tp_Init: BswMActionListItemIndex=16, BswMActionListItemRef=ESH_Action_J1939Tp_Init
              Action_CDS_Init: BswMActionListItemIndex=17, BswMActionListItemRef=ESH_Action_CDS_Init
              Action_ComM_FullCom: BswMActionListItemIndex=18, BswMActionListItemRef=ESH_Action_ComM_FUllCOM
              Action_Switch_State_Mode_WakeUp: BswMActionListItemIndex=19, BswMActionListItemRef=ESH_Action_SwitchStateMode_WakeUp
          ESH_AL_WakeUpToRun
            8 x BswMActionListItem, all with import=NONE:
              Action_Dem_Init: BswMActionListItemIndex=1, BswMActionListItemRef=ESH_Action_Dem_Init
              Action_ComMAllowCom_Can1: BswMActionListItemIndex=2, BswMActionListItemRef=ESH_Action_ComMAllowCom_Can1
              Action_ComMAllowCom_Can2: BswMActionListItemIndex=3, BswMActionListItemRef=ESH_Action_ComMAllowCom_Can2
              Action_ComMAllowCom_Can3: BswMActionListItemIndex=4, BswMActionListItemRef=ESH_Action_ComMAllowCom_Can3
              Action_ComMAllowCom_Can4: BswMActionListItemIndex=5, BswMActionListItemRef=ESH_Action_ComMAllowCom_Can4
              Action_PduGroupControl_On: BswMActionListItemIndex=6, BswMActionListItemRef=ESH_Action_PduGroupControl_On
              Action_SelfRunReqTimerStart: BswMActionListItemIndex=7, BswMActionListItemRef=ESH_Action_SelfRunReqTimerStart
              Action_Switch_State_Mode_Run: BswMActionListItemIndex=8, BswMActionListItemRef=ESH_Action_SwitchStateMode_Run
          ESH_AL_RunToPostRun
            Action_Switch_State_Mode_PostRun (BswMActionListItem): import=NONE, BswMActionListItemIndex=1, BswMActionListItemRef=ESH_Action_SwitchStateMode_PostRun
          ESH_AL_PostRunToPreShutDown
            Action_Switch_State_Mode_PreShutDown (BswMActionListItem): import=NONE, BswMActionListItemIndex=1, BswMActionListItemRef=ESH_Action_SwitchStateMode_PreShutDown
            Action_Dem_Shutdown (BswMActionListItem): import=NONE, BswMActionListItemIndex=2, BswMActionListItemRef=ESH_Action_Dem_Shutdown
          ESH_AL_PreShutDownToWaitforNvm
            3 x BswMActionListItem, all with import=NONE:
              Action_Switch_State_Mode_WaitforNvm: BswMActionListItemIndex=1, BswMActionListItemRef=ESH_Action_SwitchStateMode_WaitforNvm
              Action_NvmWriteAllTimer_Start: BswMActionListItemIndex=2, BswMActionListItemRef=ESH_Action_NvmWriteAllTimer_Start
              Action_NvM_WriteAll: BswMActionListItemIndex=3, BswMActionListItemRef=ESH_Action_NvM_WriteAll
          ESH_AL_WaitForNvmToShutDown
            3 x BswMActionListItem, all with import=NONE:
              Action_Switch_State_Mode_ShutDown: BswMActionListItemIndex=1, BswMActionListItemRef=ESH_Action_SwitchStateModeShutDown
              Action_SelectShutdownTarget: BswMActionListItemIndex=2, BswMActionListItemRef=ESH_Action_SelectShutdownTarget
              Action_ShutDown: BswMActionListItemIndex=3, BswMActionListItemRef=ESH_Action_ShutDown
          ESH_AL_WaitForNvmToWakeUp
            3 x BswMActionListItem, all with import=NONE:
              Action_Switch_State_Mode_WakeUp: BswMActionListItemIndex=1, BswMActionListItemRef=ESH_Action_SwitchStateMode_WakeUp
              Action_NvM_CancelWriteAll: BswMActionListItemIndex=2, BswMActionListItemRef=ESH_Action_NvM_CancelWriteAll
              Action_NvmCancelWriteAllTimer_Start: BswMActionListItemIndex=3, BswMActionListItemRef=ESH_Action_NvmCancelWriteAllTimer_Start
    BswMGeneral:
      import = NONE
      BswMCanSMEnabled = true
      BswMCanSMIcomEnabled = false
      BswMComMEnabled = true
      BswMDcmEnabled = true
      BswMDevErrorDetect = true
      BswMEcuMEnabled = true
      BswMEthSMEnabled = false
      BswMFrSMEnabled = false
      BswMGenericRequestEnabled = true
      BswMJ1939DcmEnabled = false
      BswMLinSMEnabled = false
      BswMLinTPEnabled = false
      BswMMainFunctionPeriod = 0.005
      BswMNvMEnabled = true
      BswMSdEnabled = false
      BswMNMEnabled = false
      BswMVersionInfoApi = true
