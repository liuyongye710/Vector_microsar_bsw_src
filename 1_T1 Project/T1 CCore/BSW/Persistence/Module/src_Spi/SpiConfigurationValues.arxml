AUTOSAR XML
package /ActiveEcuC
  module config Spi
    SpiDriver: import=NONE, SpiMaxChannel=4, SpiMaxJob=4, SpiMaxSequence=4
      4 x SpiChannel, all with import=NONE, SpiChannelType=EB, SpiDefaultData=0, SpiEbMaxLength=64, SpiIbNBuffers=1, SpiTransferStart=MSB:
        SpiChannel0: SpiChannelId=0, SpiDataWidth=8
        SpiChannel1: SpiChannelId=1, SpiDataWidth=16
        SpiChannel2: SpiChannelId=2, SpiDataWidth=8
        SpiChannel3: SpiChannelId=3, SpiDataWidth=16
      3 x SpiExternalDevice, all with import=NONE, SpiCsPolarity=LOW, SpiCsSelection=CS_VIA_GPIO, SpiDataShiftEdge=TRAILING:
        SpiExternalDevice0: SpiBaudrate=5000000, SpiCsIdentifier=0
        SpiExternalDevice1: SpiBaudrate=1000000, SpiCsIdentifier=1
        SpiExternalDevice2: SpiBaudrate=1000000, SpiCsIdentifier=2
      4 x SpiJob, all with import=NONE, SpiHwUnitSynchronous=SYNCHRONOUS:
        SpiJob0: SpiJobId=0, SpiDeviceAssignment=SpiExternalDevice0
          SpiChannelList0 (SpiChannelList): import=NONE, SpiChannelIndex=0, SpiChannelAssignment=SpiChannel0
        SpiJob1: SpiJobId=1, SpiDeviceAssignment=SpiExternalDevice1
          SpiChannelList0 (SpiChannelList): import=NONE, SpiChannelIndex=0, SpiChannelAssignment=SpiChannel1
        SpiJob2: SpiJobId=2, SpiDeviceAssignment=SpiExternalDevice2
          SpiChannelList0 (SpiChannelList): import=NONE, SpiChannelIndex=0, SpiChannelAssignment=SpiChannel2
        SpiJob3: SpiJobId=3, SpiDeviceAssignment=SpiExternalDevice0
          SpiChannelList0 (SpiChannelList): import=NONE, SpiChannelIndex=0, SpiChannelAssignment=SpiChannel3
      4 x SpiSequence, all with import=NONE:
        SpiSequence{0..3}: SpiSequenceId={0..3}, SpiJobAssignment=SpiJob{0..3}
    SpiGeneral: import=NONE
