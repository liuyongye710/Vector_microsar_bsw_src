AUTOSAR XML
package /ActiveEcuC
  module config Fee
    6 x FeeBlockConfiguration, all with import=NONE:
      FeeBlockConfiguration0: FeeBlockNumber=0, FeeBlockSize=0, FeeImmediateData=false
      FeeBlockConfiguration1_0: FeeBlockNumber=4, FeeBlockSize=5, FeeImmediateData=false
      FeeBlockConfiguration1_1: FeeBlockNumber=5, FeeBlockSize=5, FeeImmediateData=false
      Fee_dsm_nvm_data_block: FeeBlockNumber=8, FeeBlockSize=32772, FeeImmediateData=true
      Fee_app_nvm_data_block: FeeBlockNumber=12, FeeBlockSize=16388, FeeImmediateData=true
      Fee_data_nvm_onfly_block: FeeBlockNumber=16, FeeBlockSize=1028, FeeImmediateData=true
    FeeGeneral:
      import = NONE
      FeeDevErrorDetect = true
      FeeMainFunctionPeriod = 0.001
      FeeNvmJobEndNotification = NULL_PTR
      FeeNvmJobErrorNotification = NULL_PTR
      FeePollingMode = true
      FeeSetModeSupported = true
      FeeVersionInfoApi = true
      FeeVirtualPageSize = 8
      FeeSectorBlockThreshold = 1024
      FeeInternalBufferSize = 128
      FeeFirstSectorAddress = 229376
      FeeSecondSectorAddress = 491520
      FeeSectorSize = 262144
    FeeSectorConfiguration0 (FeeSectorConfiguration): import=NONE, FeeSectorNumber=1, FeeSectorAddress=229376, FeeSectorSize=262144
    FeeSectorConfiguration1 (FeeSectorConfiguration): import=NONE, FeeSectorNumber=2, FeeSectorAddress=491520, FeeSectorSize=262144
