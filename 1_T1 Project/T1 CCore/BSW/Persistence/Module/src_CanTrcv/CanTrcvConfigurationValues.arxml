AUTOSAR XML
package /ActiveEcuC
  module config CanTrcv
    CanTrcvConfigSet: import=NONE
      CanTrcvChannel0 (CanTrcvChannel):
        import = NONE
        CanTrcvChannelId = 0
        CanTrcvChannelUsed = true
        CanTrcvControlsPowerSupply = false
        CanTrcvHwPnSupport = false
        CanTrcvInitState = CANTRCV_OP_MODE_NORMAL
        CanTrcvMaxBaudrate = 500
        CanTrcvAccess: import=NONE
          CanTrcvSpiAccess: import=NONE
            CanTrcvSpiSequence0 (CanTrcvSpiSequence): import=NONE, CanTrcvSpiAccessSynchronous=false, CanTrcvSpiSequenceName=SpiSequence2
        CanTrcvPartialNetwork: import=NONE, CanTrcvBaudRate=500, CanTrcvPnFrameCanId=0, CanTrcvPnFrameCanIdMask=0, CanTrcvPnFrameDlc=0
    CanTrcvGeneral:
      import = NONE
      CanTrcvDevErrorDetect = false
      CanTrcvGetVersionInfo = false
      CanTrcvIndex = 0
      CanTrcvMainFunctionDiagnosticsPeriod = 0.005
      CanTrcvMainFunctionPeriod = 0.005
