AUTOSAR XML
package /ActiveEcuC
  module config CanSM
    CanSMConfiguration: import=NONE
      4 x CanSMManagerNetwork, all with import=COMM_IMPORT, CanSMBorCounterL1ToL2=5, CanSMBorTimeL1=0.05, CanSMBorTimeL2=0.2, CanSMBorTimeTxEnsured=1, CanSMBorTxConfirmationPolling=false:
        CAN_Matrix_DCDC_V0_1_20250414_VR82BV: CanSMComMNetworkHandleRef=CAN_MatrixDCDCV0120250305_VR82BV
          CanSMController: import=COMM_IMPORT, CanSMControllerId=CAN_Matrix_DCDC_V0_1_20250414_VR82BV
        FAW_MCD_MCU_CAN_V1_4_1_D3_sO0: CanSMComMNetworkHandleRef=FAW_PTCAN_MCU_V141_D3_sO0
          CanSMController: import=COMM_IMPORT, CanSMControllerId=FAW_MCD_MCU_CAN_V1_4_1_D3_sO0
        FAW2_MCD_MCU_CAN_DBC_V0_1_CHL_20241216_Voxyrf: CanSMComMNetworkHandleRef=FAW_MCD_MCU_Voxyrf
          CanSMController: import=COMM_IMPORT, CanSMControllerId=FAW2_MCD_MCU_CAN_DBC_V0_1_CHL_20241216_Voxyrf
        FAW3_HVAC_V2_0DBC_OjcG_c: CanSMComMNetworkHandleRef=FAW__HVACDCDC2__V20DBC_OjcG_c
          CanSMController: import=COMM_IMPORT, CanSMControllerId=FAW3_HVAC_V2_0DBC_OjcG_c
    CanSMGeneral: import=NONE, CanSMDevErrorDetect=false, CanSMMainFunctionTimePeriod=0.005, CanSMVersionInfoApi=false, CanSMPreNoComSpecialhandlingNoSleep=false
