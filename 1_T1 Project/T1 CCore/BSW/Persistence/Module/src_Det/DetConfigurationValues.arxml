AUTOSAR XML
package /ActiveEcuC
  module config Det
    DetGeneral: import=NONE
