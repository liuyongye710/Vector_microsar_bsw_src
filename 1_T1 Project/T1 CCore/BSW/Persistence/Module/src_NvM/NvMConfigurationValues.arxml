AUTOSAR XML
package /ActiveEcuC
  module config NvM
    3 x NvMBlockDescriptor, all with import=NONE, NvMBlockCrcType=NVM_CRC16, NvMBlockJobPriority=0, NvMBlockManagementType=NVM_BLOCK_NATIVE, NvMBlockUseAutoValidation=true, NvMBlockUseCRCCompMechanism=true, NvMBlockUseSetRamBlockStatus=true, NvMCalcRamBlockCrc=true, NvMInitBlockCallback=NULL_PTR, NvMMaxNumOfReadRetries=3, NvMMaxNumOfWriteRetries=3, NvMNvBlockNum=1, NvMNvramDeviceId=1, NvMReadRamBlockFromNvCallback=NULL_PTR, NvMResistantToChangedSw=true, NvMRomBlockNum=1, NvMSelectBlockForReadAll=true, NvMSelectBlockForWriteAll=true, NvMStaticBlockIDCheck=true, NvMWriteRamBlockToNvCallback=NULL_PTR:
      dsm_nvm_data_block: NvMBlockHeaderInclude=Nvm_Appl.h, NvMNvBlockLength=32768, NvMNvramBlockIdentifier=2, NvMRamBlockDataAddress=dsm_nvm_data, NvMRomBlockDataAddress=dsm_default_data
        NvMTargetBlockReference: import=NONE
          NvMFeeRef: import=NONE, NvMNameOfFeeBlock=Fee_dsm_nvm_data_block
      app_nvm_data_block: NvMNvBlockLength=16384, NvMNvramBlockIdentifier=3, NvMRamBlockDataAddress=app_nvm_data, NvMRomBlockDataAddress=app_default_data
        NvMTargetBlockReference: import=NONE
          NvMFeeRef: import=NONE, NvMNameOfFeeBlock=Fee_app_nvm_data_block
      data_nvm_onfly_block: NvMNvBlockLength=1024, NvMNvramBlockIdentifier=4, NvMRamBlockDataAddress=data_nvm_onfly, NvMRomBlockDataAddress=data_onfly_default
        NvMTargetBlockReference: import=NONE
          NvMFeeRef: import=NONE, NvMNameOfFeeBlock=Fee_data_nvm_onfly_block
    NvMCommon:
      import = NONE
      NvMApiConfigClass = NVM_API_CONFIG_CLASS_3
      NvMBswMMultiBlockJobStatusInformation = true
      NvMCompiledConfigId = 1
      NvMCrcNumOfBytes = 128
      NvMDatasetSelectionBits = 2
      NvMDevErrorDetect = true
      NvMDrvModeSwitch = true
      NvMDynamicConfiguration = true
      NvMJobPrioritization = true
      NvMMainFunctionPeriod = 0.001
      NvMPollingMode = true
      NvMRepeatMirrorOperations = 3
      NvMSetRamBlockStatusApi = true
