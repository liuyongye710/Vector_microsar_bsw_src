AUTOSAR XML
package /ActiveEcuC
  module config LinIf
