AUTOSAR XML
package /ActiveEcuC
  module config PduR
    5 x PduRBswModules, all with import=COMM_IMPORT, PduRTxConfirmation=true:
      PduRBswModules_CanIf: PduRCancelReceive=false, PduRCancelTransmit=false, PduRChangeParameterApi=false, PduRCommunicationInterface=true, PduRLowerModule=true, PduRRetransmission=false, PduRTransportProtocol=false, PduRTriggertransmit=false, PduRUpperModule=false, PduRUseTag=false, PduRBswModuleRef=CanIf
      PduRBswModules_CanTp: PduRCancelReceive=false, PduRCancelTransmit=false, PduRChangeParameterApi=false, PduRCommunicationInterface=false, PduRLowerModule=true, PduRRetransmission=false, PduRTransportProtocol=true, PduRTriggertransmit=false, PduRUpperModule=false, PduRUseTag=false, PduRBswModuleRef=CanTp
      PduRBswModules_Com: PduRCancelReceive=false, PduRCancelTransmit=false, PduRChangeParameterApi=false, PduRCommunicationInterface=true, PduRLowerModule=false, PduRRetransmission=false, PduRTransportProtocol=true, PduRTriggertransmit=true, PduRUpperModule=true, PduRUseTag=false, PduRBswModuleRef=Com
      PduRBswModules_Dcm: PduRCancelReceive=false, PduRCancelTransmit=false, PduRChangeParameterApi=false, PduRCommunicationInterface=false, PduRLowerModule=false, PduRRetransmission=false, PduRTransportProtocol=true, PduRTriggertransmit=false, PduRUpperModule=true, PduRUseTag=false, PduRBswModuleRef=Dcm
      PduRBswModules_J1939Tp: PduRLowerModule=true, PduRTransportProtocol=true, PduRBswModuleRef=J1939Tp
    PduRGeneral:
      import = NONE
      PduRDevErrorDetect = false
      PduRVersionInfoApi = false
      PduRZeroCostOperation = false
      PduRSupportIfGetway = false
      PduRSupportTpGetway = false
      PduRSupportIfMulicast = false
      PduRSupportTpMulicast = false
      PduRSupportMultiCore = false
      PduRSupportDiagnosis = false
    PduRRoutingTables: import=NONE, PduRConfigurationId=1, PduRMaxRoutingPathCnt=47, PduRMaxRoutingPathGroupCnt=5, PduRMaxRoutingTableCnt=1
      5 x PduRRoutingPathGroup, all with import=COMM_IMPORT, PduRIsEnabledAtInit=true:
        PduRRoutingPathGroup_Com: PduRRoutingPathGroupId=0, PduRDestPduRef=TSC1Mtr_D3_sO0, PduRDestPduRef=EEC2HCU_D3_sO0, PduRDestPduRef=CCVSHCU_D3_sO0, PduRDestPduRef=TC1_D3_sO0, PduRDestPduRef=TC1Handle_D3_sO0, PduRDestPduRef=ETC1_D3_sO0, PduRDestPduRef=ETC2_D3_sO0, PduRDestPduRef=AMT3_D3_sO0, PduRDestPduRef=HCUMCU_D3_sO0, PduRDestPduRef=HCUMCU2_D3_sO0, PduRDestPduRef=SC_D3_sO0, PduRDestPduRef=TSC1Mtr2_D3_sO0, PduRDestPduRef=DCDC_Status1_VR82BV, PduRDestPduRef=DCDC_Status2_VR82BV, PduRDestPduRef=DCDC_Status3_VR82BV, PduRDestPduRef=HCUAPCU_OjcG_c, PduRDestPduRef=HCUOPCU_OjcG_c, PduRDestPduRef=HCU3_OjcG_c, PduRDestPduRef=BMS5_OjcG_c, PduRDestPduRef=MCU2_OjcG_c, PduRDestPduRef=HCUDCDC_OjcG_c
        PduRRoutingPathGroup_Dcm: PduRRoutingPathGroupId=1, PduRDestPduRef=MCU_Rx_Data_2_Voxyrf, PduRDestPduRef=MCU_Rx_Data_1_Voxyrf
        PduRRoutingPathGroup_CanIf: PduRRoutingPathGroupId=2, PduRDestPduRef=MCU1_D3_sO0, PduRDestPduRef=MCU3_D3_sO0, PduRDestPduRef=MCU21_D3_sO0, PduRDestPduRef=MCU22_D3_sO0, PduRDestPduRef=MCU23_D3_sO0, PduRDestPduRef=MCU2_D3_sO0, PduRDestPduRef=DCDC_Cmd1_VR82BV, PduRDestPduRef=APCU1_OjcG_c, PduRDestPduRef=APCU2_OjcG_c, PduRDestPduRef=DCDC1_OjcG_c, PduRDestPduRef=OPCU1_OjcG_c, PduRDestPduRef=OPCU2_OjcG_c, PduRDestPduRef=RelayState_OjcG_c, PduRDestPduRef=RelayState2_OjcG_c, PduRDestPduRef=IMCU1PTU_OjcG_c, PduRDestPduRef=MECU1Reserved_OjcG_c
        PduRRoutingPathGroup_CanTp: PduRRoutingPathGroupId=3, PduRDestPduRef=MCU_Tx_Data_Voxyrf
        PduRRoutingPathGroup_J1939Tp: PduRRoutingPathGroupId=4, PduRDestPduRef=ECMCU_D3_sO0, PduRDestPduRef=DM1MCU_D3_sO0, PduRDestPduRef=DM1MCU2_D3_sO0, PduRDestPduRef=DM1APCU_OjcG_c, PduRDestPduRef=DM1DCDC_OjcG_c, PduRDestPduRef=DM1OPCU_OjcG_c, PduRDestPduRef=DM1PTU_OjcG_c
      PduRRoutingTable: import=NONE
        47 x PduRRoutingPath, all with import=COMM_IMPORT:
          MCU1_D3_sO0
            MCU1_D3_sO0 (PduRDestPdu):
              import = COMM_IMPORT
              PduRDestPduDataProvision = PDUR_DIRECT
              PduRDestPduHandleId = 0
              PduRTransmissionConfirmation = true
              PduRDestPduRef = MCU1_D3_sO0
              PduRDestModuleRef = PduRBswModules_CanIf
            PduRSrcPdu: import=COMM_IMPORT, PduRSourcePduHandleId=0, PduRSrcPduUpTxConf=true, PduRSrcPduRef=MCU1_D3_sO0, PduRSrcModuleRef=PduRBswModules_Com
          ECMCU_D3_sO0
            ECMCU_D3_sO0 (PduRDestPdu):
              import = COMM_IMPORT
              PduRDestPduDataProvision = PDUR_DIRECT
              PduRDestPduHandleId = 1
              PduRTransmissionConfirmation = true
              PduRDestPduRef = ECMCU_D3_sO0
              PduRDestModuleRef = PduRBswModules_J1939Tp
            PduRSrcPdu: import=COMM_IMPORT, PduRSourcePduHandleId=1, PduRSrcPduUpTxConf=true, PduRSrcPduRef=ECMCU_D3_sO0, PduRSrcModuleRef=PduRBswModules_Com
          MCU3_D3_sO0
            MCU3_D3_sO0 (PduRDestPdu):
              import = COMM_IMPORT
              PduRDestPduDataProvision = PDUR_DIRECT
              PduRDestPduHandleId = 2
              PduRTransmissionConfirmation = true
              PduRDestPduRef = MCU3_D3_sO0
              PduRDestModuleRef = PduRBswModules_CanIf
            PduRSrcPdu: import=COMM_IMPORT, PduRSourcePduHandleId=2, PduRSrcPduUpTxConf=true, PduRSrcPduRef=MCU3_D3_sO0, PduRSrcModuleRef=PduRBswModules_Com
          MCU21_D3_sO0
            MCU21_D3_sO0 (PduRDestPdu):
              import = COMM_IMPORT
              PduRDestPduDataProvision = PDUR_DIRECT
              PduRDestPduHandleId = 3
              PduRTransmissionConfirmation = true
              PduRDestPduRef = MCU21_D3_sO0
              PduRDestModuleRef = PduRBswModules_CanIf
            PduRSrcPdu: import=COMM_IMPORT, PduRSourcePduHandleId=3, PduRSrcPduUpTxConf=true, PduRSrcPduRef=MCU21_D3_sO0, PduRSrcModuleRef=PduRBswModules_Com
          MCU22_D3_sO0
            MCU22_D3_sO0 (PduRDestPdu):
              import = COMM_IMPORT
              PduRDestPduDataProvision = PDUR_DIRECT
              PduRDestPduHandleId = 4
              PduRTransmissionConfirmation = true
              PduRDestPduRef = MCU22_D3_sO0
              PduRDestModuleRef = PduRBswModules_CanIf
            PduRSrcPdu: import=COMM_IMPORT, PduRSourcePduHandleId=4, PduRSrcPduUpTxConf=true, PduRSrcPduRef=MCU22_D3_sO0, PduRSrcModuleRef=PduRBswModules_Com
          MCU23_D3_sO0
            MCU23_D3_sO0 (PduRDestPdu):
              import = COMM_IMPORT
              PduRDestPduDataProvision = PDUR_DIRECT
              PduRDestPduHandleId = 5
              PduRTransmissionConfirmation = true
              PduRDestPduRef = MCU23_D3_sO0
              PduRDestModuleRef = PduRBswModules_CanIf
            PduRSrcPdu: import=COMM_IMPORT, PduRSourcePduHandleId=5, PduRSrcPduUpTxConf=true, PduRSrcPduRef=MCU23_D3_sO0, PduRSrcModuleRef=PduRBswModules_Com
          DM1MCU_D3_sO0
            DM1MCU_D3_sO0 (PduRDestPdu):
              import = COMM_IMPORT
              PduRDestPduDataProvision = PDUR_DIRECT
              PduRDestPduHandleId = 6
              PduRTransmissionConfirmation = true
              PduRDestPduRef = DM1MCU_D3_sO0
              PduRDestModuleRef = PduRBswModules_J1939Tp
            PduRSrcPdu: import=COMM_IMPORT, PduRSourcePduHandleId=6, PduRSrcPduUpTxConf=true, PduRSrcPduRef=DM1MCU_D3_sO0, PduRSrcModuleRef=PduRBswModules_Com
          DM1MCU2_D3_sO0
            DM1MCU2_D3_sO0 (PduRDestPdu):
              import = COMM_IMPORT
              PduRDestPduDataProvision = PDUR_DIRECT
              PduRDestPduHandleId = 7
              PduRTransmissionConfirmation = true
              PduRDestPduRef = DM1MCU2_D3_sO0
              PduRDestModuleRef = PduRBswModules_J1939Tp
            PduRSrcPdu: import=COMM_IMPORT, PduRSourcePduHandleId=7, PduRSrcPduUpTxConf=true, PduRSrcPduRef=DM1MCU2_D3_sO0, PduRSrcModuleRef=PduRBswModules_Com
          MCU2_D3_sO0
            MCU2_D3_sO0 (PduRDestPdu):
              import = COMM_IMPORT
              PduRDestPduDataProvision = PDUR_DIRECT
              PduRDestPduHandleId = 8
              PduRTransmissionConfirmation = true
              PduRDestPduRef = MCU2_D3_sO0
              PduRDestModuleRef = PduRBswModules_CanIf
            PduRSrcPdu: import=COMM_IMPORT, PduRSourcePduHandleId=8, PduRSrcPduUpTxConf=true, PduRSrcPduRef=MCU2_D3_sO0, PduRSrcModuleRef=PduRBswModules_Com
          TSC1Mtr_D3_sO0
            TSC1Mtr_D3_sO0 (PduRDestPdu):
              import = COMM_IMPORT
              PduRDestPduDataProvision = PDUR_DIRECT
              PduRDestPduHandleId = 9
              PduRTransmissionConfirmation = false
              PduRDestPduRef = TSC1Mtr_D3_sO0
              PduRDestModuleRef = PduRBswModules_Com
            PduRSrcPdu: import=COMM_IMPORT, PduRSourcePduHandleId=9, PduRSrcPduUpTxConf=false, PduRSrcPduRef=TSC1Mtr_D3_sO0, PduRSrcModuleRef=PduRBswModules_CanIf
          EEC2HCU_D3_sO0
            EEC2HCU_D3_sO0 (PduRDestPdu):
              import = COMM_IMPORT
              PduRDestPduDataProvision = PDUR_DIRECT
              PduRDestPduHandleId = 10
              PduRTransmissionConfirmation = false
              PduRDestPduRef = EEC2HCU_D3_sO0
              PduRDestModuleRef = PduRBswModules_Com
            PduRSrcPdu: import=COMM_IMPORT, PduRSourcePduHandleId=10, PduRSrcPduUpTxConf=false, PduRSrcPduRef=EEC2HCU_D3_sO0, PduRSrcModuleRef=PduRBswModules_CanIf
          CCVSHCU_D3_sO0
            CCVSHCU_D3_sO0 (PduRDestPdu):
              import = COMM_IMPORT
              PduRDestPduDataProvision = PDUR_DIRECT
              PduRDestPduHandleId = 11
              PduRTransmissionConfirmation = false
              PduRDestPduRef = CCVSHCU_D3_sO0
              PduRDestModuleRef = PduRBswModules_Com
            PduRSrcPdu: import=COMM_IMPORT, PduRSourcePduHandleId=11, PduRSrcPduUpTxConf=false, PduRSrcPduRef=CCVSHCU_D3_sO0, PduRSrcModuleRef=PduRBswModules_CanIf
          TC1_D3_sO0
            TC1_D3_sO0 (PduRDestPdu):
              import = COMM_IMPORT
              PduRDestPduDataProvision = PDUR_DIRECT
              PduRDestPduHandleId = 12
              PduRTransmissionConfirmation = false
              PduRDestPduRef = TC1_D3_sO0
              PduRDestModuleRef = PduRBswModules_Com
            PduRSrcPdu: import=COMM_IMPORT, PduRSourcePduHandleId=12, PduRSrcPduUpTxConf=false, PduRSrcPduRef=TC1_D3_sO0, PduRSrcModuleRef=PduRBswModules_CanIf
          TC1Handle_D3_sO0
            TC1Handle_D3_sO0 (PduRDestPdu):
              import = COMM_IMPORT
              PduRDestPduDataProvision = PDUR_DIRECT
              PduRDestPduHandleId = 13
              PduRTransmissionConfirmation = false
              PduRDestPduRef = TC1Handle_D3_sO0
              PduRDestModuleRef = PduRBswModules_Com
            PduRSrcPdu: import=COMM_IMPORT, PduRSourcePduHandleId=13, PduRSrcPduUpTxConf=false, PduRSrcPduRef=TC1Handle_D3_sO0, PduRSrcModuleRef=PduRBswModules_CanIf
          ETC1_D3_sO0
            ETC1_D3_sO0 (PduRDestPdu):
              import = COMM_IMPORT
              PduRDestPduDataProvision = PDUR_DIRECT
              PduRDestPduHandleId = 14
              PduRTransmissionConfirmation = false
              PduRDestPduRef = ETC1_D3_sO0
              PduRDestModuleRef = PduRBswModules_Com
            PduRSrcPdu: import=COMM_IMPORT, PduRSourcePduHandleId=14, PduRSrcPduUpTxConf=false, PduRSrcPduRef=ETC1_D3_sO0, PduRSrcModuleRef=PduRBswModules_CanIf
          ETC2_D3_sO0
            ETC2_D3_sO0 (PduRDestPdu):
              import = COMM_IMPORT
              PduRDestPduDataProvision = PDUR_DIRECT
              PduRDestPduHandleId = 15
              PduRTransmissionConfirmation = false
              PduRDestPduRef = ETC2_D3_sO0
              PduRDestModuleRef = PduRBswModules_Com
            PduRSrcPdu: import=COMM_IMPORT, PduRSourcePduHandleId=15, PduRSrcPduUpTxConf=false, PduRSrcPduRef=ETC2_D3_sO0, PduRSrcModuleRef=PduRBswModules_CanIf
          AMT3_D3_sO0
            AMT3_D3_sO0 (PduRDestPdu):
              import = COMM_IMPORT
              PduRDestPduDataProvision = PDUR_DIRECT
              PduRDestPduHandleId = 16
              PduRTransmissionConfirmation = false
              PduRDestPduRef = AMT3_D3_sO0
              PduRDestModuleRef = PduRBswModules_Com
            PduRSrcPdu: import=COMM_IMPORT, PduRSourcePduHandleId=16, PduRSrcPduUpTxConf=false, PduRSrcPduRef=AMT3_D3_sO0, PduRSrcModuleRef=PduRBswModules_CanIf
          HCUMCU_D3_sO0
            HCUMCU_D3_sO0 (PduRDestPdu):
              import = COMM_IMPORT
              PduRDestPduDataProvision = PDUR_DIRECT
              PduRDestPduHandleId = 17
              PduRTransmissionConfirmation = false
              PduRDestPduRef = HCUMCU_D3_sO0
              PduRDestModuleRef = PduRBswModules_Com
            PduRSrcPdu: import=COMM_IMPORT, PduRSourcePduHandleId=17, PduRSrcPduUpTxConf=false, PduRSrcPduRef=HCUMCU_D3_sO0, PduRSrcModuleRef=PduRBswModules_CanIf
          HCUMCU2_D3_sO0
            HCUMCU2_D3_sO0 (PduRDestPdu):
              import = COMM_IMPORT
              PduRDestPduDataProvision = PDUR_DIRECT
              PduRDestPduHandleId = 18
              PduRTransmissionConfirmation = false
              PduRDestPduRef = HCUMCU2_D3_sO0
              PduRDestModuleRef = PduRBswModules_Com
            PduRSrcPdu: import=COMM_IMPORT, PduRSourcePduHandleId=18, PduRSrcPduUpTxConf=false, PduRSrcPduRef=HCUMCU2_D3_sO0, PduRSrcModuleRef=PduRBswModules_CanIf
          SC_D3_sO0
            SC_D3_sO0 (PduRDestPdu):
              import = COMM_IMPORT
              PduRDestPduDataProvision = PDUR_DIRECT
              PduRDestPduHandleId = 19
              PduRTransmissionConfirmation = false
              PduRDestPduRef = SC_D3_sO0
              PduRDestModuleRef = PduRBswModules_Com
            PduRSrcPdu: import=COMM_IMPORT, PduRSourcePduHandleId=19, PduRSrcPduUpTxConf=false, PduRSrcPduRef=SC_D3_sO0, PduRSrcModuleRef=PduRBswModules_CanIf
          TSC1Mtr2_D3_sO0
            TSC1Mtr2_D3_sO0 (PduRDestPdu):
              import = COMM_IMPORT
              PduRDestPduDataProvision = PDUR_DIRECT
              PduRDestPduHandleId = 20
              PduRTransmissionConfirmation = false
              PduRDestPduRef = TSC1Mtr2_D3_sO0
              PduRDestModuleRef = PduRBswModules_Com
            PduRSrcPdu: import=COMM_IMPORT, PduRSourcePduHandleId=20, PduRSrcPduUpTxConf=false, PduRSrcPduRef=TSC1Mtr2_D3_sO0, PduRSrcModuleRef=PduRBswModules_CanIf
          MCU_Tx_Data_Voxyrf
            MCU_Tx_Data_Voxyrf (PduRDestPdu):
              import = COMM_IMPORT
              PduRDestPduDataProvision = PDUR_DIRECT
              PduRDestPduHandleId = 21
              PduRTransmissionConfirmation = true
              PduRDestPduRef = MCU_Tx_Data_Voxyrf
              PduRDestModuleRef = PduRBswModules_CanTp
            PduRSrcPdu: import=COMM_IMPORT, PduRSourcePduHandleId=21, PduRSrcPduUpTxConf=true, PduRSrcPduRef=MCU_Tx_Data_Voxyrf, PduRSrcModuleRef=PduRBswModules_Dcm
          MCU_Rx_Data_2_Voxyrf
            MCU_Rx_Data_2_Voxyrf (PduRDestPdu):
              import = COMM_IMPORT
              PduRDestPduDataProvision = PDUR_DIRECT
              PduRDestPduHandleId = 22
              PduRTransmissionConfirmation = false
              PduRDestPduRef = MCU_Rx_Data_2_Voxyrf
              PduRDestModuleRef = PduRBswModules_Dcm
            PduRSrcPdu: import=COMM_IMPORT, PduRSourcePduHandleId=22, PduRSrcPduUpTxConf=false, PduRSrcPduRef=MCU_Rx_Data_2_Voxyrf, PduRSrcModuleRef=PduRBswModules_CanTp
          MCU_Rx_Data_1_Voxyrf
            MCU_Rx_Data_1_Voxyrf (PduRDestPdu):
              import = COMM_IMPORT
              PduRDestPduDataProvision = PDUR_DIRECT
              PduRDestPduHandleId = 23
              PduRTransmissionConfirmation = false
              PduRDestPduRef = MCU_Rx_Data_1_Voxyrf
              PduRDestModuleRef = PduRBswModules_Dcm
            PduRSrcPdu: import=COMM_IMPORT, PduRSourcePduHandleId=23, PduRSrcPduUpTxConf=false, PduRSrcPduRef=MCU_Rx_Data_1_Voxyrf, PduRSrcModuleRef=PduRBswModules_CanTp
          DCDC_Cmd1_VR82BV
            DCDC_Cmd1_VR82BV (PduRDestPdu):
              import = COMM_IMPORT
              PduRDestPduDataProvision = PDUR_DIRECT
              PduRDestPduHandleId = 24
              PduRTransmissionConfirmation = true
              PduRDestPduRef = DCDC_Cmd1_VR82BV
              PduRDestModuleRef = PduRBswModules_CanIf
            PduRSrcPdu: import=COMM_IMPORT, PduRSourcePduHandleId=24, PduRSrcPduUpTxConf=true, PduRSrcPduRef=DCDC_Cmd1_VR82BV, PduRSrcModuleRef=PduRBswModules_Com
          DCDC_Status1_VR82BV
            DCDC_Status1_VR82BV (PduRDestPdu):
              import = COMM_IMPORT
              PduRDestPduDataProvision = PDUR_DIRECT
              PduRDestPduHandleId = 25
              PduRTransmissionConfirmation = false
              PduRDestPduRef = DCDC_Status1_VR82BV
              PduRDestModuleRef = PduRBswModules_Com
            PduRSrcPdu: import=COMM_IMPORT, PduRSourcePduHandleId=25, PduRSrcPduUpTxConf=false, PduRSrcPduRef=DCDC_Status1_VR82BV, PduRSrcModuleRef=PduRBswModules_CanIf
          DCDC_Status2_VR82BV
            DCDC_Status2_VR82BV (PduRDestPdu):
              import = COMM_IMPORT
              PduRDestPduDataProvision = PDUR_DIRECT
              PduRDestPduHandleId = 26
              PduRTransmissionConfirmation = false
              PduRDestPduRef = DCDC_Status2_VR82BV
              PduRDestModuleRef = PduRBswModules_Com
            PduRSrcPdu: import=COMM_IMPORT, PduRSourcePduHandleId=26, PduRSrcPduUpTxConf=false, PduRSrcPduRef=DCDC_Status2_VR82BV, PduRSrcModuleRef=PduRBswModules_CanIf
          DCDC_Status3_VR82BV
            DCDC_Status3_VR82BV (PduRDestPdu):
              import = COMM_IMPORT
              PduRDestPduDataProvision = PDUR_DIRECT
              PduRDestPduHandleId = 27
              PduRTransmissionConfirmation = false
              PduRDestPduRef = DCDC_Status3_VR82BV
              PduRDestModuleRef = PduRBswModules_Com
            PduRSrcPdu: import=COMM_IMPORT, PduRSourcePduHandleId=27, PduRSrcPduUpTxConf=false, PduRSrcPduRef=DCDC_Status3_VR82BV, PduRSrcModuleRef=PduRBswModules_CanIf
          APCU1_OjcG_c
            APCU1_OjcG_c (PduRDestPdu):
              import = COMM_IMPORT
              PduRDestPduDataProvision = PDUR_DIRECT
              PduRDestPduHandleId = 28
              PduRTransmissionConfirmation = true
              PduRDestPduRef = APCU1_OjcG_c
              PduRDestModuleRef = PduRBswModules_CanIf
            PduRSrcPdu: import=COMM_IMPORT, PduRSourcePduHandleId=28, PduRSrcPduUpTxConf=true, PduRSrcPduRef=APCU1_OjcG_c, PduRSrcModuleRef=PduRBswModules_Com
          APCU2_OjcG_c
            APCU2_OjcG_c (PduRDestPdu):
              import = COMM_IMPORT
              PduRDestPduDataProvision = PDUR_DIRECT
              PduRDestPduHandleId = 29
              PduRTransmissionConfirmation = true
              PduRDestPduRef = APCU2_OjcG_c
              PduRDestModuleRef = PduRBswModules_CanIf
            PduRSrcPdu: import=COMM_IMPORT, PduRSourcePduHandleId=29, PduRSrcPduUpTxConf=true, PduRSrcPduRef=APCU2_OjcG_c, PduRSrcModuleRef=PduRBswModules_Com
          DM1APCU_OjcG_c
            DM1APCU_OjcG_c (PduRDestPdu):
              import = COMM_IMPORT
              PduRDestPduDataProvision = PDUR_DIRECT
              PduRDestPduHandleId = 30
              PduRTransmissionConfirmation = true
              PduRDestPduRef = DM1APCU_OjcG_c
              PduRDestModuleRef = PduRBswModules_J1939Tp
            PduRSrcPdu: import=COMM_IMPORT, PduRSourcePduHandleId=30, PduRSrcPduUpTxConf=true, PduRSrcPduRef=DM1APCU_OjcG_c, PduRSrcModuleRef=PduRBswModules_Com
          DCDC1_OjcG_c
            DCDC1_OjcG_c (PduRDestPdu):
              import = COMM_IMPORT
              PduRDestPduDataProvision = PDUR_DIRECT
              PduRDestPduHandleId = 31
              PduRTransmissionConfirmation = true
              PduRDestPduRef = DCDC1_OjcG_c
              PduRDestModuleRef = PduRBswModules_CanIf
            PduRSrcPdu: import=COMM_IMPORT, PduRSourcePduHandleId=31, PduRSrcPduUpTxConf=true, PduRSrcPduRef=DCDC1_OjcG_c, PduRSrcModuleRef=PduRBswModules_Com
          DM1DCDC_OjcG_c
            DM1DCDC_OjcG_c (PduRDestPdu):
              import = COMM_IMPORT
              PduRDestPduDataProvision = PDUR_DIRECT
              PduRDestPduHandleId = 32
              PduRTransmissionConfirmation = true
              PduRDestPduRef = DM1DCDC_OjcG_c
              PduRDestModuleRef = PduRBswModules_J1939Tp
            PduRSrcPdu: import=COMM_IMPORT, PduRSourcePduHandleId=32, PduRSrcPduUpTxConf=true, PduRSrcPduRef=DM1DCDC_OjcG_c, PduRSrcModuleRef=PduRBswModules_Com
          DM1OPCU_OjcG_c
            DM1OPCU_OjcG_c (PduRDestPdu):
              import = COMM_IMPORT
              PduRDestPduDataProvision = PDUR_DIRECT
              PduRDestPduHandleId = 33
              PduRTransmissionConfirmation = true
              PduRDestPduRef = DM1OPCU_OjcG_c
              PduRDestModuleRef = PduRBswModules_J1939Tp
            PduRSrcPdu: import=COMM_IMPORT, PduRSourcePduHandleId=33, PduRSrcPduUpTxConf=true, PduRSrcPduRef=DM1OPCU_OjcG_c, PduRSrcModuleRef=PduRBswModules_Com
          OPCU1_OjcG_c
            OPCU1_OjcG_c (PduRDestPdu):
              import = COMM_IMPORT
              PduRDestPduDataProvision = PDUR_DIRECT
              PduRDestPduHandleId = 34
              PduRTransmissionConfirmation = true
              PduRDestPduRef = OPCU1_OjcG_c
              PduRDestModuleRef = PduRBswModules_CanIf
            PduRSrcPdu: import=COMM_IMPORT, PduRSourcePduHandleId=34, PduRSrcPduUpTxConf=true, PduRSrcPduRef=OPCU1_OjcG_c, PduRSrcModuleRef=PduRBswModules_Com
          OPCU2_OjcG_c
            OPCU2_OjcG_c (PduRDestPdu):
              import = COMM_IMPORT
              PduRDestPduDataProvision = PDUR_DIRECT
              PduRDestPduHandleId = 35
              PduRTransmissionConfirmation = true
              PduRDestPduRef = OPCU2_OjcG_c
              PduRDestModuleRef = PduRBswModules_CanIf
            PduRSrcPdu: import=COMM_IMPORT, PduRSourcePduHandleId=35, PduRSrcPduUpTxConf=true, PduRSrcPduRef=OPCU2_OjcG_c, PduRSrcModuleRef=PduRBswModules_Com
          RelayState_OjcG_c
            RelayState_OjcG_c (PduRDestPdu):
              import = COMM_IMPORT
              PduRDestPduDataProvision = PDUR_DIRECT
              PduRDestPduHandleId = 36
              PduRTransmissionConfirmation = true
              PduRDestPduRef = RelayState_OjcG_c
              PduRDestModuleRef = PduRBswModules_CanIf
            PduRSrcPdu: import=COMM_IMPORT, PduRSourcePduHandleId=36, PduRSrcPduUpTxConf=true, PduRSrcPduRef=RelayState_OjcG_c, PduRSrcModuleRef=PduRBswModules_Com
          RelayState2_OjcG_c
            RelayState2_OjcG_c (PduRDestPdu):
              import = COMM_IMPORT
              PduRDestPduDataProvision = PDUR_DIRECT
              PduRDestPduHandleId = 37
              PduRTransmissionConfirmation = true
              PduRDestPduRef = RelayState2_OjcG_c
              PduRDestModuleRef = PduRBswModules_CanIf
            PduRSrcPdu: import=COMM_IMPORT, PduRSourcePduHandleId=37, PduRSrcPduUpTxConf=true, PduRSrcPduRef=RelayState2_OjcG_c, PduRSrcModuleRef=PduRBswModules_Com
          IMCU1PTU_OjcG_c
            IMCU1PTU_OjcG_c (PduRDestPdu):
              import = COMM_IMPORT
              PduRDestPduDataProvision = PDUR_DIRECT
              PduRDestPduHandleId = 38
              PduRTransmissionConfirmation = true
              PduRDestPduRef = IMCU1PTU_OjcG_c
              PduRDestModuleRef = PduRBswModules_CanIf
            PduRSrcPdu: import=COMM_IMPORT, PduRSourcePduHandleId=38, PduRSrcPduUpTxConf=true, PduRSrcPduRef=IMCU1PTU_OjcG_c, PduRSrcModuleRef=PduRBswModules_Com
          MECU1Reserved_OjcG_c
            MECU1Reserved_OjcG_c (PduRDestPdu):
              import = COMM_IMPORT
              PduRDestPduDataProvision = PDUR_DIRECT
              PduRDestPduHandleId = 39
              PduRTransmissionConfirmation = true
              PduRDestPduRef = MECU1Reserved_OjcG_c
              PduRDestModuleRef = PduRBswModules_CanIf
            PduRSrcPdu: import=COMM_IMPORT, PduRSourcePduHandleId=39, PduRSrcPduUpTxConf=true, PduRSrcPduRef=MECU1Reserved_OjcG_c, PduRSrcModuleRef=PduRBswModules_Com
          DM1PTU_OjcG_c
            DM1PTU_OjcG_c (PduRDestPdu):
              import = COMM_IMPORT
              PduRDestPduDataProvision = PDUR_DIRECT
              PduRDestPduHandleId = 40
              PduRTransmissionConfirmation = true
              PduRDestPduRef = DM1PTU_OjcG_c
              PduRDestModuleRef = PduRBswModules_J1939Tp
            PduRSrcPdu: import=COMM_IMPORT, PduRSourcePduHandleId=40, PduRSrcPduUpTxConf=true, PduRSrcPduRef=DM1PTU_OjcG_c, PduRSrcModuleRef=PduRBswModules_Com
          HCUDCDC_OjcG_c
            HCUDCDC_OjcG_c (PduRDestPdu):
              import = COMM_IMPORT
              PduRDestPduDataProvision = PDUR_DIRECT
              PduRDestPduHandleId = 41
              PduRTransmissionConfirmation = false
              PduRDestPduRef = HCUDCDC_OjcG_c
              PduRDestModuleRef = PduRBswModules_Com
            PduRSrcPdu: import=COMM_IMPORT, PduRSourcePduHandleId=41, PduRSrcPduUpTxConf=false, PduRSrcPduRef=HCUDCDC_OjcG_c, PduRSrcModuleRef=PduRBswModules_CanIf
          HCUAPCU_OjcG_c
            HCUAPCU_OjcG_c (PduRDestPdu):
              import = COMM_IMPORT
              PduRDestPduDataProvision = PDUR_DIRECT
              PduRDestPduHandleId = 42
              PduRTransmissionConfirmation = false
              PduRDestPduRef = HCUAPCU_OjcG_c
              PduRDestModuleRef = PduRBswModules_Com
            PduRSrcPdu: import=COMM_IMPORT, PduRSourcePduHandleId=42, PduRSrcPduUpTxConf=false, PduRSrcPduRef=HCUAPCU_OjcG_c, PduRSrcModuleRef=PduRBswModules_CanIf
          HCUOPCU_OjcG_c
            HCUOPCU_OjcG_c (PduRDestPdu):
              import = COMM_IMPORT
              PduRDestPduDataProvision = PDUR_DIRECT
              PduRDestPduHandleId = 43
              PduRTransmissionConfirmation = false
              PduRDestPduRef = HCUOPCU_OjcG_c
              PduRDestModuleRef = PduRBswModules_Com
            PduRSrcPdu: import=COMM_IMPORT, PduRSourcePduHandleId=43, PduRSrcPduUpTxConf=false, PduRSrcPduRef=HCUOPCU_OjcG_c, PduRSrcModuleRef=PduRBswModules_CanIf
          HCU3_OjcG_c
            HCU3_OjcG_c (PduRDestPdu):
              import = COMM_IMPORT
              PduRDestPduDataProvision = PDUR_DIRECT
              PduRDestPduHandleId = 44
              PduRTransmissionConfirmation = false
              PduRDestPduRef = HCU3_OjcG_c
              PduRDestModuleRef = PduRBswModules_Com
            PduRSrcPdu: import=COMM_IMPORT, PduRSourcePduHandleId=44, PduRSrcPduUpTxConf=false, PduRSrcPduRef=HCU3_OjcG_c, PduRSrcModuleRef=PduRBswModules_CanIf
          BMS5_OjcG_c
            BMS5_OjcG_c (PduRDestPdu):
              import = COMM_IMPORT
              PduRDestPduDataProvision = PDUR_DIRECT
              PduRDestPduHandleId = 45
              PduRTransmissionConfirmation = false
              PduRDestPduRef = BMS5_OjcG_c
              PduRDestModuleRef = PduRBswModules_Com
            PduRSrcPdu: import=COMM_IMPORT, PduRSourcePduHandleId=45, PduRSrcPduUpTxConf=false, PduRSrcPduRef=BMS5_OjcG_c, PduRSrcModuleRef=PduRBswModules_CanIf
          MCU2_OjcG_c
            MCU2_OjcG_c (PduRDestPdu):
              import = COMM_IMPORT
              PduRDestPduDataProvision = PDUR_DIRECT
              PduRDestPduHandleId = 46
              PduRTransmissionConfirmation = false
              PduRDestPduRef = MCU2_OjcG_c
              PduRDestModuleRef = PduRBswModules_Com
            PduRSrcPdu: import=COMM_IMPORT, PduRSourcePduHandleId=46, PduRSrcPduUpTxConf=false, PduRSrcPduRef=MCU2_OjcG_c, PduRSrcModuleRef=PduRBswModules_CanIf
