AUTOSAR XML
package /ActiveEcuC
  module config EcuM
    EcuMConfiguration: import=NONE
      EcuMCommonConfiguration:
        import = NONE
        EcuMDefaultAppMode = OSDEFAULTAPPMODE
        EcuMOSResource = Core{0..2}_Task_OsResource{0..2}
        EcuMDefaultShutdownTarget: import=NONE, EcuMDefaultState=EcuMStateOff
        EcuMDriverInitListOne: import=NONE
          13 x EcuMDriverInitItem, all with import=NONE:
            Adc_InitFunction: EcuMModuleID=Adc, EcuMModuleParameter=POSTBUILD_PTR, EcuMPbParameter=&Adc_Config, EcuMModuleService=Init, EcuMHeaderFile=Adc.h, OSCoreRef=OsCore_CORE2
            Can_InitFunction: EcuMModuleID=Can, EcuMModuleParameter=POSTBUILD_PTR, EcuMPbParameter=&Can_Config, EcuMModuleService=Init, EcuMHeaderFile=Can.h, OSCoreRef=OsCore_CORE2
            CalAppl_InitFunction: EcuMModuleID=CalAppl, EcuMModuleParameter=VOID, EcuMModuleService=CalSramInit, EcuMHeaderFile=Cal_Appl.h, OSCoreRef=OsCore_CORE2
            Fls_InitFunction: EcuMModuleID=Fls, EcuMModuleParameter=POSTBUILD_PTR, EcuMPbParameter=&Fls_Config, EcuMModuleService=Init, EcuMHeaderFile=Fls.h, OSCoreRef=OsCore_CORE2
            Gpt_InitFunction: EcuMModuleID=Gpt, EcuMModuleParameter=POSTBUILD_PTR, EcuMPbParameter=&GptChannelConfigSet_0, EcuMModuleService=Init, EcuMHeaderFile=Gpt.h, OSCoreRef=OsCore_CORE2
            Icu_InitFunction: EcuMModuleID=Icu, EcuMModuleParameter=POSTBUILD_PTR, EcuMPbParameter=&IcuConfigSet_0, EcuMModuleService=Init, EcuMHeaderFile=Icu.h, OSCoreRef=OsCore_CORE2
            Lin_InitFunction: EcuMModuleID=Lin, EcuMModuleParameter=POSTBUILD_PTR, EcuMPbParameter=&LinGlobalConfig, EcuMModuleService=Init, EcuMHeaderFile=Lin.h, OSCoreRef=OsCore_CORE2
            Port_InitFunction: EcuMModuleID=Port, EcuMModuleParameter=POSTBUILD_PTR, EcuMPbParameter=&PortContainer, EcuMModuleService=Init, EcuMHeaderFile=Port.h, OSCoreRef=OsCore_CORE2
            Pwm_InitFunction: EcuMModuleID=Pwm, EcuMModuleParameter=POSTBUILD_PTR, EcuMPbParameter=&Pwm_Config, EcuMModuleService=Init, EcuMHeaderFile=Pwm.h, OSCoreRef=OsCore_CORE2
            Spi_InitFunction: EcuMModuleID=Spi, EcuMModuleParameter=POSTBUILD_PTR, EcuMPbParameter=&Spi_Configuration, EcuMModuleService=Init, EcuMHeaderFile=Spi.h, OSCoreRef=OsCore_CORE2
            Os_Core{0..2}_InitFunction: EcuMModuleID=Os, EcuMModuleParameter=VOID, EcuMModuleService=Init, EcuMHeaderFile=Os.h, OSCoreRef=OsCore_CORE{0..2}
        EcuMDriverInitListZero: import=NONE
        9 x EcuMWakeupSource:
          ECUM_WKSOURCE_POWER: import=NONE, EcuMWakeupSourceId=0
          ECUM_WKSOURCE_RESET: import=NONE, EcuMWakeupSourceId=1
          ECUM_WKSOURCE_INTERNAL_RESET: import=NONE, EcuMWakeupSourceId=2
          ECUM_WKSOURCE_INTERNAL_WDG: import=NONE, EcuMWakeupSourceId=3
          ECUM_WKSOURCE_EXTERNAL_WDG: import=NONE, EcuMWakeupSourceId=4
          CAN_MatrixDCDCV0120250305_VR82BV: import=COMM_IMPORT, EcuMWakeupSourceId=5, EcuMComMChannelRef=CAN_MatrixDCDCV0120250305_VR82BV
          FAW_PTCAN_MCU_V141_D3_sO0: import=COMM_IMPORT, EcuMWakeupSourceId=6, EcuMComMChannelRef=FAW_PTCAN_MCU_V141_D3_sO0
          FAW_MCD_MCU_Voxyrf: import=COMM_IMPORT, EcuMWakeupSourceId=7, EcuMComMChannelRef=FAW_MCD_MCU_Voxyrf
          FAW__HVACDCDC2__V20DBC_OjcG_c: import=COMM_IMPORT, EcuMWakeupSourceId=8, EcuMComMChannelRef=FAW__HVACDCDC2__V20DBC_OjcG_c
      EcuMFlexConfiguration: import=NONE
        EcuMFlexUserConfig0 (EcuMFlexUserConfig): import=NONE, EcuMFlexUser=0
        EcuMGoDownAllowedUsers: import=NONE
    EcuMFlexGeneral: import=NONE
    EcuMGeneral: import=NONE, EcuMDevErrorDetect=false, EcuMIncludeDet=false, EcuMMainFunctionPeriod=0.005, EcuMVersionInfoApi=true
