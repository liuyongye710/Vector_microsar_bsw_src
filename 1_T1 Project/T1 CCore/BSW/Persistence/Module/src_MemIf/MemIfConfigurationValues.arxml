AUTOSAR XML
package /ActiveEcuC
  module config MemIf
    MemIfGeneral: import=NONE, MemIfDevErrorDetect=true, MemIfNumberOfDevices=1, MemIfVersionInfoApi=true
