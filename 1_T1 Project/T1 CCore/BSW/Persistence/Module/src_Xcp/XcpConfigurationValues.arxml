AUTOSAR XML
package /ActiveEcuC
  module config Xcp
    XcpConfig: import=NONE
      XCP_Response_Voxyrf (XcpPdu): import=COMM_IMPORT
        XcpTxPdu: import=COMM_IMPORT, XcpTxPduId=0, XcpTxPduRef=XCP_Response_Voxyrf
      XCP_Request_Voxyrf (XcpPdu): import=COMM_IMPORT
        XcpRxPdu: import=COMM_IMPORT, XcpRxPduId=0, XcpRxPduRef=XCP_Request_Voxyrf
      3 x XcpEventChannel, all with import=NONE, XcpEventChannelMaxDaqList=1, XcpEventChannelTimeUnit=TIMESTAMP_UNIT_10MS, XcpEventChannelType=DAQ:
        XcpEventChannel_10ms: XcpEventName=XcpEvent_10ms, XcpEventChannelNumber=0, XcpEventChannelTimeCycle=1
        XcpEventChannel_50ms: XcpEventName=XcpEvent_50ms, XcpEventChannelNumber=1, XcpEventChannelTimeCycle=5
        XcpEventChannel_100ms: XcpEventName=XcpEvent_100ms, XcpEventChannelNumber=2, XcpEventChannelTimeCycle=10
    XcpGeneral:
      import = NONE
      XcpDaqConfigType = DAQ_DYNAMIC
      XcpDaqCount = 3
      XcpDevErrorDetect = true
      XcpFlashProgrammingEnabled = true
      XcpIdentificationFieldType = ABSOLUTE
      XcpMainFunctionPeriod = 0.01
      XcpMaxEventChannel = 3
      XcpOdtCount = 127
      XcpOdtEntrySizeDaq = 4
      XcpOnCanEnabled = true
      XcpOnEthernetEnabled = false
      XcpPrescalerSupported = false
      XcpTimestampTicks = 0
      XcpVersionInfoApi = true
      XcpDaqMemSize = 5120
      XcpEnableSendQueue = true
      XcpEnableSafeMode = false
      XcpBlockDownEnable = false
      XcpBlockUploadEnable = false
      XcpCheckSumEnable = false
      XcpSafeLen = 4
      XcpBlockSize = 2
      XcpBlockMinSt = 0
      XcpTransmitTime = 3
      XcpEventBasePeriodSelect = MainFunctionPeriod
      XcpOdtSendNumber = 7
      XcpCounterRef = SystemTimer_Core2
    XcpConnection0 (XcpConnection):
      import = NONE
      XcpBusType = XCP_BUS_CAN
      XcpMaxCto = 8
      XcpMaxDto = 8
      XcpOdtEntriesCount = 7
      XcpOnEthernetTcpEnabled = false
      RxXcpPduIdRef = XcpRxPdu
      TxXcpPduIdRef = XcpTxPdu
