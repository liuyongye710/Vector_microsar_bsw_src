AUTOSAR XML
package /ActiveEcuC
  module config CanTp
    CanTpConfig: import=NONE, CanTpMainFunctionPeriod=0.005
      FAW2_MCD_MCU_CAN_DBC_V0_1_CHL_20241216_Voxyrf (CanTpChannel): import=COMM_IMPORT
        MCU_Rx_Data_1_Voxyrf (CanTpRxNSdu):
          import = COMM_IMPORT
          CanTpBs = 0
          CanTpNar = 0.025
          CanTpNbr = 0.025
          CanTpNcr = 0.15
          CanTpRxAddressingFormat = CANTP_EXTENDED
          CanTpRxNSduId = 0
          CanTpRxPaddingActivation = CANTP_ON
          CanTpRxTaType = CANTP_PHYSICAL
          CanTpRxWftMax = 255
          CanTpSTmin = 0.01
          CanTpRxNSduRef = MCU_Rx_Data_1_Voxyrf
        MCU_Rx_Data_2_Voxyrf (CanTpRxNSdu):
          import = COMM_IMPORT
          CanTpBs = 0
          CanTpNar = 0.025
          CanTpNbr = 0.025
          CanTpNcr = 0.15
          CanTpRxAddressingFormat = CANTP_EXTENDED
          CanTpRxNSduId = 1
          CanTpRxPaddingActivation = CANTP_ON
          CanTpRxTaType = CANTP_FUNCTIONAL
          CanTpRxWftMax = 255
          CanTpSTmin = 0.01
          CanTpRxNSduRef = MCU_Rx_Data_2_Voxyrf
        MCU_Tx_Data_Voxyrf (CanTpTxNSdu):
          import = COMM_IMPORT
          CanTpNas = 0.025
          CanTpNbs = 0.075
          CanTpNcs = 0.05
          CanTpTxAddressingFormat = CANTP_EXTENDED
          CanTpTxNSduId = 0
          CanTpTxPaddingActivation = CANTP_ON
          CanTpTxTaType = CANTP_PHYSICAL
          CanTpTxPduDlc = 8
          CanTpTxNSduRef = MCU_Tx_Data_Voxyrf
    CanTpGeneral: import=NONE, CanTpChangeParameterApi=true, CanTpDevErrorDetect=false, CanTpPaddingByte=0, CanTpReadParameterApi=true, CanTpVersionInfoApi=true
