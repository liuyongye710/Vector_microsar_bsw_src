AUTOSAR XML
package /ActiveEcuC
  module config LinSM
    LinSMConfigSet: import=NONE, LinSMModeRequestRepetitionMax=3
      FAW_EMS_AGM_LIN_V1_0_ldf_QdCKJs (LinSMChannel):
        import = COMM_IMPORT
        LinSMConfirmationTimeout = 10
        LinSMTransceiverPassiveMode = false
        LinSMNodeType = MASTER
        LinSMComMNetworkHandleRef = FAW_EMS_AGM_LIN_V1_0_ldf_QdCKJs
        NULL_SCHEDULE_QdCKJs (LinSMSchedule): import=COMM_IMPORT, LinSMScheduleIndex=0, LinSMScheduleIndexRef=NULL_SCHEDULE_QdCKJs
        TWO_AGM_TABLE_QdCKJs (LinSMSchedule): import=COMM_IMPORT, LinSMScheduleIndex=1, LinSMScheduleIndexRef=TWO_AGM_TABLE_QdCKJs
    LinSMGeneral: import=NONE, LinSMDevErrorDetect=false, LinSMMainProcessingPeriod=0.005, LinSMVersionInfoApi=false, LinSMBswMEnabled=true
