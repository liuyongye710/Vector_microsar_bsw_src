AUTOSAR XML
package /ActiveEcuC
  module config Com
    ComConfig: import=NONE
      44 x ComIPdu, all with import=COMM_IMPORT, ComIPduSignalProcessing=DEFERRED:
        MCU1_D3_sO0: ComIPduDirection=SEND, ComIPduHandleId=0, ComIPduType=NORMAL, ComIPduGroupRef=FAW_MCD_MCU_CAN_V1_4_1_dbc_D3_sO0_Tx, ComIPduSignalRef=MotoperatingmodeMCU1_MCU1_FAW_MCD_MCU_CAN_V1_4_1_dbc_Tx, ComIPduSignalRef=MotRotDirtionMCU1_MCU1_FAW_MCD_MCU_CAN_V1_4_1_dbc_Tx, ComIPduSignalRef=MotSysStsMCU1_MCU1_FAW_MCD_MCU_CAN_V1_4_1_dbc_Tx, ComIPduSignalRef=highprecisionMotTqMCU1_MCU1_FAW_MCD_MCU_CAN_V1_4_1_dbc_Tx, ComIPduSignalRef=MotCurMaxOutphighprecisionTqMCU1_MCU1_FAW_MCD_MCU_CAN_V1_4_1_dbc_Tx, ComIPduSignalRef=MotTqMCU1_MCU1_FAW_MCD_MCU_CAN_V1_4_1_dbc_Tx, ComIPduSignalRef=CurMaxOutpTqofMotMCU1_MCU1_FAW_MCD_MCU_CAN_V1_4_1_dbc_Tx, ComIPduSignalRef=MotSpdMCU1_MCU1_FAW_MCD_MCU_CAN_V1_4_1_dbc_Tx, ComIPduSignalRef=highUPwroffAllwedMCU1_MCU1_FAW_MCD_MCU_CAN_V1_4_1_dbc_Tx, ComIPduSignalRef=ActvdisChrgStMCU1_MCU1_FAW_MCD_MCU_CAN_V1_4_1_dbc_Tx, ComIPduSignalRef=MotFailrStsMCU1_MCU1_FAW_MCD_MCU_CAN_V1_4_1_dbc_Tx, ComIPduSignalRef=MsgCnterMCU1_MCU1_FAW_MCD_MCU_CAN_V1_4_1_dbc_Tx, ComIPduSignalRef=MsgChksumMCU1_MCU1_FAW_MCD_MCU_CAN_V1_4_1_dbc_Tx, ComPduIdRef=MCU1_D3_sO0
          ComTxIPdu: import=COMM_IMPORT, ComMinimumDelayTime=0, ComTxIPduUnusedAreasDefault=0
            ComTxModeFalse: import=COMM_IMPORT
              ComTxMode: import=COMM_IMPORT, ComTxModeMode=DIRECT, ComTxModeNumberOfRepetitions=0, ComTxModeRepetitionPeriod=0
            ComTxModeTrue: import=COMM_IMPORT
              ComTxMode: import=COMM_IMPORT, ComTxModeMode=DIRECT, ComTxModeNumberOfRepetitions=0, ComTxModeRepetitionPeriod=0
        ECMCU_D3_sO0: ComIPduDirection=SEND, ComIPduHandleId=1, ComIPduType=TP, ComIPduGroupRef=FAW_MCD_MCU_CAN_V1_4_1_dbc_D3_sO0_Tx, ComIPduSignalRef=MotTqECMCU_ECMCU_FAW_MCD_MCU_CAN_V1_4_1_dbc_Tx, ComPduIdRef=ECMCU_D3_sO0
          ComTxIPdu: import=COMM_IMPORT, ComMinimumDelayTime=0, ComTxIPduUnusedAreasDefault=255
            ComTxModeFalse: import=COMM_IMPORT
              ComTxMode: import=COMM_IMPORT, ComTxModeMode=DIRECT, ComTxModeNumberOfRepetitions=0, ComTxModeRepetitionPeriod=0
            ComTxModeTrue: import=COMM_IMPORT
              ComTxMode: import=COMM_IMPORT, ComTxModeMode=DIRECT, ComTxModeNumberOfRepetitions=0, ComTxModeRepetitionPeriod=0
        MCU3_D3_sO0: ComIPduDirection=SEND, ComIPduHandleId=2, ComIPduType=NORMAL, ComIPduGroupRef=FAW_MCD_MCU_CAN_V1_4_1_dbc_D3_sO0_Tx, ComIPduSignalRef=MotAvlMaxGennhighprecisionTqMCU3_MCU3_FAW_MCD_MCU_CAN_V1_4_1_dbc_Tx, ComIPduSignalRef=MotAvlMaxGennTqMCU3_MCU3_FAW_MCD_MCU_CAN_V1_4_1_dbc_Tx, ComIPduSignalRef=MsgCnterMCU3_MCU3_FAW_MCD_MCU_CAN_V1_4_1_dbc_Tx, ComIPduSignalRef=MsgChksumMCU3_MCU3_FAW_MCD_MCU_CAN_V1_4_1_dbc_Tx, ComPduIdRef=MCU3_D3_sO0
          ComTxIPdu: import=COMM_IMPORT, ComMinimumDelayTime=0, ComTxIPduUnusedAreasDefault=0
            ComTxModeFalse: import=COMM_IMPORT
              ComTxMode: import=COMM_IMPORT, ComTxModeMode=DIRECT, ComTxModeNumberOfRepetitions=0, ComTxModeRepetitionPeriod=0
            ComTxModeTrue: import=COMM_IMPORT
              ComTxMode: import=COMM_IMPORT, ComTxModeMode=DIRECT, ComTxModeNumberOfRepetitions=0, ComTxModeRepetitionPeriod=0
        MCU21_D3_sO0: ComIPduDirection=SEND, ComIPduHandleId=3, ComIPduType=NORMAL, ComIPduGroupRef=FAW_MCD_MCU_CAN_V1_4_1_dbc_D3_sO0_Tx, ComIPduSignalRef=MotoperatingmodeMCU21_MCU21_FAW_MCD_MCU_CAN_V1_4_1_dbc_Tx, ComIPduSignalRef=MotRotDirtionMCU21_MCU21_FAW_MCD_MCU_CAN_V1_4_1_dbc_Tx, ComIPduSignalRef=MotSysStsMCU21_MCU21_FAW_MCD_MCU_CAN_V1_4_1_dbc_Tx, ComIPduSignalRef=highprecisionMotTqMCU21_MCU21_FAW_MCD_MCU_CAN_V1_4_1_dbc_Tx, ComIPduSignalRef=otCurMaxOutphighprecisionTqMCU21_MCU21_FAW_MCD_MCU_CAN_V1_4_1_dbc_Tx, ComIPduSignalRef=MotTqMCU21_MCU21_FAW_MCD_MCU_CAN_V1_4_1_dbc_Tx, ComIPduSignalRef=CurMaxOutpTqofMotMCU21_MCU21_FAW_MCD_MCU_CAN_V1_4_1_dbc_Tx, ComIPduSignalRef=MotSpdMCU21_MCU21_FAW_MCD_MCU_CAN_V1_4_1_dbc_Tx, ComIPduSignalRef=highUPwroffAllwedMCU21_MCU21_FAW_MCD_MCU_CAN_V1_4_1_dbc_Tx, ComIPduSignalRef=ActvdisChrgStMCU21_MCU21_FAW_MCD_MCU_CAN_V1_4_1_dbc_Tx, ComIPduSignalRef=MotFailrStsMCU21_MCU21_FAW_MCD_MCU_CAN_V1_4_1_dbc_Tx, ComIPduSignalRef=MsgCnterMCU21_MCU21_FAW_MCD_MCU_CAN_V1_4_1_dbc_Tx, ComIPduSignalRef=MsgChksumMCU21_MCU21_FAW_MCD_MCU_CAN_V1_4_1_dbc_Tx, ComPduIdRef=MCU21_D3_sO0
          ComTxIPdu: import=COMM_IMPORT, ComMinimumDelayTime=0, ComTxIPduUnusedAreasDefault=0
            ComTxModeFalse: import=COMM_IMPORT
              ComTxMode: import=COMM_IMPORT, ComTxModeMode=DIRECT, ComTxModeNumberOfRepetitions=0, ComTxModeRepetitionPeriod=0
            ComTxModeTrue: import=COMM_IMPORT
              ComTxMode: import=COMM_IMPORT, ComTxModeMode=DIRECT, ComTxModeNumberOfRepetitions=0, ComTxModeRepetitionPeriod=0
        MCU22_D3_sO0: ComIPduDirection=SEND, ComIPduHandleId=4, ComIPduType=NORMAL, ComIPduGroupRef=FAW_MCD_MCU_CAN_V1_4_1_dbc_D3_sO0_Tx, ComIPduSignalRef=MotCtrllerbusUMCU22_MCU22_FAW_MCD_MCU_CAN_V1_4_1_dbc_Tx, ComIPduSignalRef=MotCtrllerbusCurMCU22_MCU22_FAW_MCD_MCU_CAN_V1_4_1_dbc_Tx, ComIPduSignalRef=MotTMCU22_MCU22_FAW_MCD_MCU_CAN_V1_4_1_dbc_Tx, ComIPduSignalRef=MotCtrllerTMCU22_MCU22_FAW_MCD_MCU_CAN_V1_4_1_dbc_Tx, ComPduIdRef=MCU22_D3_sO0
          ComTxIPdu: import=COMM_IMPORT, ComMinimumDelayTime=0, ComTxIPduUnusedAreasDefault=0
            ComTxModeFalse: import=COMM_IMPORT
              ComTxMode: import=COMM_IMPORT, ComTxModeMode=DIRECT, ComTxModeNumberOfRepetitions=0, ComTxModeRepetitionPeriod=0
            ComTxModeTrue: import=COMM_IMPORT
              ComTxMode: import=COMM_IMPORT, ComTxModeMode=DIRECT, ComTxModeNumberOfRepetitions=0, ComTxModeRepetitionPeriod=0
        MCU23_D3_sO0: ComIPduDirection=SEND, ComIPduHandleId=5, ComIPduType=NORMAL, ComIPduGroupRef=FAW_MCD_MCU_CAN_V1_4_1_dbc_D3_sO0_Tx, ComIPduSignalRef=otAvlMaxGennhighprecisionTqMCU23_MCU23_FAW_MCD_MCU_CAN_V1_4_1_dbc_Tx, ComIPduSignalRef=MotAvlMaxGennTqMCU23_MCU23_FAW_MCD_MCU_CAN_V1_4_1_dbc_Tx, ComIPduSignalRef=MsgCnterMCU23_MCU23_FAW_MCD_MCU_CAN_V1_4_1_dbc_Tx, ComIPduSignalRef=MsgChksumMCU23_MCU23_FAW_MCD_MCU_CAN_V1_4_1_dbc_Tx, ComPduIdRef=MCU23_D3_sO0
          ComTxIPdu: import=COMM_IMPORT, ComMinimumDelayTime=0, ComTxIPduUnusedAreasDefault=0
            ComTxModeFalse: import=COMM_IMPORT
              ComTxMode: import=COMM_IMPORT, ComTxModeMode=DIRECT, ComTxModeNumberOfRepetitions=0, ComTxModeRepetitionPeriod=0
            ComTxModeTrue: import=COMM_IMPORT
              ComTxMode: import=COMM_IMPORT, ComTxModeMode=DIRECT, ComTxModeNumberOfRepetitions=0, ComTxModeRepetitionPeriod=0
        DM1MCU_D3_sO0: ComIPduDirection=SEND, ComIPduHandleId=6, ComIPduType=TP, ComIPduGroupRef=FAW_MCD_MCU_CAN_V1_4_1_dbc_D3_sO0_Tx, ComIPduSignalRef=ProtlampDM1MCU_DM1MCU_FAW_MCD_MCU_CAN_V1_4_1_dbc_Tx, ComIPduSignalRef=amberWarnlampDM1MCU_DM1MCU_FAW_MCD_MCU_CAN_V1_4_1_dbc_Tx, ComIPduSignalRef=redstoplampDM1MCU_DM1MCU_FAW_MCD_MCU_CAN_V1_4_1_dbc_Tx, ComIPduSignalRef=malFctIndcrlampDM1MCU_DM1MCU_FAW_MCD_MCU_CAN_V1_4_1_dbc_Tx, ComIPduSignalRef=FlashProtlampDM1MCU_DM1MCU_FAW_MCD_MCU_CAN_V1_4_1_dbc_Tx, ComIPduSignalRef=FlashamberWarnlampDM1MCU_DM1MCU_FAW_MCD_MCU_CAN_V1_4_1_dbc_Tx, ComIPduSignalRef=FlashredstoplampDM1MCU_DM1MCU_FAW_MCD_MCU_CAN_V1_4_1_dbc_Tx, ComIPduSignalRef=FlashmalFctIndcrlampDM1MCU_DM1MCU_FAW_MCD_MCU_CAN_V1_4_1_dbc_Tx, ComIPduSignalRef=spn8leastsignificantbitsDM1MCU_DM1MCU_FAW_MCD_MCU_CAN_V1_4_1_dbc_Tx, ComIPduSignalRef=spnSecbyteDM1MCU_DM1MCU_FAW_MCD_MCU_CAN_V1_4_1_dbc_Tx, ComIPduSignalRef=FMiDM1MCU_DM1MCU_FAW_MCD_MCU_CAN_V1_4_1_dbc_Tx, ComIPduSignalRef=spn3mostsignificantbitsDM1MCU_DM1MCU_FAW_MCD_MCU_CAN_V1_4_1_dbc_Tx, ComIPduSignalRef=occurrenceCntDM1MCU_DM1MCU_FAW_MCD_MCU_CAN_V1_4_1_dbc_Tx, ComIPduSignalRef=spnCnvnMetHODDM1MCU_DM1MCU_FAW_MCD_MCU_CAN_V1_4_1_dbc_Tx, ComPduIdRef=DM1MCU_D3_sO0
          ComTxIPdu: import=COMM_IMPORT, ComMinimumDelayTime=0, ComTxIPduUnusedAreasDefault=255
            ComTxModeFalse: import=COMM_IMPORT
              ComTxMode: import=COMM_IMPORT, ComTxModeMode=DIRECT, ComTxModeNumberOfRepetitions=0, ComTxModeRepetitionPeriod=0
            ComTxModeTrue: import=COMM_IMPORT
              ComTxMode: import=COMM_IMPORT, ComTxModeMode=DIRECT, ComTxModeNumberOfRepetitions=0, ComTxModeRepetitionPeriod=0
        DM1MCU2_D3_sO0: ComIPduDirection=SEND, ComIPduHandleId=7, ComIPduType=TP, ComIPduGroupRef=FAW_MCD_MCU_CAN_V1_4_1_dbc_D3_sO0_Tx, ComIPduSignalRef=ProtlampDM1MCU2_DM1MCU2_FAW_MCD_MCU_CAN_V1_4_1_dbc_Tx, ComIPduSignalRef=amberWarnlampDM1MCU2_DM1MCU2_FAW_MCD_MCU_CAN_V1_4_1_dbc_Tx, ComIPduSignalRef=redstoplampDM1MCU2_DM1MCU2_FAW_MCD_MCU_CAN_V1_4_1_dbc_Tx, ComIPduSignalRef=malFctIndcrlampDM1MCU2_DM1MCU2_FAW_MCD_MCU_CAN_V1_4_1_dbc_Tx, ComIPduSignalRef=FlashProtlampDM1MCU2_DM1MCU2_FAW_MCD_MCU_CAN_V1_4_1_dbc_Tx, ComIPduSignalRef=FlashamberWarnlampDM1MCU2_DM1MCU2_FAW_MCD_MCU_CAN_V1_4_1_dbc_Tx, ComIPduSignalRef=FlashredstoplampDM1MCU2_DM1MCU2_FAW_MCD_MCU_CAN_V1_4_1_dbc_Tx, ComIPduSignalRef=FlashmalFctIndcrlampDM1MCU2_DM1MCU2_FAW_MCD_MCU_CAN_V1_4_1_dbc_Tx, ComIPduSignalRef=spn8leastsignificantbitsDM1MCU2_DM1MCU2_FAW_MCD_MCU_CAN_V1_4_1_dbc_Tx, ComIPduSignalRef=spnSecbyteDM1MCU2_DM1MCU2_FAW_MCD_MCU_CAN_V1_4_1_dbc_Tx, ComIPduSignalRef=FMiDM1MCU2_DM1MCU2_FAW_MCD_MCU_CAN_V1_4_1_dbc_Tx, ComIPduSignalRef=spn3mostsignificantbitsDM1MCU2_DM1MCU2_FAW_MCD_MCU_CAN_V1_4_1_dbc_Tx, ComIPduSignalRef=occurrenceCntDM1MCU2_DM1MCU2_FAW_MCD_MCU_CAN_V1_4_1_dbc_Tx, ComIPduSignalRef=spnCnvnMetHODDM1MCU2_DM1MCU2_FAW_MCD_MCU_CAN_V1_4_1_dbc_Tx, ComPduIdRef=DM1MCU2_D3_sO0
          ComTxIPdu: import=COMM_IMPORT, ComMinimumDelayTime=0, ComTxIPduUnusedAreasDefault=255
            ComTxModeFalse: import=COMM_IMPORT
              ComTxMode: import=COMM_IMPORT, ComTxModeMode=DIRECT, ComTxModeNumberOfRepetitions=0, ComTxModeRepetitionPeriod=0
            ComTxModeTrue: import=COMM_IMPORT
              ComTxMode: import=COMM_IMPORT, ComTxModeMode=DIRECT, ComTxModeNumberOfRepetitions=0, ComTxModeRepetitionPeriod=0
        MCU2_D3_sO0: ComIPduDirection=SEND, ComIPduHandleId=8, ComIPduType=NORMAL, ComIPduGroupRef=FAW_MCD_MCU_CAN_V1_4_1_dbc_D3_sO0_Tx, ComIPduSignalRef=MotCtrllerbusUMCU2_MCU2_FAW_MCD_MCU_CAN_V1_4_1_dbc_Tx, ComIPduSignalRef=MotCtrllerbusCurMCU2_MCU2_FAW_MCD_MCU_CAN_V1_4_1_dbc_Tx, ComIPduSignalRef=MotTMCU2_MCU2_FAW_MCD_MCU_CAN_V1_4_1_dbc_Tx, ComIPduSignalRef=MotCtrllerTMCU2_MCU2_FAW_MCD_MCU_CAN_V1_4_1_dbc_Tx, ComPduIdRef=MCU2_D3_sO0
          ComTxIPdu: import=COMM_IMPORT, ComMinimumDelayTime=0, ComTxIPduUnusedAreasDefault=0
            ComTxModeFalse: import=COMM_IMPORT
              ComTxMode: import=COMM_IMPORT, ComTxModeMode=DIRECT, ComTxModeNumberOfRepetitions=0, ComTxModeRepetitionPeriod=0
            ComTxModeTrue: import=COMM_IMPORT
              ComTxMode: import=COMM_IMPORT, ComTxModeMode=DIRECT, ComTxModeNumberOfRepetitions=0, ComTxModeRepetitionPeriod=0
        TSC1Mtr_D3_sO0: ComIPduCallout=Com_RxIpduCallout_TSC1Mtr_D3_sO0, ComIPduDirection=RECEIVE, ComIPduHandleId=0, ComIPduType=NORMAL, ComIPduGroupRef=FAW_MCD_MCU_CAN_V1_4_1_dbc_D3_sO0_Rx, ComIPduSignalRef=OvrdCtrlmodeTSC1Mtr_TSC1Mtr_FAW_MCD_MCU_CAN_V1_4_1_dbc_Rx, ComIPduSignalRef=ReqedSpdCtrlCdnsTSC1Mtr_TSC1Mtr_FAW_MCD_MCU_CAN_V1_4_1_dbc_Rx, ComIPduSignalRef=OvrdCtrlmodePrioTSC1Mtr_TSC1Mtr_FAW_MCD_MCU_CAN_V1_4_1_dbc_Rx, ComIPduSignalRef=ReqedSpdSpdLimTSC1Mtr_TSC1Mtr_FAW_MCD_MCU_CAN_V1_4_1_dbc_Rx, ComIPduSignalRef=ReqedTqTqLimTSC1Mtr_TSC1Mtr_FAW_MCD_MCU_CAN_V1_4_1_dbc_Rx, ComIPduSignalRef=ReqedTqfrActnalTSC1Mtr_TSC1Mtr_FAW_MCD_MCU_CAN_V1_4_1_dbc_Rx, ComIPduSignalRef=MsgCnterTSC1Mtr_TSC1Mtr_FAW_MCD_MCU_CAN_V1_4_1_dbc_Rx, ComIPduSignalRef=MsgChksumTSC1Mtr_TSC1Mtr_FAW_MCD_MCU_CAN_V1_4_1_dbc_Rx, ComPduIdRef=TSC1Mtr_D3_sO0
          ComRxIPdu: import=COMM_IMPORT, ComRxModeTimeCycle=0.01
        EEC2HCU_D3_sO0: ComIPduCallout=Com_RxIpduCallout_EEC2HCU_D3_sO0, ComIPduDirection=RECEIVE, ComIPduHandleId=1, ComIPduType=NORMAL, ComIPduGroupRef=FAW_MCD_MCU_CAN_V1_4_1_dbc_D3_sO0_Rx, ComIPduSignalRef=AccrPedlapPosn_EEC2HCU_EEC2HCU_FAW_MCD_MCU_CAN_V1_4_1_dbc_Rx, ComPduIdRef=EEC2HCU_D3_sO0
          ComRxIPdu: import=COMM_IMPORT, ComRxModeTimeCycle=0.05
        CCVSHCU_D3_sO0: ComIPduCallout=Com_RxIpduCallout_CCVSHCU_D3_sO0, ComIPduDirection=RECEIVE, ComIPduHandleId=2, ComIPduType=NORMAL, ComIPduGroupRef=FAW_MCD_MCU_CAN_V1_4_1_dbc_D3_sO0_Rx, ComIPduSignalRef=PrkgBrkSwtCCVSHCU_CCVSHCU_FAW_MCD_MCU_CAN_V1_4_1_dbc_Rx, ComIPduSignalRef=BrkSwtCCVSHCU_CCVSHCU_FAW_MCD_MCU_CAN_V1_4_1_dbc_Rx, ComPduIdRef=CCVSHCU_D3_sO0
          ComRxIPdu: import=COMM_IMPORT, ComRxModeTimeCycle=0.1
        TC1_D3_sO0: ComIPduCallout=Com_RxIpduCallout_TC1_D3_sO0, ComIPduDirection=RECEIVE, ComIPduHandleId=3, ComIPduType=NORMAL, ComIPduGroupRef=FAW_MCD_MCU_CAN_V1_4_1_dbc_D3_sO0_Rx, ComIPduSignalRef=TrsmReqedgearTC1_TC1_FAW_MCD_MCU_CAN_V1_4_1_dbc_Rx, ComIPduSignalRef=Trsmmode2TC1_TC1_FAW_MCD_MCU_CAN_V1_4_1_dbc_Rx, ComPduIdRef=TC1_D3_sO0
          ComRxIPdu: import=COMM_IMPORT, ComRxModeTimeCycle=0.05
        TC1Handle_D3_sO0: ComIPduCallout=Com_RxIpduCallout_TC1Handle_D3_sO0, ComIPduDirection=RECEIVE, ComIPduHandleId=4, ComIPduType=NORMAL, ComIPduGroupRef=FAW_MCD_MCU_CAN_V1_4_1_dbc_D3_sO0_Rx, ComIPduSignalRef=TrsmReqedgearTC1Handle_TC1Handle_FAW_MCD_MCU_CAN_V1_4_1_dbc_Rx, ComPduIdRef=TC1Handle_D3_sO0
          ComRxIPdu: import=COMM_IMPORT, ComRxModeTimeCycle=0.05
        ETC1_D3_sO0: ComIPduCallout=Com_RxIpduCallout_ETC1_D3_sO0, ComIPduDirection=RECEIVE, ComIPduHandleId=5, ComIPduType=NORMAL, ComIPduGroupRef=FAW_MCD_MCU_CAN_V1_4_1_dbc_D3_sO0_Rx, ComIPduSignalRef=ShiftinProcETC1_ETC1_FAW_MCD_MCU_CAN_V1_4_1_dbc_Rx, ComPduIdRef=ETC1_D3_sO0
          ComRxIPdu: import=COMM_IMPORT, ComRxModeTimeCycle=0.01
        ETC2_D3_sO0: ComIPduCallout=Com_RxIpduCallout_ETC2_D3_sO0, ComIPduDirection=RECEIVE, ComIPduHandleId=6, ComIPduType=NORMAL, ComIPduGroupRef=FAW_MCD_MCU_CAN_V1_4_1_dbc_D3_sO0_Rx, ComIPduSignalRef=SeledgearETC2_ETC2_FAW_MCD_MCU_CAN_V1_4_1_dbc_Rx, ComIPduSignalRef=ActgearRatETC2_ETC2_FAW_MCD_MCU_CAN_V1_4_1_dbc_Rx, ComIPduSignalRef=CurgearETC2_ETC2_FAW_MCD_MCU_CAN_V1_4_1_dbc_Rx, ComPduIdRef=ETC2_D3_sO0
          ComRxIPdu: import=COMM_IMPORT, ComRxModeTimeCycle=0.1
        AMT3_D3_sO0: ComIPduCallout=Com_RxIpduCallout_AMT3_D3_sO0, ComIPduDirection=RECEIVE, ComIPduHandleId=7, ComIPduType=NORMAL, ComIPduGroupRef=FAW_MCD_MCU_CAN_V1_4_1_dbc_D3_sO0_Rx, ComIPduSignalRef=ReqHCUtoCtrltheMotAMT3_AMT3_FAW_MCD_MCU_CAN_V1_4_1_dbc_Rx, ComIPduSignalRef=TrsmgearselfLrningStAMT3_AMT3_FAW_MCD_MCU_CAN_V1_4_1_dbc_Rx, ComIPduSignalRef=holdCurgearReqAMT3_AMT3_FAW_MCD_MCU_CAN_V1_4_1_dbc_Rx, ComIPduSignalRef=CluStsAMT3_AMT3_FAW_MCD_MCU_CAN_V1_4_1_dbc_Rx, ComIPduSignalRef=SersparallelmodeStAMT3_AMT3_FAW_MCD_MCU_CAN_V1_4_1_dbc_Rx, ComIPduSignalRef=CluCnsedTqAMT3_AMT3_FAW_MCD_MCU_CAN_V1_4_1_dbc_Rx, ComIPduSignalRef=SwtStoftheFpickerAMT3_AMT3_FAW_MCD_MCU_CAN_V1_4_1_dbc_Rx, ComIPduSignalRef=DrvgFStAMT3_AMT3_FAW_MCD_MCU_CAN_V1_4_1_dbc_Rx, ComIPduSignalRef=PrkgFStAMT3_AMT3_FAW_MCD_MCU_CAN_V1_4_1_dbc_Rx, ComIPduSignalRef=ptobindingStAMT3_AMT3_FAW_MCD_MCU_CAN_V1_4_1_dbc_Rx, ComPduIdRef=AMT3_D3_sO0
          ComRxIPdu: import=COMM_IMPORT, ComRxModeTimeCycle=1
        HCUMCU_D3_sO0: ComIPduCallout=Com_RxIpduCallout_HCUMCU_D3_sO0, ComIPduDirection=RECEIVE, ComIPduHandleId=8, ComIPduType=NORMAL, ComIPduGroupRef=FAW_MCD_MCU_CAN_V1_4_1_dbc_D3_sO0_Rx, ComIPduSignalRef=theReqedMotoperatingmodeHCUMCU_HCUMCU_FAW_MCD_MCU_CAN_V1_4_1_dbc_Rx, ComIPduSignalRef=highprecisionMotTqReqedHCUMCU_HCUMCU_FAW_MCD_MCU_CAN_V1_4_1_dbc_Rx, ComIPduSignalRef=MotTqReqedHCUMCU_HCUMCU_FAW_MCD_MCU_CAN_V1_4_1_dbc_Rx, ComIPduSignalRef=MotSpdReqedHCUMCU_HCUMCU_FAW_MCD_MCU_CAN_V1_4_1_dbc_Rx, ComIPduSignalRef=MotworkEnaCmdHCUMCU_HCUMCU_FAW_MCD_MCU_CAN_V1_4_1_dbc_Rx, ComIPduSignalRef=MotNeghighURlyCmdHCUMCU_HCUMCU_FAW_MCD_MCU_CAN_V1_4_1_dbc_Rx, ComIPduSignalRef=MotPoshighURlyCmdHCUMCU_HCUMCU_FAW_MCD_MCU_CAN_V1_4_1_dbc_Rx, ComIPduSignalRef=MotpreChrghighURlyCmdHCUMCU_HCUMCU_FAW_MCD_MCU_CAN_V1_4_1_dbc_Rx, ComIPduSignalRef=highUPwroffReqofMotHCUMCU_HCUMCU_FAW_MCD_MCU_CAN_V1_4_1_dbc_Rx, ComIPduSignalRef=MotActvdisChrgCmdHCUMCU_HCUMCU_FAW_MCD_MCU_CAN_V1_4_1_dbc_Rx, ComIPduSignalRef=MaxSpdLimUnderCurloadHCUMCU_HCUMCU_FAW_MCD_MCU_CAN_V1_4_1_dbc_Rx, ComPduIdRef=HCUMCU_D3_sO0
          ComRxIPdu: import=COMM_IMPORT, ComRxModeTimeCycle=0.01
        HCUMCU2_D3_sO0: ComIPduCallout=Com_RxIpduCallout_HCUMCU2_D3_sO0, ComIPduDirection=RECEIVE, ComIPduHandleId=9, ComIPduType=NORMAL, ComIPduGroupRef=FAW_MCD_MCU_CAN_V1_4_1_dbc_D3_sO0_Rx, ComIPduSignalRef=theReqedMotoperatingmodeHCUMCU2_HCUMCU2_FAW_MCD_MCU_CAN_V1_4_1_dbc_Rx, ComIPduSignalRef=highprecisionMotTqReqedHCUMCU2_HCUMCU2_FAW_MCD_MCU_CAN_V1_4_1_dbc_Rx, ComIPduSignalRef=MotTqReqedHCUMCU2_HCUMCU2_FAW_MCD_MCU_CAN_V1_4_1_dbc_Rx, ComIPduSignalRef=MotSpdReqedHCUMCU2_HCUMCU2_FAW_MCD_MCU_CAN_V1_4_1_dbc_Rx, ComIPduSignalRef=MotworkEnaCmdHCUMCU2_HCUMCU2_FAW_MCD_MCU_CAN_V1_4_1_dbc_Rx, ComIPduSignalRef=MotNeghighURlyCmdHCUMCU2_HCUMCU2_FAW_MCD_MCU_CAN_V1_4_1_dbc_Rx, ComIPduSignalRef=MotPoshighURlyCmdHCUMCU2_HCUMCU2_FAW_MCD_MCU_CAN_V1_4_1_dbc_Rx, ComIPduSignalRef=MotpreChrghighURlyCmdHCUMCU2_HCUMCU2_FAW_MCD_MCU_CAN_V1_4_1_dbc_Rx, ComIPduSignalRef=highUPwroffReqofMotHCUMCU2_HCUMCU2_FAW_MCD_MCU_CAN_V1_4_1_dbc_Rx, ComIPduSignalRef=MotActvdisChrgCmdHCUMCU2_HCUMCU2_FAW_MCD_MCU_CAN_V1_4_1_dbc_Rx, ComIPduSignalRef=MaxSpdLimUnderCurloadHCUMCU2_HCUMCU2_FAW_MCD_MCU_CAN_V1_4_1_dbc_Rx, ComPduIdRef=HCUMCU2_D3_sO0
          ComRxIPdu: import=COMM_IMPORT, ComRxModeTimeCycle=0.01
        SC_D3_sO0: ComIPduCallout=Com_RxIpduCallout_SC_D3_sO0, ComIPduDirection=RECEIVE, ComIPduHandleId=10, ComIPduType=NORMAL, ComIPduGroupRef=FAW_MCD_MCU_CAN_V1_4_1_dbc_D3_sO0_Rx, ComIPduSignalRef=ptoSwtCmdSC_SC_FAW_MCD_MCU_CAN_V1_4_1_dbc_Rx, ComPduIdRef=SC_D3_sO0
          ComRxIPdu: import=COMM_IMPORT, ComRxModeTimeCycle=0.1
        TSC1Mtr2_D3_sO0: ComIPduCallout=Com_RxIpduCallout_TSC1Mtr2_D3_sO0, ComIPduDirection=RECEIVE, ComIPduHandleId=11, ComIPduType=NORMAL, ComIPduGroupRef=FAW_MCD_MCU_CAN_V1_4_1_dbc_D3_sO0_Rx, ComIPduSignalRef=OvrdCtrlmodeTSC1Mtr2_TSC1Mtr2_FAW_MCD_MCU_CAN_V1_4_1_dbc_Rx, ComIPduSignalRef=ReqedSpdCtrlCdnsTSC1Mtr2_TSC1Mtr2_FAW_MCD_MCU_CAN_V1_4_1_dbc_Rx, ComIPduSignalRef=OvrdCtrlmodePrioTSC1Mtr2_TSC1Mtr2_FAW_MCD_MCU_CAN_V1_4_1_dbc_Rx, ComIPduSignalRef=ReqedSpdSpdLimTSC1Mtr2_TSC1Mtr2_FAW_MCD_MCU_CAN_V1_4_1_dbc_Rx, ComIPduSignalRef=ReqedTqTqLimTSC1Mtr2_TSC1Mtr2_FAW_MCD_MCU_CAN_V1_4_1_dbc_Rx, ComIPduSignalRef=ReqedTqfrActnalTSC1Mtr2_TSC1Mtr2_FAW_MCD_MCU_CAN_V1_4_1_dbc_Rx, ComIPduSignalRef=MsgCnterTSC1Mtr2_TSC1Mtr2_FAW_MCD_MCU_CAN_V1_4_1_dbc_Rx, ComIPduSignalRef=MsgChksumTSC1Mtr2_TSC1Mtr2_FAW_MCD_MCU_CAN_V1_4_1_dbc_Rx, ComPduIdRef=TSC1Mtr2_D3_sO0
          ComRxIPdu: import=COMM_IMPORT, ComRxModeTimeCycle=0.01
        DCDC_Cmd1_VR82BV: ComIPduDirection=SEND, ComIPduHandleId=9, ComIPduType=NORMAL, ComIPduGroupRef=CAN_Matrix_DCDC_V0_1_20250414_dbc_VR82BV_Tx, ComIPduSignalRef=DCDC_VouSet_DCDC_Cmd1_CAN_Matrix_DCDC_V0_1_20250414_dbc_Tx, ComIPduSignalRef=DCDC_CouSet_DCDC_Cmd1_CAN_Matrix_DCDC_V0_1_20250414_dbc_Tx, ComIPduSignalRef=DCDC_Mode_DCDC_Cmd1_CAN_Matrix_DCDC_V0_1_20250414_dbc_Tx, ComIPduSignalRef=DCDC_Enable_DCDC_Cmd1_CAN_Matrix_DCDC_V0_1_20250414_dbc_Tx, ComIPduSignalRef=DCDC_Sleep_DCDC_Cmd1_CAN_Matrix_DCDC_V0_1_20250414_dbc_Tx, ComIPduSignalRef=DCDC_Precharge_DCDC_Cmd1_CAN_Matrix_DCDC_V0_1_20250414_dbc_Tx, ComIPduSignalRef=DCDC_Fault_Clear_DCDC_Cmd1_CAN_Matrix_DCDC_V0_1_20250414_dbc_Tx, ComIPduSignalRef=DCDC_Dir_DCDC_Cmd1_CAN_Matrix_DCDC_V0_1_20250414_dbc_Tx, ComIPduSignalRef=DCDC_Dir_Check_DCDC_Cmd1_CAN_Matrix_DCDC_V0_1_20250414_dbc_Tx, ComIPduSignalRef=DCDC_Counter_DCDC_Cmd1_CAN_Matrix_DCDC_V0_1_20250414_dbc_Tx, ComIPduSignalRef=DCDC_Checksum_DCDC_Cmd1_CAN_Matrix_DCDC_V0_1_20250414_dbc_Tx, ComPduIdRef=DCDC_Cmd1_VR82BV
          ComTxIPdu: import=COMM_IMPORT, ComMinimumDelayTime=0, ComTxIPduUnusedAreasDefault=0
            ComTxModeFalse: import=COMM_IMPORT
              ComTxMode: import=COMM_IMPORT, ComTxModeMode=PERIODIC, ComTxModeTimeOffset=0, ComTxModeTimePeriod=0.01
            ComTxModeTrue: import=COMM_IMPORT
              ComTxMode: import=COMM_IMPORT, ComTxModeMode=PERIODIC, ComTxModeTimeOffset=0, ComTxModeTimePeriod=0.01
        DCDC_Status1_VR82BV: ComIPduCallout=Com_RxIpduCallout_DCDC_Status1_VR82BV, ComIPduDirection=RECEIVE, ComIPduHandleId=12, ComIPduType=NORMAL, ComIPduGroupRef=CAN_Matrix_DCDC_V0_1_20250414_dbc_VR82BV_Rx, ComIPduSignalRef=DCDC_VIn_DCDC_Status1_CAN_Matrix_DCDC_V0_1_20250414_dbc_Rx, ComIPduSignalRef=DCDC_Vout_DCDC_Status1_CAN_Matrix_DCDC_V0_1_20250414_dbc_Rx, ComIPduSignalRef=DCDC_Cout_DCDC_Status1_CAN_Matrix_DCDC_V0_1_20250414_dbc_Rx, ComIPduSignalRef=DCDC_ModeFB_DCDC_Status1_CAN_Matrix_DCDC_V0_1_20250414_dbc_Rx, ComIPduSignalRef=DCDC_DirFB_DCDC_Status1_CAN_Matrix_DCDC_V0_1_20250414_dbc_Rx, ComIPduSignalRef=DCDC_Cmdsrc_DCDC_Status1_CAN_Matrix_DCDC_V0_1_20250414_dbc_Rx, ComIPduSignalRef=DCDC_Faultlevel_DCDC_Status1_CAN_Matrix_DCDC_V0_1_20250414_dbc_Rx, ComIPduSignalRef=DCDC_State_DCDC_Status1_CAN_Matrix_DCDC_V0_1_20250414_dbc_Rx, ComIPduSignalRef=DCDC_Counter1_DCDC_Status1_CAN_Matrix_DCDC_V0_1_20250414_dbc_Rx, ComIPduSignalRef=DCDC_Checksum1_DCDC_Status1_CAN_Matrix_DCDC_V0_1_20250414_dbc_Rx, ComPduIdRef=DCDC_Status1_VR82BV
          ComRxIPdu: import=COMM_IMPORT, ComRxModeTimeCycle=0.01
        DCDC_Status2_VR82BV: ComIPduCallout=Com_RxIpduCallout_DCDC_Status2_VR82BV, ComIPduDirection=RECEIVE, ComIPduHandleId=13, ComIPduType=NORMAL, ComIPduGroupRef=CAN_Matrix_DCDC_V0_1_20250414_dbc_VR82BV_Rx, ComIPduSignalRef=DCDC_CoutLimit_DCDC_Status2_CAN_Matrix_DCDC_V0_1_20250414_dbc_Rx, ComIPduSignalRef=DCDC_Vin_OV_level1_DCDC_Status2_CAN_Matrix_DCDC_V0_1_20250414_dbc_Rx, ComIPduSignalRef=DCDC_Vin_OV_level3_DCDC_Status2_CAN_Matrix_DCDC_V0_1_20250414_dbc_Rx, ComIPduSignalRef=DCDC_Vin_OV_level4_DCDC_Status2_CAN_Matrix_DCDC_V0_1_20250414_dbc_Rx, ComIPduSignalRef=DCDC_Vin_UV_level1_DCDC_Status2_CAN_Matrix_DCDC_V0_1_20250414_dbc_Rx, ComIPduSignalRef=DCDC_Vin_UV_level3_DCDC_Status2_CAN_Matrix_DCDC_V0_1_20250414_dbc_Rx, ComIPduSignalRef=DCDC_Vin_UV_level4_DCDC_Status2_CAN_Matrix_DCDC_V0_1_20250414_dbc_Rx, ComIPduSignalRef=DCDC_Vout_OV_level1_DCDC_Status2_CAN_Matrix_DCDC_V0_1_20250414_dbc_Rx, ComIPduSignalRef=DCDC_Vout_OV_level3_DCDC_Status2_CAN_Matrix_DCDC_V0_1_20250414_dbc_Rx, ComIPduSignalRef=DCDC_Vout_OV_level4_DCDC_Status2_CAN_Matrix_DCDC_V0_1_20250414_dbc_Rx, ComIPduSignalRef=DCDC_Vout_UV_level1_DCDC_Status2_CAN_Matrix_DCDC_V0_1_20250414_dbc_Rx, ComIPduSignalRef=DCDC_Vout_UV_level3_DCDC_Status2_CAN_Matrix_DCDC_V0_1_20250414_dbc_Rx, ComIPduSignalRef=DCDC_Vout_UV_level4_DCDC_Status2_CAN_Matrix_DCDC_V0_1_20250414_dbc_Rx, ComIPduSignalRef=DCDC_Cout_OC_level1_DCDC_Status2_CAN_Matrix_DCDC_V0_1_20250414_dbc_Rx, ComIPduSignalRef=DCDC_Cout_OC_level2_DCDC_Status2_CAN_Matrix_DCDC_V0_1_20250414_dbc_Rx, ComIPduSignalRef=DCDC_Cout_OC_level3_DCDC_Status2_CAN_Matrix_DCDC_V0_1_20250414_dbc_Rx, ComIPduSignalRef=DCDC_Cout_OC_level4_DCDC_Status2_CAN_Matrix_DCDC_V0_1_20250414_dbc_Rx, ComIPduSignalRef=DCDC_Out_SC_level1_DCDC_Status2_CAN_Matrix_DCDC_V0_1_20250414_dbc_Rx, ComIPduSignalRef=DCDC_Out_SC_level2_DCDC_Status2_CAN_Matrix_DCDC_V0_1_20250414_dbc_Rx, ComIPduSignalRef=DCDC_PSFB_OT_level1_DCDC_Status2_CAN_Matrix_DCDC_V0_1_20250414_dbc_Rx, ComIPduSignalRef=DCDC_PSFB_OT_level3_DCDC_Status2_CAN_Matrix_DCDC_V0_1_20250414_dbc_Rx, ComIPduSignalRef=DCDC_PSFB_OT_level4_DCDC_Status2_CAN_Matrix_DCDC_V0_1_20250414_dbc_Rx, ComIPduSignalRef=DCDC_SR_OT_level1_DCDC_Status2_CAN_Matrix_DCDC_V0_1_20250414_dbc_Rx, ComIPduSignalRef=DCDC_SR_OT_level3_DCDC_Status2_CAN_Matrix_DCDC_V0_1_20250414_dbc_Rx, ComIPduSignalRef=DCDC_SR_OT_level4_DCDC_Status2_CAN_Matrix_DCDC_V0_1_20250414_dbc_Rx, ComIPduSignalRef=DCDC_OC_PSFB_level2_DCDC_Status2_CAN_Matrix_DCDC_V0_1_20250414_dbc_Rx, ComIPduSignalRef=DCDC_OC_BoostSub1_level2_DCDC_Status2_CAN_Matrix_DCDC_V0_1_20250414_dbc_Rx, ComIPduSignalRef=DCDC_OC_BoostSub2_level2_DCDC_Status2_CAN_Matrix_DCDC_V0_1_20250414_dbc_Rx, ComIPduSignalRef=DCDC_CAN_Timeout_DCDC_Status2_CAN_Matrix_DCDC_V0_1_20250414_dbc_Rx, ComIPduSignalRef=DCDC_CAN_E2E_DCDC_Status2_CAN_Matrix_DCDC_V0_1_20250414_dbc_Rx, ComIPduSignalRef=DCDC_Initial_Failure_DCDC_Status2_CAN_Matrix_DCDC_V0_1_20250414_dbc_Rx, ComIPduSignalRef=DCDC_Precharge_Failure_DCDC_Status2_CAN_Matrix_DCDC_V0_1_20250414_dbc_Rx, ComIPduSignalRef=DCDC_PSFB_CS_Failure_DCDC_Status2_CAN_Matrix_DCDC_V0_1_20250414_dbc_Rx, ComIPduSignalRef=DCDC_Hard_Failure_level1_DCDC_Status2_CAN_Matrix_DCDC_V0_1_20250414_dbc_Rx, ComIPduSignalRef=DCDC_HOC_PSFB_level1_DCDC_Status2_CAN_Matrix_DCDC_V0_1_20250414_dbc_Rx, ComIPduSignalRef=DCDC_HOC_Cout_level1_DCDC_Status2_CAN_Matrix_DCDC_V0_1_20250414_dbc_Rx, ComIPduSignalRef=DCDC_HOC_Vin_level1_DCDC_Status2_CAN_Matrix_DCDC_V0_1_20250414_dbc_Rx, ComIPduSignalRef=DCDC_HOV_Vout_Boost_level1_DCDC_Status2_CAN_Matrix_DCDC_V0_1_20250414_dbc_Rx, ComIPduSignalRef=DCDC_HOV_Vout_level1_DCDC_Status2_CAN_Matrix_DCDC_V0_1_20250414_dbc_Rx, ComIPduSignalRef=DCDC_HOC_BoostSub1_level1_DCDC_Status2_CAN_Matrix_DCDC_V0_1_20250414_dbc_Rx, ComIPduSignalRef=DCDC_HOC_BoostSub2_level2_DCDC_Status2_CAN_Matrix_DCDC_V0_1_20250414_dbc_Rx, ComIPduSignalRef=DCDC_BoostSub1_CS_Failure_DCDC_Status2_CAN_Matrix_DCDC_V0_1_20250414_dbc_Rx, ComIPduSignalRef=DCDC_BoostSub2_CS_Failure_DCDC_Status2_CAN_Matrix_DCDC_V0_1_20250414_dbc_Rx, ComPduIdRef=DCDC_Status2_VR82BV
          ComRxIPdu: import=COMM_IMPORT, ComRxModeTimeCycle=0.01
        DCDC_Status3_VR82BV: ComIPduCallout=Com_RxIpduCallout_DCDC_Status3_VR82BV, ComIPduDirection=RECEIVE, ComIPduHandleId=14, ComIPduType=NORMAL, ComIPduGroupRef=CAN_Matrix_DCDC_V0_1_20250414_dbc_VR82BV_Rx, ComIPduSignalRef=DCDC_SoftVer_DCDC_Status3_CAN_Matrix_DCDC_V0_1_20250414_dbc_Rx, ComIPduSignalRef=DCDC_HardVer_DCDC_Status3_CAN_Matrix_DCDC_V0_1_20250414_dbc_Rx, ComIPduSignalRef=DCDC_Temp_Dclink_DCDC_Status3_CAN_Matrix_DCDC_V0_1_20250414_dbc_Rx, ComIPduSignalRef=DCDC_Temp_SR_DCDC_Status3_CAN_Matrix_DCDC_V0_1_20250414_dbc_Rx, ComIPduSignalRef=DCDC_Temp_TSFM_DCDC_Status3_CAN_Matrix_DCDC_V0_1_20250414_dbc_Rx, ComIPduSignalRef=DCDC_Temp_PSFB_DCDC_Status3_CAN_Matrix_DCDC_V0_1_20250414_dbc_Rx, ComPduIdRef=DCDC_Status3_VR82BV
          ComRxIPdu: import=COMM_IMPORT, ComRxModeTimeCycle=0.02
        APCU1_OjcG_c: ComIPduDirection=SEND, ComIPduHandleId=10, ComIPduType=NORMAL, ComIPduGroupRef=FAW3_HVAC_V2_0DBC_dbc_OjcG_c_Tx, ComIPduSignalRef=APCUhighUbusUAPCU1_APCU1_FAW3_HVAC_V2_0DBC_dbc_Tx, ComIPduSignalRef=APCUMotworkingStsAPCU1_APCU1_FAW3_HVAC_V2_0DBC_dbc_Tx, ComIPduSignalRef=APCUMotFailrStsAPCU1_APCU1_FAW3_HVAC_V2_0DBC_dbc_Tx, ComIPduSignalRef=APCUOutpCurAPCU1_APCU1_FAW3_HVAC_V2_0DBC_dbc_Tx, ComPduIdRef=APCU1_OjcG_c
          ComTxIPdu: import=COMM_IMPORT, ComMinimumDelayTime=0, ComTxIPduUnusedAreasDefault=0
            ComTxModeFalse: import=COMM_IMPORT
              ComTxMode: import=COMM_IMPORT, ComTxModeMode=DIRECT, ComTxModeTimeOffset=0
            ComTxModeTrue: import=COMM_IMPORT
              ComTxMode: import=COMM_IMPORT, ComTxModeMode=DIRECT, ComTxModeTimeOffset=0
        APCU2_OjcG_c: ComIPduDirection=SEND, ComIPduHandleId=11, ComIPduType=NORMAL, ComIPduGroupRef=FAW3_HVAC_V2_0DBC_dbc_OjcG_c_Tx, ComIPduSignalRef=APCUTAPCU2_APCU2_FAW3_HVAC_V2_0DBC_dbc_Tx, ComPduIdRef=APCU2_OjcG_c
          ComTxIPdu: import=COMM_IMPORT, ComMinimumDelayTime=0, ComTxIPduUnusedAreasDefault=0
            ComTxModeFalse: import=COMM_IMPORT
              ComTxMode: import=COMM_IMPORT, ComTxModeMode=DIRECT, ComTxModeTimeOffset=0
            ComTxModeTrue: import=COMM_IMPORT
              ComTxMode: import=COMM_IMPORT, ComTxModeMode=DIRECT, ComTxModeTimeOffset=0
        DM1APCU_OjcG_c: ComIPduDirection=SEND, ComIPduHandleId=12, ComIPduType=TP, ComIPduGroupRef=FAW3_HVAC_V2_0DBC_dbc_OjcG_c_Tx, ComIPduSignalRef=ProtlampDM1APCU_DM1APCU_FAW3_HVAC_V2_0DBC_dbc_Tx, ComIPduSignalRef=amberWarnlampDM1APCU_DM1APCU_FAW3_HVAC_V2_0DBC_dbc_Tx, ComIPduSignalRef=redstoplampDM1APCU_DM1APCU_FAW3_HVAC_V2_0DBC_dbc_Tx, ComIPduSignalRef=malFctIndcrlampDM1APCU_DM1APCU_FAW3_HVAC_V2_0DBC_dbc_Tx, ComIPduSignalRef=FlashProtlampDM1APCU_DM1APCU_FAW3_HVAC_V2_0DBC_dbc_Tx, ComIPduSignalRef=FlashamberWarnlampDM1APCU_DM1APCU_FAW3_HVAC_V2_0DBC_dbc_Tx, ComIPduSignalRef=FlashredstoplampDM1APCU_DM1APCU_FAW3_HVAC_V2_0DBC_dbc_Tx, ComIPduSignalRef=FlashmalFctIndcrlampDM1APCU_DM1APCU_FAW3_HVAC_V2_0DBC_dbc_Tx, ComIPduSignalRef=spn8leastsignificantbitsDM1APCU_DM1APCU_FAW3_HVAC_V2_0DBC_dbc_Tx, ComIPduSignalRef=spnSecbyteDM1APCU_DM1APCU_FAW3_HVAC_V2_0DBC_dbc_Tx, ComIPduSignalRef=FMiDM1APCU_DM1APCU_FAW3_HVAC_V2_0DBC_dbc_Tx, ComIPduSignalRef=spn3mostsignificantbitsDM1APCU_DM1APCU_FAW3_HVAC_V2_0DBC_dbc_Tx, ComIPduSignalRef=occurrenceCntDM1APCU_DM1APCU_FAW3_HVAC_V2_0DBC_dbc_Tx, ComIPduSignalRef=spnCnvnMetHODDM1APCU_DM1APCU_FAW3_HVAC_V2_0DBC_dbc_Tx, ComPduIdRef=DM1APCU_OjcG_c
          ComTxIPdu: import=COMM_IMPORT, ComMinimumDelayTime=0, ComTxIPduUnusedAreasDefault=255
            ComTxModeFalse: import=COMM_IMPORT
              ComTxMode: import=COMM_IMPORT, ComTxModeMode=DIRECT, ComTxModeTimeOffset=0
            ComTxModeTrue: import=COMM_IMPORT
              ComTxMode: import=COMM_IMPORT, ComTxModeMode=DIRECT, ComTxModeTimeOffset=0
        DCDC1_OjcG_c: ComIPduDirection=SEND, ComIPduHandleId=13, ComIPduType=NORMAL, ComIPduGroupRef=FAW3_HVAC_V2_0DBC_dbc_OjcG_c_Tx, ComIPduSignalRef=DCDCInpUDCDC1_DCDC1_FAW3_HVAC_V2_0DBC_dbc_Tx, ComIPduSignalRef=DCDCInpCurDCDC1_DCDC1_FAW3_HVAC_V2_0DBC_dbc_Tx, ComIPduSignalRef=DCDCOutpUDCDC1_DCDC1_FAW3_HVAC_V2_0DBC_dbc_Tx, ComIPduSignalRef=DCDCOutpCurDCDC1_DCDC1_FAW3_HVAC_V2_0DBC_dbc_Tx, ComIPduSignalRef=DCDCTDCDC1_DCDC1_FAW3_HVAC_V2_0DBC_dbc_Tx, ComIPduSignalRef=DCDCworkingStsDCDC1_DCDC1_FAW3_HVAC_V2_0DBC_dbc_Tx, ComIPduSignalRef=DCDCFltStsDCDC1_DCDC1_FAW3_HVAC_V2_0DBC_dbc_Tx, ComPduIdRef=DCDC1_OjcG_c
          ComTxIPdu: import=COMM_IMPORT, ComMinimumDelayTime=0, ComTxIPduUnusedAreasDefault=0
            ComTxModeFalse: import=COMM_IMPORT
              ComTxMode: import=COMM_IMPORT, ComTxModeMode=DIRECT, ComTxModeTimeOffset=0
            ComTxModeTrue: import=COMM_IMPORT
              ComTxMode: import=COMM_IMPORT, ComTxModeMode=DIRECT, ComTxModeTimeOffset=0
        DM1DCDC_OjcG_c: ComIPduDirection=SEND, ComIPduHandleId=14, ComIPduType=TP, ComIPduGroupRef=FAW3_HVAC_V2_0DBC_dbc_OjcG_c_Tx, ComIPduSignalRef=ProtlampDM1DCDC_DM1DCDC_FAW3_HVAC_V2_0DBC_dbc_Tx, ComIPduSignalRef=amberWarnlampDM1DCDC_DM1DCDC_FAW3_HVAC_V2_0DBC_dbc_Tx, ComIPduSignalRef=redstoplampDM1DCDC_DM1DCDC_FAW3_HVAC_V2_0DBC_dbc_Tx, ComIPduSignalRef=malFctIndcrlampDM1DCDC_DM1DCDC_FAW3_HVAC_V2_0DBC_dbc_Tx, ComIPduSignalRef=FlashProtlampDM1DCDC_DM1DCDC_FAW3_HVAC_V2_0DBC_dbc_Tx, ComIPduSignalRef=FlashamberWarnlampDM1DCDC_DM1DCDC_FAW3_HVAC_V2_0DBC_dbc_Tx, ComIPduSignalRef=FlashredstoplampDM1DCDC_DM1DCDC_FAW3_HVAC_V2_0DBC_dbc_Tx, ComIPduSignalRef=FlashmalFctIndcrlampDM1DCDC_DM1DCDC_FAW3_HVAC_V2_0DBC_dbc_Tx, ComIPduSignalRef=spn8leastsignificantbitsDM1DCDC_DM1DCDC_FAW3_HVAC_V2_0DBC_dbc_Tx, ComIPduSignalRef=spnSecbyteDM1DCDC_DM1DCDC_FAW3_HVAC_V2_0DBC_dbc_Tx, ComIPduSignalRef=FMiDM1DCDC_DM1DCDC_FAW3_HVAC_V2_0DBC_dbc_Tx, ComIPduSignalRef=spn3mostsignificantbitsDM1DCDC_DM1DCDC_FAW3_HVAC_V2_0DBC_dbc_Tx, ComIPduSignalRef=occurrenceCntDM1DCDC_DM1DCDC_FAW3_HVAC_V2_0DBC_dbc_Tx, ComIPduSignalRef=spnCnvnMetHODDM1DCDC_DM1DCDC_FAW3_HVAC_V2_0DBC_dbc_Tx, ComPduIdRef=DM1DCDC_OjcG_c
          ComTxIPdu: import=COMM_IMPORT, ComMinimumDelayTime=0, ComTxIPduUnusedAreasDefault=255
            ComTxModeFalse: import=COMM_IMPORT
              ComTxMode: import=COMM_IMPORT, ComTxModeMode=DIRECT, ComTxModeTimeOffset=0
            ComTxModeTrue: import=COMM_IMPORT
              ComTxMode: import=COMM_IMPORT, ComTxModeMode=DIRECT, ComTxModeTimeOffset=0
        DM1OPCU_OjcG_c: ComIPduDirection=SEND, ComIPduHandleId=15, ComIPduType=TP, ComIPduGroupRef=FAW3_HVAC_V2_0DBC_dbc_OjcG_c_Tx, ComIPduSignalRef=ProtlampDM1OPCU_DM1OPCU_FAW3_HVAC_V2_0DBC_dbc_Tx, ComIPduSignalRef=amberWarnlampDM1OPCU_DM1OPCU_FAW3_HVAC_V2_0DBC_dbc_Tx, ComIPduSignalRef=redstoplampDM1OPCU_DM1OPCU_FAW3_HVAC_V2_0DBC_dbc_Tx, ComIPduSignalRef=malFctIndcrlampDM1OPCU_DM1OPCU_FAW3_HVAC_V2_0DBC_dbc_Tx, ComIPduSignalRef=FlashProtlampDM1OPCU_DM1OPCU_FAW3_HVAC_V2_0DBC_dbc_Tx, ComIPduSignalRef=FlashamberWarnlampDM1OPCU_DM1OPCU_FAW3_HVAC_V2_0DBC_dbc_Tx, ComIPduSignalRef=FlashredstoplampDM1OPCU_DM1OPCU_FAW3_HVAC_V2_0DBC_dbc_Tx, ComIPduSignalRef=FlashmalFctIndcrlampDM1OPCU_DM1OPCU_FAW3_HVAC_V2_0DBC_dbc_Tx, ComIPduSignalRef=spn8leastsignificantbitsDM1OPCU_DM1OPCU_FAW3_HVAC_V2_0DBC_dbc_Tx, ComIPduSignalRef=spnSecbyteDM1OPCU_DM1OPCU_FAW3_HVAC_V2_0DBC_dbc_Tx, ComIPduSignalRef=FMiDM1OPCU_DM1OPCU_FAW3_HVAC_V2_0DBC_dbc_Tx, ComIPduSignalRef=spn3mostsignificantbitsDM1OPCU_DM1OPCU_FAW3_HVAC_V2_0DBC_dbc_Tx, ComIPduSignalRef=occurrenceCntDM1OPCU_DM1OPCU_FAW3_HVAC_V2_0DBC_dbc_Tx, ComIPduSignalRef=spnCnvnMetHODDM1OPCU_DM1OPCU_FAW3_HVAC_V2_0DBC_dbc_Tx, ComPduIdRef=DM1OPCU_OjcG_c
          ComTxIPdu: import=COMM_IMPORT, ComMinimumDelayTime=0, ComTxIPduUnusedAreasDefault=255
            ComTxModeFalse: import=COMM_IMPORT
              ComTxMode: import=COMM_IMPORT, ComTxModeMode=DIRECT, ComTxModeTimeOffset=0
            ComTxModeTrue: import=COMM_IMPORT
              ComTxMode: import=COMM_IMPORT, ComTxModeMode=DIRECT, ComTxModeTimeOffset=0
        OPCU1_OjcG_c: ComIPduDirection=SEND, ComIPduHandleId=16, ComIPduType=NORMAL, ComIPduGroupRef=FAW3_HVAC_V2_0DBC_dbc_OjcG_c_Tx, ComIPduSignalRef=OPCUhighUbusUOPCU1_OPCU1_FAW3_HVAC_V2_0DBC_dbc_Tx, ComIPduSignalRef=OPCUMotFailrStsOPCU1_OPCU1_FAW3_HVAC_V2_0DBC_dbc_Tx, ComIPduSignalRef=OPCUworkingStsOPCU1_OPCU1_FAW3_HVAC_V2_0DBC_dbc_Tx, ComPduIdRef=OPCU1_OjcG_c
          ComTxIPdu: import=COMM_IMPORT, ComMinimumDelayTime=0, ComTxIPduUnusedAreasDefault=0
            ComTxModeFalse: import=COMM_IMPORT
              ComTxMode: import=COMM_IMPORT, ComTxModeMode=DIRECT, ComTxModeTimeOffset=0
            ComTxModeTrue: import=COMM_IMPORT
              ComTxMode: import=COMM_IMPORT, ComTxModeMode=DIRECT, ComTxModeTimeOffset=0
        OPCU2_OjcG_c: ComIPduDirection=SEND, ComIPduHandleId=17, ComIPduType=NORMAL, ComIPduGroupRef=FAW3_HVAC_V2_0DBC_dbc_OjcG_c_Tx, ComIPduSignalRef=oilPUMPMotIvterTOPCU2_OPCU2_FAW3_HVAC_V2_0DBC_dbc_Tx, ComIPduSignalRef=oilPUMPMotOutpCurOPCU2_OPCU2_FAW3_HVAC_V2_0DBC_dbc_Tx, ComPduIdRef=OPCU2_OjcG_c
          ComTxIPdu: import=COMM_IMPORT, ComMinimumDelayTime=0, ComTxIPduUnusedAreasDefault=0
            ComTxModeFalse: import=COMM_IMPORT
              ComTxMode: import=COMM_IMPORT, ComTxModeMode=DIRECT, ComTxModeTimeOffset=0
            ComTxModeTrue: import=COMM_IMPORT
              ComTxMode: import=COMM_IMPORT, ComTxModeMode=DIRECT, ComTxModeTimeOffset=0
        RelayState_OjcG_c: ComIPduDirection=SEND, ComIPduHandleId=18, ComIPduType=NORMAL, ComIPduGroupRef=FAW3_HVAC_V2_0DBC_dbc_OjcG_c_Tx, ComIPduSignalRef=mainPosRlyStsRelayState_RelayState_FAW3_HVAC_V2_0DBC_dbc_Tx, ComIPduSignalRef=mainnegtiveRlyStsRelayState_RelayState_FAW3_HVAC_V2_0DBC_dbc_Tx, ComIPduSignalRef=pduFailrStsRelayState_RelayState_FAW3_HVAC_V2_0DBC_dbc_Tx, ComIPduSignalRef=preChrgnRlyStsRelayState_RelayState_FAW3_HVAC_V2_0DBC_dbc_Tx, ComIPduSignalRef=fuelcellRlyStsRelayState_RelayState_FAW3_HVAC_V2_0DBC_dbc_Tx, ComIPduSignalRef=PTCRlyStsRelayState_RelayState_FAW3_HVAC_V2_0DBC_dbc_Tx, ComIPduSignalRef=AcsoryRlyStsRelayState_RelayState_FAW3_HVAC_V2_0DBC_dbc_Tx, ComIPduSignalRef=MECURlyStsRelayState_RelayState_FAW3_HVAC_V2_0DBC_dbc_Tx, ComIPduSignalRef=DCDCRlyStsRelayState_RelayState_FAW3_HVAC_V2_0DBC_dbc_Tx, ComIPduSignalRef=mainPosRlyPwronStsRelayState_RelayState_FAW3_HVAC_V2_0DBC_dbc_Tx, ComIPduSignalRef=MECUPwronStsRelayState_RelayState_FAW3_HVAC_V2_0DBC_dbc_Tx, ComIPduSignalRef=BattpackHeatgPosRlyStsRelayState_RelayState_FAW3_HVAC_V2_0DBC_dbc_Tx, ComIPduSignalRef=BattpackHeatgNegRlyStsRelayState_RelayState_FAW3_HVAC_V2_0DBC_dbc_Tx, ComIPduSignalRef=hydroCoolgRlyStsRelayState_RelayState_FAW3_HVAC_V2_0DBC_dbc_Tx, ComIPduSignalRef=acRlyStsRelayState_RelayState_FAW3_HVAC_V2_0DBC_dbc_Tx, ComPduIdRef=RelayState_OjcG_c
          ComTxIPdu: import=COMM_IMPORT, ComMinimumDelayTime=0, ComTxIPduUnusedAreasDefault=0
            ComTxModeFalse: import=COMM_IMPORT
              ComTxMode: import=COMM_IMPORT, ComTxModeMode=DIRECT, ComTxModeTimeOffset=0
            ComTxModeTrue: import=COMM_IMPORT
              ComTxMode: import=COMM_IMPORT, ComTxModeMode=DIRECT, ComTxModeTimeOffset=0
        RelayState2_OjcG_c: ComIPduDirection=SEND, ComIPduHandleId=19, ComIPduType=NORMAL, ComIPduGroupRef=FAW3_HVAC_V2_0DBC_dbc_OjcG_c_Tx, ComIPduSignalRef=DirtCurChrg1PosRlyStsRelayState2_RelayState2_FAW3_HVAC_V2_0DBC_dbc_Tx, ComIPduSignalRef=DirtCurChrg1NegRlyStsRelayState2_RelayState2_FAW3_HVAC_V2_0DBC_dbc_Tx, ComIPduSignalRef=DirtCurChrg2NegRlyStsRelayState20_RelayState2_FAW3_HVAC_V2_0DBC_dbc_Tx, ComIPduSignalRef=DirtCurChrg2NegRlyStsRelayState21_RelayState2_FAW3_HVAC_V2_0DBC_dbc_Tx, ComIPduSignalRef=PwrBattURelayState2_RelayState2_FAW3_HVAC_V2_0DBC_dbc_Tx, ComIPduSignalRef=BattheatPTCRlyStsRelayState2_RelayState2_FAW3_HVAC_V2_0DBC_dbc_Tx, ComIPduSignalRef=WtrCoolgRlyStsRelayState2_RelayState2_FAW3_HVAC_V2_0DBC_dbc_Tx, ComPduIdRef=RelayState2_OjcG_c
          ComTxIPdu: import=COMM_IMPORT, ComMinimumDelayTime=0, ComTxIPduUnusedAreasDefault=0
            ComTxModeFalse: import=COMM_IMPORT
              ComTxMode: import=COMM_IMPORT, ComTxModeMode=DIRECT, ComTxModeTimeOffset=0
            ComTxModeTrue: import=COMM_IMPORT
              ComTxMode: import=COMM_IMPORT, ComTxModeMode=DIRECT, ComTxModeTimeOffset=0
        IMCU1PTU_OjcG_c: ComIPduDirection=SEND, ComIPduHandleId=20, ComIPduType=NORMAL, ComIPduGroupRef=FAW3_HVAC_V2_0DBC_dbc_OjcG_c_Tx, ComIPduSignalRef=insulationRIMCU1PTU_IMCU1PTU_FAW3_HVAC_V2_0DBC_dbc_Tx, ComIPduSignalRef=sulationMonrdetectsUResdIMCU1PTU_IMCU1PTU_FAW3_HVAC_V2_0DBC_dbc_Tx, ComIPduSignalRef=insulationMonrSysStsIMCU1PTU_IMCU1PTU_FAW3_HVAC_V2_0DBC_dbc_Tx, ComIPduSignalRef=insulationMonrAlrmIMCU1PTU_IMCU1PTU_FAW3_HVAC_V2_0DBC_dbc_Tx, ComPduIdRef=IMCU1PTU_OjcG_c
          ComTxIPdu: import=COMM_IMPORT, ComMinimumDelayTime=0, ComTxIPduUnusedAreasDefault=0
            ComTxModeFalse: import=COMM_IMPORT
              ComTxMode: import=COMM_IMPORT, ComTxModeMode=DIRECT, ComTxModeTimeOffset=0
            ComTxModeTrue: import=COMM_IMPORT
              ComTxMode: import=COMM_IMPORT, ComTxModeMode=DIRECT, ComTxModeTimeOffset=0
        MECU1Reserved_OjcG_c: ComIPduDirection=SEND, ComIPduHandleId=21, ComIPduType=NORMAL, ComIPduGroupRef=FAW3_HVAC_V2_0DBC_dbc_OjcG_c_Tx, ComIPduSignalRef=MECUbusbarUMECU1Reserved_MECU1Reserved_FAW3_HVAC_V2_0DBC_dbc_Tx, ComPduIdRef=MECU1Reserved_OjcG_c
          ComTxIPdu: import=COMM_IMPORT, ComMinimumDelayTime=0, ComTxIPduUnusedAreasDefault=0
            ComTxModeFalse: import=COMM_IMPORT
              ComTxMode: import=COMM_IMPORT, ComTxModeMode=DIRECT, ComTxModeTimeOffset=0
            ComTxModeTrue: import=COMM_IMPORT
              ComTxMode: import=COMM_IMPORT, ComTxModeMode=DIRECT, ComTxModeTimeOffset=0
        DM1PTU_OjcG_c: ComIPduDirection=SEND, ComIPduHandleId=22, ComIPduType=TP, ComIPduGroupRef=FAW3_HVAC_V2_0DBC_dbc_OjcG_c_Tx, ComIPduSignalRef=ProtlampDM1PTU_DM1PTU_FAW3_HVAC_V2_0DBC_dbc_Tx, ComIPduSignalRef=amberWarnlampDM1PTU_DM1PTU_FAW3_HVAC_V2_0DBC_dbc_Tx, ComIPduSignalRef=redstoplampDM1PTU_DM1PTU_FAW3_HVAC_V2_0DBC_dbc_Tx, ComIPduSignalRef=malFctIndcrlampDM1PTU_DM1PTU_FAW3_HVAC_V2_0DBC_dbc_Tx, ComIPduSignalRef=FlashProtlampDM1PTU_DM1PTU_FAW3_HVAC_V2_0DBC_dbc_Tx, ComIPduSignalRef=FlashamberWarnlampDM1PTU_DM1PTU_FAW3_HVAC_V2_0DBC_dbc_Tx, ComIPduSignalRef=FlashredstoplampDM1PTU_DM1PTU_FAW3_HVAC_V2_0DBC_dbc_Tx, ComIPduSignalRef=FlashmalFctIndcrlampDM1PTU_DM1PTU_FAW3_HVAC_V2_0DBC_dbc_Tx, ComIPduSignalRef=spn8leastsignificantbitsDM1PTU_DM1PTU_FAW3_HVAC_V2_0DBC_dbc_Tx, ComIPduSignalRef=spnSecbyteDM1PTU_DM1PTU_FAW3_HVAC_V2_0DBC_dbc_Tx, ComIPduSignalRef=FMiDM1PTU_DM1PTU_FAW3_HVAC_V2_0DBC_dbc_Tx, ComIPduSignalRef=spn3mostsignificantbitsDM1PTU_DM1PTU_FAW3_HVAC_V2_0DBC_dbc_Tx, ComIPduSignalRef=occurrenceCntDM1PTU_DM1PTU_FAW3_HVAC_V2_0DBC_dbc_Tx, ComIPduSignalRef=spnCnvnMetHODDM1PTU_DM1PTU_FAW3_HVAC_V2_0DBC_dbc_Tx, ComPduIdRef=DM1PTU_OjcG_c
          ComTxIPdu: import=COMM_IMPORT, ComMinimumDelayTime=0, ComTxIPduUnusedAreasDefault=255
            ComTxModeFalse: import=COMM_IMPORT
              ComTxMode: import=COMM_IMPORT, ComTxModeMode=DIRECT, ComTxModeTimeOffset=0
            ComTxModeTrue: import=COMM_IMPORT
              ComTxMode: import=COMM_IMPORT, ComTxModeMode=DIRECT, ComTxModeTimeOffset=0
        HCUDCDC_OjcG_c: ComIPduCallout=Com_RxIpduCallout_HCUDCDC_OjcG_c, ComIPduDirection=RECEIVE, ComIPduHandleId=15, ComIPduType=NORMAL, ComIPduGroupRef=FAW3_HVAC_V2_0DBC_dbc_OjcG_c_Rx, ComIPduSignalRef=DCDCOutpUReqHCUDCDC_HCUDCDC_FAW3_HVAC_V2_0DBC_dbc_Rx, ComIPduSignalRef=DCDCworkingeanableCmdHCUDCDC_HCUDCDC_FAW3_HVAC_V2_0DBC_dbc_Rx, ComPduIdRef=HCUDCDC_OjcG_c
          ComRxIPdu: import=COMM_IMPORT, ComRxModeTimeCycle=0.1
        HCUAPCU_OjcG_c: ComIPduCallout=Com_RxIpduCallout_HCUAPCU_OjcG_c, ComIPduDirection=RECEIVE, ComIPduHandleId=16, ComIPduType=NORMAL, ComIPduGroupRef=FAW3_HVAC_V2_0DBC_dbc_OjcG_c_Rx, ComIPduSignalRef=airPUMPMotworkingEnaHCUAPCU_HCUAPCU_FAW3_HVAC_V2_0DBC_dbc_Rx, ComPduIdRef=HCUAPCU_OjcG_c
          ComRxIPdu: import=COMM_IMPORT, ComRxModeTimeCycle=0.1
        HCUOPCU_OjcG_c: ComIPduCallout=Com_RxIpduCallout_HCUOPCU_OjcG_c, ComIPduDirection=RECEIVE, ComIPduHandleId=17, ComIPduType=NORMAL, ComIPduGroupRef=FAW3_HVAC_V2_0DBC_dbc_OjcG_c_Rx, ComIPduSignalRef=oilPUMPMotworkingEnaCmdHCUOPCU_HCUOPCU_FAW3_HVAC_V2_0DBC_dbc_Rx, ComPduIdRef=HCUOPCU_OjcG_c
          ComRxIPdu: import=COMM_IMPORT, ComRxModeTimeCycle=0.1
        HCU3_OjcG_c: ComIPduCallout=Com_RxIpduCallout_HCU3_OjcG_c, ComIPduDirection=RECEIVE, ComIPduHandleId=18, ComIPduType=NORMAL, ComIPduGroupRef=FAW3_HVAC_V2_0DBC_dbc_OjcG_c_Rx, ComIPduSignalRef=mainPoshighURlyCtrlCmdHCU3_HCU3_FAW3_HVAC_V2_0DBC_dbc_Rx, ComIPduSignalRef=fuelcellRlyCtrlCmdHCU3_HCU3_FAW3_HVAC_V2_0DBC_dbc_Rx, ComIPduSignalRef=BattheatPTCRlyCtrlCmdHCU3_HCU3_FAW3_HVAC_V2_0DBC_dbc_Rx, ComIPduSignalRef=AcsoryRlyCtrlCmdHCU3_HCU3_FAW3_HVAC_V2_0DBC_dbc_Rx, ComIPduSignalRef=PTCRlyCtrlCmdHCU3_HCU3_FAW3_HVAC_V2_0DBC_dbc_Rx, ComIPduSignalRef=MECURlyclosingReqHCU3_HCU3_FAW3_HVAC_V2_0DBC_dbc_Rx, ComIPduSignalRef=DCDCRlyclosingReqHCU3_HCU3_FAW3_HVAC_V2_0DBC_dbc_Rx, ComIPduSignalRef=acRlyclosingReqHCU3_HCU3_FAW3_HVAC_V2_0DBC_dbc_Rx, ComPduIdRef=HCU3_OjcG_c
          ComRxIPdu: import=COMM_IMPORT, ComRxModeTimeCycle=0.1
        BMS5_OjcG_c: ComIPduCallout=Com_RxIpduCallout_BMS5_OjcG_c, ComIPduDirection=RECEIVE, ComIPduHandleId=19, ComIPduType=NORMAL, ComIPduGroupRef=FAW3_HVAC_V2_0DBC_dbc_OjcG_c_Rx, ComIPduSignalRef=DirtCurChrg1PosRlyCtrlCmdBMS5_BMS5_FAW3_HVAC_V2_0DBC_dbc_Rx, ComIPduSignalRef=DirtCurChrg1NegRlyCtrlCmdBMS5_BMS5_FAW3_HVAC_V2_0DBC_dbc_Rx, ComIPduSignalRef=DirtCurChrg2PosRlyCtrlCmdBMS5_BMS5_FAW3_HVAC_V2_0DBC_dbc_Rx, ComIPduSignalRef=DirtCurChrg2NegRlyCtrlCmdBMS5_BMS5_FAW3_HVAC_V2_0DBC_dbc_Rx, ComIPduSignalRef=WtrCoolgRlyCtrlCmdBMS5_BMS5_FAW3_HVAC_V2_0DBC_dbc_Rx, ComIPduSignalRef=insulationtesterCtrlCmdBMS5_BMS5_FAW3_HVAC_V2_0DBC_dbc_Rx, ComIPduSignalRef=mainNegRlyStsBMS5_BMS5_FAW3_HVAC_V2_0DBC_dbc_Rx, ComPduIdRef=BMS5_OjcG_c
          ComRxIPdu: import=COMM_IMPORT, ComRxModeTimeCycle=0.02
        MCU2_OjcG_c: ComIPduCallout=Com_RxIpduCallout_MCU2_OjcG_c, ComIPduDirection=RECEIVE, ComIPduHandleId=20, ComIPduType=NORMAL, ComIPduGroupRef=FAW3_HVAC_V2_0DBC_dbc_OjcG_c_Rx, ComIPduSignalRef=MotCtrllerbusUMCU2_MCU2_FAW3_HVAC_V2_0DBC_dbc_Rx, ComIPduSignalRef=MotCtrllerbusCurMCU2_MCU2_FAW3_HVAC_V2_0DBC_dbc_Rx, ComIPduSignalRef=MotTMCU2_MCU2_FAW3_HVAC_V2_0DBC_dbc_Rx, ComIPduSignalRef=MotCtrllerTMCU2_MCU2_FAW3_HVAC_V2_0DBC_dbc_Rx, ComPduIdRef=MCU2_OjcG_c
          ComRxIPdu: import=COMM_IMPORT, ComRxModeTimeCycle=0.1
      6 x ComIPduGroup, all with import=COMM_IMPORT:
        CAN_Matrix_DCDC_V0_1_20250414_dbc_VR82BV_Tx: ComIPduGroupHandleId=0
        CAN_Matrix_DCDC_V0_1_20250414_dbc_VR82BV_Rx: ComIPduGroupHandleId=1
        FAW_MCD_MCU_CAN_V1_4_1_dbc_D3_sO0_Tx: ComIPduGroupHandleId=2
        FAW_MCD_MCU_CAN_V1_4_1_dbc_D3_sO0_Rx: ComIPduGroupHandleId=3
        FAW3_HVAC_V2_0DBC_dbc_OjcG_c_Tx: ComIPduGroupHandleId=4
        FAW3_HVAC_V2_0DBC_dbc_OjcG_c_Rx: ComIPduGroupHandleId=5
      323 x ComSignal, all with import=COMM_IMPORT:
        MotoperatingmodeMCU1_MCU1_FAW_MCD_MCU_CAN_V1_4_1_dbc_Tx: source-file=FAW_MCD_MCU_CAN_V1.4.1.dbc, ComBitPosition=0, ComBitSize=2, ComHandleId=0, ComSignalEndianness=LITTLE_ENDIAN, ComSignalInitValue=0, ComSignalType=UINT8, ComTimeout=0, ComTransferProperty=TRIGGERED_WITHOUT_REPETITION, ComFactorAndOffset=1;0
        MotRotDirtionMCU1_MCU1_FAW_MCD_MCU_CAN_V1_4_1_dbc_Tx: source-file=FAW_MCD_MCU_CAN_V1.4.1.dbc, ComBitPosition=2, ComBitSize=2, ComHandleId=1, ComSignalEndianness=LITTLE_ENDIAN, ComSignalInitValue=0, ComSignalType=UINT8, ComTimeout=0, ComTransferProperty=TRIGGERED_WITHOUT_REPETITION, ComFactorAndOffset=1;0
        MotSysStsMCU1_MCU1_FAW_MCD_MCU_CAN_V1_4_1_dbc_Tx: source-file=FAW_MCD_MCU_CAN_V1.4.1.dbc, ComBitPosition=4, ComBitSize=4, ComHandleId=2, ComSignalEndianness=LITTLE_ENDIAN, ComSignalInitValue=0, ComSignalType=UINT8, ComTimeout=0, ComTransferProperty=TRIGGERED_WITHOUT_REPETITION, ComFactorAndOffset=1;0
        highprecisionMotTqMCU1_MCU1_FAW_MCD_MCU_CAN_V1_4_1_dbc_Tx: source-file=FAW_MCD_MCU_CAN_V1.4.1.dbc, ComBitPosition=8, ComBitSize=4, ComHandleId=3, ComSignalEndianness=LITTLE_ENDIAN, ComSignalInitValue=15, ComSignalType=UINT8, ComTimeout=0, ComTransferProperty=TRIGGERED_WITHOUT_REPETITION, ComFactorAndOffset=1;0
        MotCurMaxOutphighprecisionTqMCU1_MCU1_FAW_MCD_MCU_CAN_V1_4_1_dbc_Tx: source-file=FAW_MCD_MCU_CAN_V1.4.1.dbc, ComBitPosition=12, ComBitSize=4, ComHandleId=4, ComSignalEndianness=LITTLE_ENDIAN, ComSignalInitValue=15, ComSignalType=UINT8, ComTimeout=0, ComTransferProperty=TRIGGERED_WITHOUT_REPETITION, ComFactorAndOffset=1;0
        MotTqMCU1_MCU1_FAW_MCD_MCU_CAN_V1_4_1_dbc_Tx: source-file=FAW_MCD_MCU_CAN_V1.4.1.dbc, ComBitPosition=16, ComBitSize=8, ComHandleId=5, ComSignalEndianness=LITTLE_ENDIAN, ComSignalInitValue=125, ComSignalType=UINT8, ComTimeout=0, ComTransferProperty=TRIGGERED_WITHOUT_REPETITION, ComFactorAndOffset=1;-125
        CurMaxOutpTqofMotMCU1_MCU1_FAW_MCD_MCU_CAN_V1_4_1_dbc_Tx: source-file=FAW_MCD_MCU_CAN_V1.4.1.dbc, ComBitPosition=24, ComBitSize=8, ComHandleId=6, ComSignalEndianness=LITTLE_ENDIAN, ComSignalInitValue=125, ComSignalType=UINT8, ComTimeout=0, ComTransferProperty=TRIGGERED_WITHOUT_REPETITION, ComFactorAndOffset=1;-125
        MotSpdMCU1_MCU1_FAW_MCD_MCU_CAN_V1_4_1_dbc_Tx: source-file=FAW_MCD_MCU_CAN_V1.4.1.dbc, ComBitPosition=32, ComBitSize=16, ComHandleId=7, ComSignalEndianness=LITTLE_ENDIAN, ComSignalInitValue=0, ComSignalType=UINT16, ComTimeout=0, ComTransferProperty=TRIGGERED_WITHOUT_REPETITION, ComFactorAndOffset=0.5;0
        highUPwroffAllwedMCU1_MCU1_FAW_MCD_MCU_CAN_V1_4_1_dbc_Tx: source-file=FAW_MCD_MCU_CAN_V1.4.1.dbc, ComBitPosition=50, ComBitSize=2, ComHandleId=8, ComSignalEndianness=LITTLE_ENDIAN, ComSignalInitValue=0, ComSignalType=UINT8, ComTimeout=0, ComTransferProperty=TRIGGERED_WITHOUT_REPETITION, ComFactorAndOffset=1;0
        ActvdisChrgStMCU1_MCU1_FAW_MCD_MCU_CAN_V1_4_1_dbc_Tx: source-file=FAW_MCD_MCU_CAN_V1.4.1.dbc, ComBitPosition=52, ComBitSize=2, ComHandleId=9, ComSignalEndianness=LITTLE_ENDIAN, ComSignalInitValue=0, ComSignalType=UINT8, ComTimeout=0, ComTransferProperty=TRIGGERED_WITHOUT_REPETITION, ComFactorAndOffset=1;0
        MotFailrStsMCU1_MCU1_FAW_MCD_MCU_CAN_V1_4_1_dbc_Tx: source-file=FAW_MCD_MCU_CAN_V1.4.1.dbc, ComBitPosition=54, ComBitSize=2, ComHandleId=10, ComSignalEndianness=LITTLE_ENDIAN, ComSignalInitValue=0, ComSignalType=UINT8, ComTimeout=0, ComTransferProperty=TRIGGERED_WITHOUT_REPETITION, ComFactorAndOffset=1;0
        MsgCnterMCU1_MCU1_FAW_MCD_MCU_CAN_V1_4_1_dbc_Tx: source-file=FAW_MCD_MCU_CAN_V1.4.1.dbc, ComBitPosition=56, ComBitSize=4, ComHandleId=11, ComSignalEndianness=LITTLE_ENDIAN, ComSignalInitValue=0, ComSignalType=UINT8, ComTimeout=0, ComTransferProperty=TRIGGERED_WITHOUT_REPETITION, ComFactorAndOffset=1;0
        MsgChksumMCU1_MCU1_FAW_MCD_MCU_CAN_V1_4_1_dbc_Tx: source-file=FAW_MCD_MCU_CAN_V1.4.1.dbc, ComBitPosition=60, ComBitSize=4, ComHandleId=12, ComSignalEndianness=LITTLE_ENDIAN, ComSignalInitValue=0, ComSignalType=UINT8, ComTimeout=0, ComTransferProperty=TRIGGERED_WITHOUT_REPETITION, ComFactorAndOffset=1;0
        MotTqECMCU_ECMCU_FAW_MCD_MCU_CAN_V1_4_1_dbc_Tx: source-file=FAW_MCD_MCU_CAN_V1.4.1.dbc, ComBitPosition=152, ComBitSize=16, ComHandleId=13, ComSignalEndianness=LITTLE_ENDIAN, ComSignalInitValue=0, ComSignalType=UINT16, ComTimeout=0, ComTransferProperty=TRIGGERED_WITHOUT_REPETITION, ComFactorAndOffset=1;0
        MotAvlMaxGennhighprecisionTqMCU3_MCU3_FAW_MCD_MCU_CAN_V1_4_1_dbc_Tx: source-file=FAW_MCD_MCU_CAN_V1.4.1.dbc, ComBitPosition=12, ComBitSize=4, ComHandleId=14, ComSignalEndianness=LITTLE_ENDIAN, ComSignalInitValue=15, ComSignalType=UINT8, ComTimeout=0, ComTransferProperty=TRIGGERED_WITHOUT_REPETITION, ComFactorAndOffset=1;0
        MotAvlMaxGennTqMCU3_MCU3_FAW_MCD_MCU_CAN_V1_4_1_dbc_Tx: source-file=FAW_MCD_MCU_CAN_V1.4.1.dbc, ComBitPosition=24, ComBitSize=8, ComHandleId=15, ComSignalEndianness=LITTLE_ENDIAN, ComSignalInitValue=125, ComSignalType=UINT8, ComTimeout=0, ComTransferProperty=TRIGGERED_WITHOUT_REPETITION, ComFactorAndOffset=1;-125
        MsgCnterMCU3_MCU3_FAW_MCD_MCU_CAN_V1_4_1_dbc_Tx: source-file=FAW_MCD_MCU_CAN_V1.4.1.dbc, ComBitPosition=56, ComBitSize=4, ComHandleId=16, ComSignalEndianness=LITTLE_ENDIAN, ComSignalInitValue=0, ComSignalType=UINT8, ComTimeout=0, ComTransferProperty=TRIGGERED_WITHOUT_REPETITION, ComFactorAndOffset=1;0
        MsgChksumMCU3_MCU3_FAW_MCD_MCU_CAN_V1_4_1_dbc_Tx: source-file=FAW_MCD_MCU_CAN_V1.4.1.dbc, ComBitPosition=60, ComBitSize=4, ComHandleId=17, ComSignalEndianness=LITTLE_ENDIAN, ComSignalInitValue=0, ComSignalType=UINT8, ComTimeout=0, ComTransferProperty=TRIGGERED_WITHOUT_REPETITION, ComFactorAndOffset=1;0
        MotoperatingmodeMCU21_MCU21_FAW_MCD_MCU_CAN_V1_4_1_dbc_Tx: source-file=FAW_MCD_MCU_CAN_V1.4.1.dbc, ComBitPosition=0, ComBitSize=2, ComHandleId=18, ComSignalEndianness=LITTLE_ENDIAN, ComSignalInitValue=0, ComSignalType=UINT8, ComTimeout=0, ComTransferProperty=TRIGGERED_WITHOUT_REPETITION, ComFactorAndOffset=1;0
        MotRotDirtionMCU21_MCU21_FAW_MCD_MCU_CAN_V1_4_1_dbc_Tx: source-file=FAW_MCD_MCU_CAN_V1.4.1.dbc, ComBitPosition=2, ComBitSize=2, ComHandleId=19, ComSignalEndianness=LITTLE_ENDIAN, ComSignalInitValue=0, ComSignalType=UINT8, ComTimeout=0, ComTransferProperty=TRIGGERED_WITHOUT_REPETITION, ComFactorAndOffset=1;0
        MotSysStsMCU21_MCU21_FAW_MCD_MCU_CAN_V1_4_1_dbc_Tx: source-file=FAW_MCD_MCU_CAN_V1.4.1.dbc, ComBitPosition=4, ComBitSize=4, ComHandleId=20, ComSignalEndianness=LITTLE_ENDIAN, ComSignalInitValue=0, ComSignalType=UINT8, ComTimeout=0, ComTransferProperty=TRIGGERED_WITHOUT_REPETITION, ComFactorAndOffset=1;0
        highprecisionMotTqMCU21_MCU21_FAW_MCD_MCU_CAN_V1_4_1_dbc_Tx: source-file=FAW_MCD_MCU_CAN_V1.4.1.dbc, ComBitPosition=8, ComBitSize=4, ComHandleId=21, ComSignalEndianness=LITTLE_ENDIAN, ComSignalInitValue=15, ComSignalType=UINT8, ComTimeout=0, ComTransferProperty=TRIGGERED_WITHOUT_REPETITION, ComFactorAndOffset=1;0
        otCurMaxOutphighprecisionTqMCU21_MCU21_FAW_MCD_MCU_CAN_V1_4_1_dbc_Tx: source-file=FAW_MCD_MCU_CAN_V1.4.1.dbc, ComBitPosition=12, ComBitSize=4, ComHandleId=22, ComSignalEndianness=LITTLE_ENDIAN, ComSignalInitValue=15, ComSignalType=UINT8, ComTimeout=0, ComTransferProperty=TRIGGERED_WITHOUT_REPETITION, ComFactorAndOffset=1;0
        MotTqMCU21_MCU21_FAW_MCD_MCU_CAN_V1_4_1_dbc_Tx: source-file=FAW_MCD_MCU_CAN_V1.4.1.dbc, ComBitPosition=16, ComBitSize=8, ComHandleId=23, ComSignalEndianness=LITTLE_ENDIAN, ComSignalInitValue=125, ComSignalType=UINT8, ComTimeout=0, ComTransferProperty=TRIGGERED_WITHOUT_REPETITION, ComFactorAndOffset=1;-125
        CurMaxOutpTqofMotMCU21_MCU21_FAW_MCD_MCU_CAN_V1_4_1_dbc_Tx: source-file=FAW_MCD_MCU_CAN_V1.4.1.dbc, ComBitPosition=24, ComBitSize=8, ComHandleId=24, ComSignalEndianness=LITTLE_ENDIAN, ComSignalInitValue=125, ComSignalType=UINT8, ComTimeout=0, ComTransferProperty=TRIGGERED_WITHOUT_REPETITION, ComFactorAndOffset=1;-125
        MotSpdMCU21_MCU21_FAW_MCD_MCU_CAN_V1_4_1_dbc_Tx: source-file=FAW_MCD_MCU_CAN_V1.4.1.dbc, ComBitPosition=32, ComBitSize=16, ComHandleId=25, ComSignalEndianness=LITTLE_ENDIAN, ComSignalInitValue=0, ComSignalType=UINT16, ComTimeout=0, ComTransferProperty=TRIGGERED_WITHOUT_REPETITION, ComFactorAndOffset=0.5;0
        highUPwroffAllwedMCU21_MCU21_FAW_MCD_MCU_CAN_V1_4_1_dbc_Tx: source-file=FAW_MCD_MCU_CAN_V1.4.1.dbc, ComBitPosition=50, ComBitSize=2, ComHandleId=26, ComSignalEndianness=LITTLE_ENDIAN, ComSignalInitValue=0, ComSignalType=UINT8, ComTimeout=0, ComTransferProperty=TRIGGERED_WITHOUT_REPETITION, ComFactorAndOffset=1;0
        ActvdisChrgStMCU21_MCU21_FAW_MCD_MCU_CAN_V1_4_1_dbc_Tx: source-file=FAW_MCD_MCU_CAN_V1.4.1.dbc, ComBitPosition=52, ComBitSize=2, ComHandleId=27, ComSignalEndianness=LITTLE_ENDIAN, ComSignalInitValue=0, ComSignalType=UINT8, ComTimeout=0, ComTransferProperty=TRIGGERED_WITHOUT_REPETITION, ComFactorAndOffset=1;0
        MotFailrStsMCU21_MCU21_FAW_MCD_MCU_CAN_V1_4_1_dbc_Tx: source-file=FAW_MCD_MCU_CAN_V1.4.1.dbc, ComBitPosition=54, ComBitSize=2, ComHandleId=28, ComSignalEndianness=LITTLE_ENDIAN, ComSignalInitValue=0, ComSignalType=UINT8, ComTimeout=0, ComTransferProperty=TRIGGERED_WITHOUT_REPETITION, ComFactorAndOffset=1;0
        MsgCnterMCU21_MCU21_FAW_MCD_MCU_CAN_V1_4_1_dbc_Tx: source-file=FAW_MCD_MCU_CAN_V1.4.1.dbc, ComBitPosition=56, ComBitSize=4, ComHandleId=29, ComSignalEndianness=LITTLE_ENDIAN, ComSignalInitValue=0, ComSignalType=UINT8, ComTimeout=0, ComTransferProperty=TRIGGERED_WITHOUT_REPETITION, ComFactorAndOffset=1;0
        MsgChksumMCU21_MCU21_FAW_MCD_MCU_CAN_V1_4_1_dbc_Tx: source-file=FAW_MCD_MCU_CAN_V1.4.1.dbc, ComBitPosition=60, ComBitSize=4, ComHandleId=30, ComSignalEndianness=LITTLE_ENDIAN, ComSignalInitValue=0, ComSignalType=UINT8, ComTimeout=0, ComTransferProperty=TRIGGERED_WITHOUT_REPETITION, ComFactorAndOffset=1;0
        MotCtrllerbusUMCU22_MCU22_FAW_MCD_MCU_CAN_V1_4_1_dbc_Tx: source-file=FAW_MCD_MCU_CAN_V1.4.1.dbc, ComBitPosition=0, ComBitSize=16, ComHandleId=31, ComSignalEndianness=LITTLE_ENDIAN, ComSignalInitValue=0, ComSignalType=UINT16, ComTimeout=0, ComTransferProperty=TRIGGERED_WITHOUT_REPETITION, ComFactorAndOffset=1;0
        MotCtrllerbusCurMCU22_MCU22_FAW_MCD_MCU_CAN_V1_4_1_dbc_Tx: source-file=FAW_MCD_MCU_CAN_V1.4.1.dbc, ComBitPosition=16, ComBitSize=16, ComHandleId=32, ComSignalEndianness=LITTLE_ENDIAN, ComSignalInitValue=0, ComSignalType=UINT16, ComTimeout=0, ComTransferProperty=TRIGGERED_WITHOUT_REPETITION, ComFactorAndOffset=1;-1600
        MotTMCU22_MCU22_FAW_MCD_MCU_CAN_V1_4_1_dbc_Tx: source-file=FAW_MCD_MCU_CAN_V1.4.1.dbc, ComBitPosition=32, ComBitSize=8, ComHandleId=33, ComSignalEndianness=LITTLE_ENDIAN, ComSignalInitValue=64, ComSignalType=UINT8, ComTimeout=0, ComTransferProperty=TRIGGERED_WITHOUT_REPETITION, ComFactorAndOffset=1;-40
        MotCtrllerTMCU22_MCU22_FAW_MCD_MCU_CAN_V1_4_1_dbc_Tx: source-file=FAW_MCD_MCU_CAN_V1.4.1.dbc, ComBitPosition=40, ComBitSize=8, ComHandleId=34, ComSignalEndianness=LITTLE_ENDIAN, ComSignalInitValue=64, ComSignalType=UINT8, ComTimeout=0, ComTransferProperty=TRIGGERED_WITHOUT_REPETITION, ComFactorAndOffset=1;-40
        otAvlMaxGennhighprecisionTqMCU23_MCU23_FAW_MCD_MCU_CAN_V1_4_1_dbc_Tx: source-file=FAW_MCD_MCU_CAN_V1.4.1.dbc, ComBitPosition=12, ComBitSize=4, ComHandleId=35, ComSignalEndianness=LITTLE_ENDIAN, ComSignalInitValue=15, ComSignalType=UINT8, ComTimeout=0, ComTransferProperty=TRIGGERED_WITHOUT_REPETITION, ComFactorAndOffset=1;0
        MotAvlMaxGennTqMCU23_MCU23_FAW_MCD_MCU_CAN_V1_4_1_dbc_Tx: source-file=FAW_MCD_MCU_CAN_V1.4.1.dbc, ComBitPosition=24, ComBitSize=8, ComHandleId=36, ComSignalEndianness=LITTLE_ENDIAN, ComSignalInitValue=125, ComSignalType=UINT8, ComTimeout=0, ComTransferProperty=TRIGGERED_WITHOUT_REPETITION, ComFactorAndOffset=1;-125
        MsgCnterMCU23_MCU23_FAW_MCD_MCU_CAN_V1_4_1_dbc_Tx: source-file=FAW_MCD_MCU_CAN_V1.4.1.dbc, ComBitPosition=56, ComBitSize=4, ComHandleId=37, ComSignalEndianness=LITTLE_ENDIAN, ComSignalInitValue=0, ComSignalType=UINT8, ComTimeout=0, ComTransferProperty=TRIGGERED_WITHOUT_REPETITION, ComFactorAndOffset=1;0
        MsgChksumMCU23_MCU23_FAW_MCD_MCU_CAN_V1_4_1_dbc_Tx: source-file=FAW_MCD_MCU_CAN_V1.4.1.dbc, ComBitPosition=60, ComBitSize=4, ComHandleId=38, ComSignalEndianness=LITTLE_ENDIAN, ComSignalInitValue=0, ComSignalType=UINT8, ComTimeout=0, ComTransferProperty=TRIGGERED_WITHOUT_REPETITION, ComFactorAndOffset=1;0
        ProtlampDM1MCU_DM1MCU_FAW_MCD_MCU_CAN_V1_4_1_dbc_Tx: source-file=FAW_MCD_MCU_CAN_V1.4.1.dbc, ComBitPosition=0, ComBitSize=2, ComHandleId=39, ComSignalEndianness=LITTLE_ENDIAN, ComSignalInitValue=0, ComSignalType=UINT8, ComTimeout=0, ComTransferProperty=TRIGGERED_WITHOUT_REPETITION, ComFactorAndOffset=1;0
        amberWarnlampDM1MCU_DM1MCU_FAW_MCD_MCU_CAN_V1_4_1_dbc_Tx: source-file=FAW_MCD_MCU_CAN_V1.4.1.dbc, ComBitPosition=2, ComBitSize=2, ComHandleId=40, ComSignalEndianness=LITTLE_ENDIAN, ComSignalInitValue=0, ComSignalType=UINT8, ComTimeout=0, ComTransferProperty=TRIGGERED_WITHOUT_REPETITION, ComFactorAndOffset=1;0
        redstoplampDM1MCU_DM1MCU_FAW_MCD_MCU_CAN_V1_4_1_dbc_Tx: source-file=FAW_MCD_MCU_CAN_V1.4.1.dbc, ComBitPosition=4, ComBitSize=2, ComHandleId=41, ComSignalEndianness=LITTLE_ENDIAN, ComSignalInitValue=0, ComSignalType=UINT8, ComTimeout=0, ComTransferProperty=TRIGGERED_WITHOUT_REPETITION, ComFactorAndOffset=1;0
        malFctIndcrlampDM1MCU_DM1MCU_FAW_MCD_MCU_CAN_V1_4_1_dbc_Tx: source-file=FAW_MCD_MCU_CAN_V1.4.1.dbc, ComBitPosition=6, ComBitSize=2, ComHandleId=42, ComSignalEndianness=LITTLE_ENDIAN, ComSignalInitValue=0, ComSignalType=UINT8, ComTimeout=0, ComTransferProperty=TRIGGERED_WITHOUT_REPETITION, ComFactorAndOffset=1;0
        FlashProtlampDM1MCU_DM1MCU_FAW_MCD_MCU_CAN_V1_4_1_dbc_Tx: source-file=FAW_MCD_MCU_CAN_V1.4.1.dbc, ComBitPosition=8, ComBitSize=2, ComHandleId=43, ComSignalEndianness=LITTLE_ENDIAN, ComSignalInitValue=0, ComSignalType=UINT8, ComTimeout=0, ComTransferProperty=TRIGGERED_WITHOUT_REPETITION, ComFactorAndOffset=1;0
        FlashamberWarnlampDM1MCU_DM1MCU_FAW_MCD_MCU_CAN_V1_4_1_dbc_Tx: source-file=FAW_MCD_MCU_CAN_V1.4.1.dbc, ComBitPosition=10, ComBitSize=2, ComHandleId=44, ComSignalEndianness=LITTLE_ENDIAN, ComSignalInitValue=0, ComSignalType=UINT8, ComTimeout=0, ComTransferProperty=TRIGGERED_WITHOUT_REPETITION, ComFactorAndOffset=1;0
        FlashredstoplampDM1MCU_DM1MCU_FAW_MCD_MCU_CAN_V1_4_1_dbc_Tx: source-file=FAW_MCD_MCU_CAN_V1.4.1.dbc, ComBitPosition=12, ComBitSize=2, ComHandleId=45, ComSignalEndianness=LITTLE_ENDIAN, ComSignalInitValue=0, ComSignalType=UINT8, ComTimeout=0, ComTransferProperty=TRIGGERED_WITHOUT_REPETITION, ComFactorAndOffset=1;0
        FlashmalFctIndcrlampDM1MCU_DM1MCU_FAW_MCD_MCU_CAN_V1_4_1_dbc_Tx: source-file=FAW_MCD_MCU_CAN_V1.4.1.dbc, ComBitPosition=14, ComBitSize=2, ComHandleId=46, ComSignalEndianness=LITTLE_ENDIAN, ComSignalInitValue=0, ComSignalType=UINT8, ComTimeout=0, ComTransferProperty=TRIGGERED_WITHOUT_REPETITION, ComFactorAndOffset=1;0
        spn8leastsignificantbitsDM1MCU_DM1MCU_FAW_MCD_MCU_CAN_V1_4_1_dbc_Tx: source-file=FAW_MCD_MCU_CAN_V1.4.1.dbc, ComBitPosition=16, ComBitSize=8, ComHandleId=47, ComSignalEndianness=LITTLE_ENDIAN, ComSignalInitValue=0, ComSignalType=UINT8, ComTimeout=0, ComTransferProperty=TRIGGERED_WITHOUT_REPETITION, ComFactorAndOffset=1;0
        spnSecbyteDM1MCU_DM1MCU_FAW_MCD_MCU_CAN_V1_4_1_dbc_Tx: source-file=FAW_MCD_MCU_CAN_V1.4.1.dbc, ComBitPosition=24, ComBitSize=8, ComHandleId=48, ComSignalEndianness=LITTLE_ENDIAN, ComSignalInitValue=0, ComSignalType=UINT8, ComTimeout=0, ComTransferProperty=TRIGGERED_WITHOUT_REPETITION, ComFactorAndOffset=1;0
        FMiDM1MCU_DM1MCU_FAW_MCD_MCU_CAN_V1_4_1_dbc_Tx: source-file=FAW_MCD_MCU_CAN_V1.4.1.dbc, ComBitPosition=32, ComBitSize=5, ComHandleId=49, ComSignalEndianness=LITTLE_ENDIAN, ComSignalInitValue=0, ComSignalType=UINT8, ComTimeout=0, ComTransferProperty=TRIGGERED_WITHOUT_REPETITION, ComFactorAndOffset=1;0
        spn3mostsignificantbitsDM1MCU_DM1MCU_FAW_MCD_MCU_CAN_V1_4_1_dbc_Tx: source-file=FAW_MCD_MCU_CAN_V1.4.1.dbc, ComBitPosition=37, ComBitSize=3, ComHandleId=50, ComSignalEndianness=LITTLE_ENDIAN, ComSignalInitValue=0, ComSignalType=UINT8, ComTimeout=0, ComTransferProperty=TRIGGERED_WITHOUT_REPETITION, ComFactorAndOffset=1;0
        occurrenceCntDM1MCU_DM1MCU_FAW_MCD_MCU_CAN_V1_4_1_dbc_Tx: source-file=FAW_MCD_MCU_CAN_V1.4.1.dbc, ComBitPosition=40, ComBitSize=7, ComHandleId=51, ComSignalEndianness=LITTLE_ENDIAN, ComSignalInitValue=0, ComSignalType=UINT8, ComTimeout=0, ComTransferProperty=TRIGGERED_WITHOUT_REPETITION, ComFactorAndOffset=1;0
        spnCnvnMetHODDM1MCU_DM1MCU_FAW_MCD_MCU_CAN_V1_4_1_dbc_Tx: source-file=FAW_MCD_MCU_CAN_V1.4.1.dbc, ComBitPosition=47, ComBitSize=1, ComHandleId=52, ComSignalEndianness=LITTLE_ENDIAN, ComSignalInitValue=0, ComSignalType=BOOLEAN, ComTimeout=0, ComTransferProperty=TRIGGERED_WITHOUT_REPETITION, ComFactorAndOffset=1;0
        ProtlampDM1MCU2_DM1MCU2_FAW_MCD_MCU_CAN_V1_4_1_dbc_Tx: source-file=FAW_MCD_MCU_CAN_V1.4.1.dbc, ComBitPosition=0, ComBitSize=2, ComHandleId=53, ComSignalEndianness=LITTLE_ENDIAN, ComSignalInitValue=0, ComSignalType=UINT8, ComTimeout=0, ComTransferProperty=TRIGGERED_WITHOUT_REPETITION, ComFactorAndOffset=1;0
        amberWarnlampDM1MCU2_DM1MCU2_FAW_MCD_MCU_CAN_V1_4_1_dbc_Tx: source-file=FAW_MCD_MCU_CAN_V1.4.1.dbc, ComBitPosition=2, ComBitSize=2, ComHandleId=54, ComSignalEndianness=LITTLE_ENDIAN, ComSignalInitValue=0, ComSignalType=UINT8, ComTimeout=0, ComTransferProperty=TRIGGERED_WITHOUT_REPETITION, ComFactorAndOffset=1;0
        redstoplampDM1MCU2_DM1MCU2_FAW_MCD_MCU_CAN_V1_4_1_dbc_Tx: source-file=FAW_MCD_MCU_CAN_V1.4.1.dbc, ComBitPosition=4, ComBitSize=2, ComHandleId=55, ComSignalEndianness=LITTLE_ENDIAN, ComSignalInitValue=0, ComSignalType=UINT8, ComTimeout=0, ComTransferProperty=TRIGGERED_WITHOUT_REPETITION, ComFactorAndOffset=1;0
        malFctIndcrlampDM1MCU2_DM1MCU2_FAW_MCD_MCU_CAN_V1_4_1_dbc_Tx: source-file=FAW_MCD_MCU_CAN_V1.4.1.dbc, ComBitPosition=6, ComBitSize=2, ComHandleId=56, ComSignalEndianness=LITTLE_ENDIAN, ComSignalInitValue=0, ComSignalType=UINT8, ComTimeout=0, ComTransferProperty=TRIGGERED_WITHOUT_REPETITION, ComFactorAndOffset=1;0
        FlashProtlampDM1MCU2_DM1MCU2_FAW_MCD_MCU_CAN_V1_4_1_dbc_Tx: source-file=FAW_MCD_MCU_CAN_V1.4.1.dbc, ComBitPosition=8, ComBitSize=2, ComHandleId=57, ComSignalEndianness=LITTLE_ENDIAN, ComSignalInitValue=0, ComSignalType=UINT8, ComTimeout=0, ComTransferProperty=TRIGGERED_WITHOUT_REPETITION, ComFactorAndOffset=1;0
        FlashamberWarnlampDM1MCU2_DM1MCU2_FAW_MCD_MCU_CAN_V1_4_1_dbc_Tx: source-file=FAW_MCD_MCU_CAN_V1.4.1.dbc, ComBitPosition=10, ComBitSize=2, ComHandleId=58, ComSignalEndianness=LITTLE_ENDIAN, ComSignalInitValue=0, ComSignalType=UINT8, ComTimeout=0, ComTransferProperty=TRIGGERED_WITHOUT_REPETITION, ComFactorAndOffset=1;0
        FlashredstoplampDM1MCU2_DM1MCU2_FAW_MCD_MCU_CAN_V1_4_1_dbc_Tx: source-file=FAW_MCD_MCU_CAN_V1.4.1.dbc, ComBitPosition=12, ComBitSize=2, ComHandleId=59, ComSignalEndianness=LITTLE_ENDIAN, ComSignalInitValue=0, ComSignalType=UINT8, ComTimeout=0, ComTransferProperty=TRIGGERED_WITHOUT_REPETITION, ComFactorAndOffset=1;0
        FlashmalFctIndcrlampDM1MCU2_DM1MCU2_FAW_MCD_MCU_CAN_V1_4_1_dbc_Tx: source-file=FAW_MCD_MCU_CAN_V1.4.1.dbc, ComBitPosition=14, ComBitSize=2, ComHandleId=60, ComSignalEndianness=LITTLE_ENDIAN, ComSignalInitValue=0, ComSignalType=UINT8, ComTimeout=0, ComTransferProperty=TRIGGERED_WITHOUT_REPETITION, ComFactorAndOffset=1;0
        spn8leastsignificantbitsDM1MCU2_DM1MCU2_FAW_MCD_MCU_CAN_V1_4_1_dbc_Tx: source-file=FAW_MCD_MCU_CAN_V1.4.1.dbc, ComBitPosition=16, ComBitSize=8, ComHandleId=61, ComSignalEndianness=LITTLE_ENDIAN, ComSignalInitValue=0, ComSignalType=UINT8, ComTimeout=0, ComTransferProperty=TRIGGERED_WITHOUT_REPETITION, ComFactorAndOffset=1;0
        spnSecbyteDM1MCU2_DM1MCU2_FAW_MCD_MCU_CAN_V1_4_1_dbc_Tx: source-file=FAW_MCD_MCU_CAN_V1.4.1.dbc, ComBitPosition=24, ComBitSize=8, ComHandleId=62, ComSignalEndianness=LITTLE_ENDIAN, ComSignalInitValue=0, ComSignalType=UINT8, ComTimeout=0, ComTransferProperty=TRIGGERED_WITHOUT_REPETITION, ComFactorAndOffset=1;0
        FMiDM1MCU2_DM1MCU2_FAW_MCD_MCU_CAN_V1_4_1_dbc_Tx: source-file=FAW_MCD_MCU_CAN_V1.4.1.dbc, ComBitPosition=32, ComBitSize=5, ComHandleId=63, ComSignalEndianness=LITTLE_ENDIAN, ComSignalInitValue=0, ComSignalType=UINT8, ComTimeout=0, ComTransferProperty=TRIGGERED_WITHOUT_REPETITION, ComFactorAndOffset=1;0
        spn3mostsignificantbitsDM1MCU2_DM1MCU2_FAW_MCD_MCU_CAN_V1_4_1_dbc_Tx: source-file=FAW_MCD_MCU_CAN_V1.4.1.dbc, ComBitPosition=37, ComBitSize=3, ComHandleId=64, ComSignalEndianness=LITTLE_ENDIAN, ComSignalInitValue=0, ComSignalType=UINT8, ComTimeout=0, ComTransferProperty=TRIGGERED_WITHOUT_REPETITION, ComFactorAndOffset=1;0
        occurrenceCntDM1MCU2_DM1MCU2_FAW_MCD_MCU_CAN_V1_4_1_dbc_Tx: source-file=FAW_MCD_MCU_CAN_V1.4.1.dbc, ComBitPosition=40, ComBitSize=7, ComHandleId=65, ComSignalEndianness=LITTLE_ENDIAN, ComSignalInitValue=0, ComSignalType=UINT8, ComTimeout=0, ComTransferProperty=TRIGGERED_WITHOUT_REPETITION, ComFactorAndOffset=1;0
        spnCnvnMetHODDM1MCU2_DM1MCU2_FAW_MCD_MCU_CAN_V1_4_1_dbc_Tx: source-file=FAW_MCD_MCU_CAN_V1.4.1.dbc, ComBitPosition=47, ComBitSize=1, ComHandleId=66, ComSignalEndianness=LITTLE_ENDIAN, ComSignalInitValue=0, ComSignalType=BOOLEAN, ComTimeout=0, ComTransferProperty=TRIGGERED_WITHOUT_REPETITION, ComFactorAndOffset=1;0
        MotCtrllerbusUMCU2_MCU2_FAW_MCD_MCU_CAN_V1_4_1_dbc_Tx: source-file=FAW_MCD_MCU_CAN_V1.4.1.dbc, ComBitPosition=0, ComBitSize=16, ComHandleId=67, ComSignalEndianness=LITTLE_ENDIAN, ComSignalInitValue=0, ComSignalType=UINT16, ComTimeout=0, ComTransferProperty=TRIGGERED_WITHOUT_REPETITION, ComFactorAndOffset=0.05;0
        MotCtrllerbusCurMCU2_MCU2_FAW_MCD_MCU_CAN_V1_4_1_dbc_Tx: source-file=FAW_MCD_MCU_CAN_V1.4.1.dbc, ComBitPosition=16, ComBitSize=16, ComHandleId=68, ComSignalEndianness=LITTLE_ENDIAN, ComSignalInitValue=0, ComSignalType=UINT16, ComTimeout=0, ComTransferProperty=TRIGGERED_WITHOUT_REPETITION, ComFactorAndOffset=0.05;-1600
        MotTMCU2_MCU2_FAW_MCD_MCU_CAN_V1_4_1_dbc_Tx: source-file=FAW_MCD_MCU_CAN_V1.4.1.dbc, ComBitPosition=32, ComBitSize=8, ComHandleId=69, ComSignalEndianness=LITTLE_ENDIAN, ComSignalInitValue=64, ComSignalType=UINT8, ComTimeout=0, ComTransferProperty=TRIGGERED_WITHOUT_REPETITION, ComFactorAndOffset=1;-40
        MotCtrllerTMCU2_MCU2_FAW_MCD_MCU_CAN_V1_4_1_dbc_Tx: source-file=FAW_MCD_MCU_CAN_V1.4.1.dbc, ComBitPosition=40, ComBitSize=8, ComHandleId=70, ComSignalEndianness=LITTLE_ENDIAN, ComSignalInitValue=64, ComSignalType=UINT8, ComTimeout=0, ComTransferProperty=TRIGGERED_WITHOUT_REPETITION, ComFactorAndOffset=1;-40
        OvrdCtrlmodeTSC1Mtr_TSC1Mtr_FAW_MCD_MCU_CAN_V1_4_1_dbc_Rx: source-file=FAW_MCD_MCU_CAN_V1.4.1.dbc, ComBitPosition=0, ComBitSize=2, ComFirstTimeout=0.5, ComHandleId=0, ComSignalEndianness=LITTLE_ENDIAN, ComSignalInitValue=0, ComSignalType=UINT8, ComTimeout=0.5, ComTimeoutNotification=Com_RxIpduTimeout_TSC1Mtr_D3_sO0, ComTransferProperty=PENDING, ComFactorAndOffset=1;0
        ReqedSpdCtrlCdnsTSC1Mtr_TSC1Mtr_FAW_MCD_MCU_CAN_V1_4_1_dbc_Rx: source-file=FAW_MCD_MCU_CAN_V1.4.1.dbc, ComBitPosition=2, ComBitSize=2, ComHandleId=1, ComSignalEndianness=LITTLE_ENDIAN, ComSignalInitValue=0, ComSignalType=UINT8, ComTimeout=0, ComTransferProperty=PENDING, ComFactorAndOffset=1;0
        OvrdCtrlmodePrioTSC1Mtr_TSC1Mtr_FAW_MCD_MCU_CAN_V1_4_1_dbc_Rx: source-file=FAW_MCD_MCU_CAN_V1.4.1.dbc, ComBitPosition=4, ComBitSize=2, ComHandleId=2, ComSignalEndianness=LITTLE_ENDIAN, ComSignalInitValue=3, ComSignalType=UINT8, ComTimeout=0, ComTransferProperty=PENDING, ComFactorAndOffset=1;0
        ReqedSpdSpdLimTSC1Mtr_TSC1Mtr_FAW_MCD_MCU_CAN_V1_4_1_dbc_Rx: source-file=FAW_MCD_MCU_CAN_V1.4.1.dbc, ComBitPosition=8, ComBitSize=16, ComHandleId=3, ComSignalEndianness=LITTLE_ENDIAN, ComSignalInitValue=0, ComSignalType=UINT16, ComTimeout=0, ComTransferProperty=PENDING, ComFactorAndOffset=0.5;0
        ReqedTqTqLimTSC1Mtr_TSC1Mtr_FAW_MCD_MCU_CAN_V1_4_1_dbc_Rx: source-file=FAW_MCD_MCU_CAN_V1.4.1.dbc, ComBitPosition=24, ComBitSize=8, ComHandleId=4, ComSignalEndianness=LITTLE_ENDIAN, ComSignalInitValue=125, ComSignalType=UINT8, ComTimeout=0, ComTransferProperty=PENDING, ComFactorAndOffset=1;-125
        ReqedTqfrActnalTSC1Mtr_TSC1Mtr_FAW_MCD_MCU_CAN_V1_4_1_dbc_Rx: source-file=FAW_MCD_MCU_CAN_V1.4.1.dbc, ComBitPosition=40, ComBitSize=4, ComHandleId=5, ComSignalEndianness=LITTLE_ENDIAN, ComSignalInitValue=15, ComSignalType=UINT8, ComTimeout=0, ComTransferProperty=PENDING, ComFactorAndOffset=1;0
        MsgCnterTSC1Mtr_TSC1Mtr_FAW_MCD_MCU_CAN_V1_4_1_dbc_Rx: source-file=FAW_MCD_MCU_CAN_V1.4.1.dbc, ComBitPosition=56, ComBitSize=4, ComHandleId=6, ComSignalEndianness=LITTLE_ENDIAN, ComSignalInitValue=0, ComSignalType=UINT8, ComTimeout=0, ComTransferProperty=PENDING, ComFactorAndOffset=1;0
        MsgChksumTSC1Mtr_TSC1Mtr_FAW_MCD_MCU_CAN_V1_4_1_dbc_Rx: source-file=FAW_MCD_MCU_CAN_V1.4.1.dbc, ComBitPosition=60, ComBitSize=4, ComHandleId=7, ComSignalEndianness=LITTLE_ENDIAN, ComSignalInitValue=0, ComSignalType=UINT8, ComTimeout=0, ComTransferProperty=PENDING, ComFactorAndOffset=1;0
        AccrPedlapPosn_EEC2HCU_EEC2HCU_FAW_MCD_MCU_CAN_V1_4_1_dbc_Rx: source-file=FAW_MCD_MCU_CAN_V1.4.1.dbc, ComBitPosition=8, ComBitSize=8, ComFirstTimeout=0.5, ComHandleId=8, ComSignalEndianness=LITTLE_ENDIAN, ComSignalInitValue=0, ComSignalType=UINT8, ComTimeout=0.5, ComTimeoutNotification=Com_RxIpduTimeout_EEC2HCU_D3_sO0, ComTransferProperty=PENDING, ComFactorAndOffset=0.4;0
        PrkgBrkSwtCCVSHCU_CCVSHCU_FAW_MCD_MCU_CAN_V1_4_1_dbc_Rx: source-file=FAW_MCD_MCU_CAN_V1.4.1.dbc, ComBitPosition=2, ComBitSize=2, ComFirstTimeout=1, ComHandleId=9, ComSignalEndianness=LITTLE_ENDIAN, ComSignalInitValue=0, ComSignalType=UINT8, ComTimeout=1, ComTimeoutNotification=Com_RxIpduTimeout_CCVSHCU_D3_sO0, ComTransferProperty=PENDING, ComFactorAndOffset=1;0
        BrkSwtCCVSHCU_CCVSHCU_FAW_MCD_MCU_CAN_V1_4_1_dbc_Rx: source-file=FAW_MCD_MCU_CAN_V1.4.1.dbc, ComBitPosition=28, ComBitSize=2, ComHandleId=10, ComSignalEndianness=LITTLE_ENDIAN, ComSignalInitValue=0, ComSignalType=UINT8, ComTimeout=0, ComTransferProperty=PENDING, ComFactorAndOffset=1;0
        TrsmReqedgearTC1_TC1_FAW_MCD_MCU_CAN_V1_4_1_dbc_Rx: source-file=FAW_MCD_MCU_CAN_V1.4.1.dbc, ComBitPosition=16, ComBitSize=8, ComFirstTimeout=0.5, ComHandleId=11, ComSignalEndianness=LITTLE_ENDIAN, ComSignalInitValue=125, ComSignalType=UINT8, ComTimeout=0.5, ComTimeoutNotification=Com_RxIpduTimeout_TC1_D3_sO0, ComTransferProperty=PENDING, ComFactorAndOffset=1;-125
        Trsmmode2TC1_TC1_FAW_MCD_MCU_CAN_V1_4_1_dbc_Rx: source-file=FAW_MCD_MCU_CAN_V1.4.1.dbc, ComBitPosition=42, ComBitSize=2, ComHandleId=12, ComSignalEndianness=LITTLE_ENDIAN, ComSignalInitValue=0, ComSignalType=UINT8, ComTimeout=0, ComTransferProperty=PENDING, ComFactorAndOffset=1;0
        TrsmReqedgearTC1Handle_TC1Handle_FAW_MCD_MCU_CAN_V1_4_1_dbc_Rx: source-file=FAW_MCD_MCU_CAN_V1.4.1.dbc, ComBitPosition=16, ComBitSize=8, ComFirstTimeout=0.5, ComHandleId=13, ComSignalEndianness=LITTLE_ENDIAN, ComSignalInitValue=125, ComSignalType=UINT8, ComTimeout=0.5, ComTimeoutNotification=Com_RxIpduTimeout_TC1Handle_D3_sO0, ComTransferProperty=PENDING, ComFactorAndOffset=1;-125
        ShiftinProcETC1_ETC1_FAW_MCD_MCU_CAN_V1_4_1_dbc_Rx: source-file=FAW_MCD_MCU_CAN_V1.4.1.dbc, ComBitPosition=4, ComBitSize=2, ComFirstTimeout=0.5, ComHandleId=14, ComSignalEndianness=LITTLE_ENDIAN, ComSignalInitValue=0, ComSignalType=UINT8, ComTimeout=0.5, ComTimeoutNotification=Com_RxIpduTimeout_ETC1_D3_sO0, ComTransferProperty=PENDING, ComFactorAndOffset=1;0
        SeledgearETC2_ETC2_FAW_MCD_MCU_CAN_V1_4_1_dbc_Rx: source-file=FAW_MCD_MCU_CAN_V1.4.1.dbc, ComBitPosition=0, ComBitSize=8, ComFirstTimeout=1, ComHandleId=15, ComSignalEndianness=LITTLE_ENDIAN, ComSignalInitValue=125, ComSignalType=UINT8, ComTimeout=1, ComTimeoutNotification=Com_RxIpduTimeout_ETC2_D3_sO0, ComTransferProperty=PENDING, ComFactorAndOffset=1;-125
        ActgearRatETC2_ETC2_FAW_MCD_MCU_CAN_V1_4_1_dbc_Rx: source-file=FAW_MCD_MCU_CAN_V1.4.1.dbc, ComBitPosition=8, ComBitSize=16, ComHandleId=16, ComSignalEndianness=LITTLE_ENDIAN, ComSignalInitValue=0, ComSignalType=UINT16, ComTimeout=0, ComTransferProperty=PENDING, ComFactorAndOffset=0.001;0
        CurgearETC2_ETC2_FAW_MCD_MCU_CAN_V1_4_1_dbc_Rx: source-file=FAW_MCD_MCU_CAN_V1.4.1.dbc, ComBitPosition=24, ComBitSize=8, ComHandleId=17, ComSignalEndianness=LITTLE_ENDIAN, ComSignalInitValue=125, ComSignalType=UINT8, ComTimeout=0, ComTransferProperty=PENDING, ComFactorAndOffset=1;-125
        ReqHCUtoCtrltheMotAMT3_AMT3_FAW_MCD_MCU_CAN_V1_4_1_dbc_Rx: source-file=FAW_MCD_MCU_CAN_V1.4.1.dbc, ComBitPosition=0, ComBitSize=2, ComFirstTimeout=3, ComHandleId=18, ComSignalEndianness=LITTLE_ENDIAN, ComSignalInitValue=0, ComSignalType=UINT8, ComTimeout=3, ComTimeoutNotification=Com_RxIpduTimeout_AMT3_D3_sO0, ComTransferProperty=PENDING, ComFactorAndOffset=1;0
        TrsmgearselfLrningStAMT3_AMT3_FAW_MCD_MCU_CAN_V1_4_1_dbc_Rx: source-file=FAW_MCD_MCU_CAN_V1.4.1.dbc, ComBitPosition=2, ComBitSize=4, ComHandleId=19, ComSignalEndianness=LITTLE_ENDIAN, ComSignalInitValue=15, ComSignalType=UINT8, ComTimeout=0, ComTransferProperty=PENDING, ComFactorAndOffset=1;0
        holdCurgearReqAMT3_AMT3_FAW_MCD_MCU_CAN_V1_4_1_dbc_Rx: source-file=FAW_MCD_MCU_CAN_V1.4.1.dbc, ComBitPosition=6, ComBitSize=2, ComHandleId=20, ComSignalEndianness=LITTLE_ENDIAN, ComSignalInitValue=3, ComSignalType=UINT8, ComTimeout=0, ComTransferProperty=PENDING, ComFactorAndOffset=1;0
        CluStsAMT3_AMT3_FAW_MCD_MCU_CAN_V1_4_1_dbc_Rx: source-file=FAW_MCD_MCU_CAN_V1.4.1.dbc, ComBitPosition=8, ComBitSize=2, ComHandleId=21, ComSignalEndianness=LITTLE_ENDIAN, ComSignalInitValue=3, ComSignalType=UINT8, ComTimeout=0, ComTransferProperty=PENDING, ComFactorAndOffset=1;0
        SersparallelmodeStAMT3_AMT3_FAW_MCD_MCU_CAN_V1_4_1_dbc_Rx: source-file=FAW_MCD_MCU_CAN_V1.4.1.dbc, ComBitPosition=10, ComBitSize=2, ComHandleId=22, ComSignalEndianness=LITTLE_ENDIAN, ComSignalInitValue=0, ComSignalType=UINT8, ComTimeout=0, ComTransferProperty=PENDING, ComFactorAndOffset=1;0
        CluCnsedTqAMT3_AMT3_FAW_MCD_MCU_CAN_V1_4_1_dbc_Rx: source-file=FAW_MCD_MCU_CAN_V1.4.1.dbc, ComBitPosition=16, ComBitSize=8, ComHandleId=23, ComSignalEndianness=LITTLE_ENDIAN, ComSignalInitValue=125, ComSignalType=UINT8, ComTimeout=0, ComTransferProperty=PENDING, ComFactorAndOffset=1;-125
        SwtStoftheFpickerAMT3_AMT3_FAW_MCD_MCU_CAN_V1_4_1_dbc_Rx: source-file=FAW_MCD_MCU_CAN_V1.4.1.dbc, ComBitPosition=48, ComBitSize=2, ComHandleId=24, ComSignalEndianness=LITTLE_ENDIAN, ComSignalInitValue=3, ComSignalType=UINT8, ComTimeout=0, ComTransferProperty=PENDING, ComFactorAndOffset=1;0
        DrvgFStAMT3_AMT3_FAW_MCD_MCU_CAN_V1_4_1_dbc_Rx: source-file=FAW_MCD_MCU_CAN_V1.4.1.dbc, ComBitPosition=50, ComBitSize=2, ComHandleId=25, ComSignalEndianness=LITTLE_ENDIAN, ComSignalInitValue=3, ComSignalType=UINT8, ComTimeout=0, ComTransferProperty=PENDING, ComFactorAndOffset=1;0
        PrkgFStAMT3_AMT3_FAW_MCD_MCU_CAN_V1_4_1_dbc_Rx: source-file=FAW_MCD_MCU_CAN_V1.4.1.dbc, ComBitPosition=52, ComBitSize=2, ComHandleId=26, ComSignalEndianness=LITTLE_ENDIAN, ComSignalInitValue=3, ComSignalType=UINT8, ComTimeout=0, ComTransferProperty=PENDING, ComFactorAndOffset=1;0
        ptobindingStAMT3_AMT3_FAW_MCD_MCU_CAN_V1_4_1_dbc_Rx: source-file=FAW_MCD_MCU_CAN_V1.4.1.dbc, ComBitPosition=54, ComBitSize=2, ComHandleId=27, ComSignalEndianness=LITTLE_ENDIAN, ComSignalInitValue=3, ComSignalType=UINT8, ComTimeout=0, ComTransferProperty=PENDING, ComFactorAndOffset=1;0
        theReqedMotoperatingmodeHCUMCU_HCUMCU_FAW_MCD_MCU_CAN_V1_4_1_dbc_Rx: source-file=FAW_MCD_MCU_CAN_V1.4.1.dbc, ComBitPosition=0, ComBitSize=2, ComFirstTimeout=0.5, ComHandleId=28, ComSignalEndianness=LITTLE_ENDIAN, ComSignalInitValue=0, ComSignalType=UINT8, ComTimeout=0.5, ComTimeoutNotification=Com_RxIpduTimeout_HCUMCU_D3_sO0, ComTransferProperty=PENDING, ComFactorAndOffset=1;0
        highprecisionMotTqReqedHCUMCU_HCUMCU_FAW_MCD_MCU_CAN_V1_4_1_dbc_Rx: source-file=FAW_MCD_MCU_CAN_V1.4.1.dbc, ComBitPosition=4, ComBitSize=4, ComHandleId=29, ComSignalEndianness=LITTLE_ENDIAN, ComSignalInitValue=15, ComSignalType=UINT8, ComTimeout=0, ComTransferProperty=PENDING, ComFactorAndOffset=1;0
        MotTqReqedHCUMCU_HCUMCU_FAW_MCD_MCU_CAN_V1_4_1_dbc_Rx: source-file=FAW_MCD_MCU_CAN_V1.4.1.dbc, ComBitPosition=8, ComBitSize=8, ComHandleId=30, ComSignalEndianness=LITTLE_ENDIAN, ComSignalInitValue=255, ComSignalType=UINT8, ComTimeout=0, ComTransferProperty=PENDING, ComFactorAndOffset=1;-125
        MotSpdReqedHCUMCU_HCUMCU_FAW_MCD_MCU_CAN_V1_4_1_dbc_Rx: source-file=FAW_MCD_MCU_CAN_V1.4.1.dbc, ComBitPosition=16, ComBitSize=16, ComHandleId=31, ComSignalEndianness=LITTLE_ENDIAN, ComSignalInitValue=0, ComSignalType=UINT16, ComTimeout=0, ComTransferProperty=PENDING, ComFactorAndOffset=0.5;0
        MotworkEnaCmdHCUMCU_HCUMCU_FAW_MCD_MCU_CAN_V1_4_1_dbc_Rx: source-file=FAW_MCD_MCU_CAN_V1.4.1.dbc, ComBitPosition=32, ComBitSize=2, ComHandleId=32, ComSignalEndianness=LITTLE_ENDIAN, ComSignalInitValue=0, ComSignalType=UINT8, ComTimeout=0, ComTransferProperty=PENDING, ComFactorAndOffset=1;0
        MotNeghighURlyCmdHCUMCU_HCUMCU_FAW_MCD_MCU_CAN_V1_4_1_dbc_Rx: source-file=FAW_MCD_MCU_CAN_V1.4.1.dbc, ComBitPosition=34, ComBitSize=2, ComHandleId=33, ComSignalEndianness=LITTLE_ENDIAN, ComSignalInitValue=0, ComSignalType=UINT8, ComTimeout=0, ComTransferProperty=PENDING, ComFactorAndOffset=1;0
        MotPoshighURlyCmdHCUMCU_HCUMCU_FAW_MCD_MCU_CAN_V1_4_1_dbc_Rx: source-file=FAW_MCD_MCU_CAN_V1.4.1.dbc, ComBitPosition=36, ComBitSize=2, ComHandleId=34, ComSignalEndianness=LITTLE_ENDIAN, ComSignalInitValue=0, ComSignalType=UINT8, ComTimeout=0, ComTransferProperty=PENDING, ComFactorAndOffset=1;0
        MotpreChrghighURlyCmdHCUMCU_HCUMCU_FAW_MCD_MCU_CAN_V1_4_1_dbc_Rx: source-file=FAW_MCD_MCU_CAN_V1.4.1.dbc, ComBitPosition=38, ComBitSize=2, ComHandleId=35, ComSignalEndianness=LITTLE_ENDIAN, ComSignalInitValue=0, ComSignalType=UINT8, ComTimeout=0, ComTransferProperty=PENDING, ComFactorAndOffset=1;0
        highUPwroffReqofMotHCUMCU_HCUMCU_FAW_MCD_MCU_CAN_V1_4_1_dbc_Rx: source-file=FAW_MCD_MCU_CAN_V1.4.1.dbc, ComBitPosition=40, ComBitSize=2, ComHandleId=36, ComSignalEndianness=LITTLE_ENDIAN, ComSignalInitValue=0, ComSignalType=UINT8, ComTimeout=0, ComTransferProperty=PENDING, ComFactorAndOffset=1;0
        MotActvdisChrgCmdHCUMCU_HCUMCU_FAW_MCD_MCU_CAN_V1_4_1_dbc_Rx: source-file=FAW_MCD_MCU_CAN_V1.4.1.dbc, ComBitPosition=42, ComBitSize=2, ComHandleId=37, ComSignalEndianness=LITTLE_ENDIAN, ComSignalInitValue=0, ComSignalType=UINT8, ComTimeout=0, ComTransferProperty=PENDING, ComFactorAndOffset=1;0
        MaxSpdLimUnderCurloadHCUMCU_HCUMCU_FAW_MCD_MCU_CAN_V1_4_1_dbc_Rx: source-file=FAW_MCD_MCU_CAN_V1.4.1.dbc, ComBitPosition=48, ComBitSize=16, ComHandleId=38, ComSignalEndianness=LITTLE_ENDIAN, ComSignalInitValue=65535, ComSignalType=UINT16, ComTimeout=0, ComTransferProperty=PENDING, ComFactorAndOffset=0.5;0
        theReqedMotoperatingmodeHCUMCU2_HCUMCU2_FAW_MCD_MCU_CAN_V1_4_1_dbc_Rx: source-file=FAW_MCD_MCU_CAN_V1.4.1.dbc, ComBitPosition=0, ComBitSize=2, ComFirstTimeout=0.5, ComHandleId=39, ComSignalEndianness=LITTLE_ENDIAN, ComSignalInitValue=0, ComSignalType=UINT8, ComTimeout=0.5, ComTimeoutNotification=Com_RxIpduTimeout_HCUMCU2_D3_sO0, ComTransferProperty=PENDING, ComFactorAndOffset=1;0
        highprecisionMotTqReqedHCUMCU2_HCUMCU2_FAW_MCD_MCU_CAN_V1_4_1_dbc_Rx: source-file=FAW_MCD_MCU_CAN_V1.4.1.dbc, ComBitPosition=4, ComBitSize=4, ComHandleId=40, ComSignalEndianness=LITTLE_ENDIAN, ComSignalInitValue=15, ComSignalType=UINT8, ComTimeout=0, ComTransferProperty=PENDING, ComFactorAndOffset=1;0
        MotTqReqedHCUMCU2_HCUMCU2_FAW_MCD_MCU_CAN_V1_4_1_dbc_Rx: source-file=FAW_MCD_MCU_CAN_V1.4.1.dbc, ComBitPosition=8, ComBitSize=8, ComHandleId=41, ComSignalEndianness=LITTLE_ENDIAN, ComSignalInitValue=255, ComSignalType=UINT8, ComTimeout=0, ComTransferProperty=PENDING, ComFactorAndOffset=1;-125
        MotSpdReqedHCUMCU2_HCUMCU2_FAW_MCD_MCU_CAN_V1_4_1_dbc_Rx: source-file=FAW_MCD_MCU_CAN_V1.4.1.dbc, ComBitPosition=16, ComBitSize=16, ComHandleId=42, ComSignalEndianness=LITTLE_ENDIAN, ComSignalInitValue=0, ComSignalType=UINT16, ComTimeout=0, ComTransferProperty=PENDING, ComFactorAndOffset=0.5;0
        MotworkEnaCmdHCUMCU2_HCUMCU2_FAW_MCD_MCU_CAN_V1_4_1_dbc_Rx: source-file=FAW_MCD_MCU_CAN_V1.4.1.dbc, ComBitPosition=32, ComBitSize=2, ComHandleId=43, ComSignalEndianness=LITTLE_ENDIAN, ComSignalInitValue=0, ComSignalType=UINT8, ComTimeout=0, ComTransferProperty=PENDING, ComFactorAndOffset=1;0
        MotNeghighURlyCmdHCUMCU2_HCUMCU2_FAW_MCD_MCU_CAN_V1_4_1_dbc_Rx: source-file=FAW_MCD_MCU_CAN_V1.4.1.dbc, ComBitPosition=34, ComBitSize=2, ComHandleId=44, ComSignalEndianness=LITTLE_ENDIAN, ComSignalInitValue=0, ComSignalType=UINT8, ComTimeout=0, ComTransferProperty=PENDING, ComFactorAndOffset=1;0
        MotPoshighURlyCmdHCUMCU2_HCUMCU2_FAW_MCD_MCU_CAN_V1_4_1_dbc_Rx: source-file=FAW_MCD_MCU_CAN_V1.4.1.dbc, ComBitPosition=36, ComBitSize=2, ComHandleId=45, ComSignalEndianness=LITTLE_ENDIAN, ComSignalInitValue=0, ComSignalType=UINT8, ComTimeout=0, ComTransferProperty=PENDING, ComFactorAndOffset=1;0
        MotpreChrghighURlyCmdHCUMCU2_HCUMCU2_FAW_MCD_MCU_CAN_V1_4_1_dbc_Rx: source-file=FAW_MCD_MCU_CAN_V1.4.1.dbc, ComBitPosition=38, ComBitSize=2, ComHandleId=46, ComSignalEndianness=LITTLE_ENDIAN, ComSignalInitValue=0, ComSignalType=UINT8, ComTimeout=0, ComTransferProperty=PENDING, ComFactorAndOffset=1;0
        highUPwroffReqofMotHCUMCU2_HCUMCU2_FAW_MCD_MCU_CAN_V1_4_1_dbc_Rx: source-file=FAW_MCD_MCU_CAN_V1.4.1.dbc, ComBitPosition=40, ComBitSize=2, ComHandleId=47, ComSignalEndianness=LITTLE_ENDIAN, ComSignalInitValue=0, ComSignalType=UINT8, ComTimeout=0, ComTransferProperty=PENDING, ComFactorAndOffset=1;0
        MotActvdisChrgCmdHCUMCU2_HCUMCU2_FAW_MCD_MCU_CAN_V1_4_1_dbc_Rx: source-file=FAW_MCD_MCU_CAN_V1.4.1.dbc, ComBitPosition=42, ComBitSize=2, ComHandleId=48, ComSignalEndianness=LITTLE_ENDIAN, ComSignalInitValue=0, ComSignalType=UINT8, ComTimeout=0, ComTransferProperty=PENDING, ComFactorAndOffset=1;0
        MaxSpdLimUnderCurloadHCUMCU2_HCUMCU2_FAW_MCD_MCU_CAN_V1_4_1_dbc_Rx: source-file=FAW_MCD_MCU_CAN_V1.4.1.dbc, ComBitPosition=48, ComBitSize=16, ComHandleId=49, ComSignalEndianness=LITTLE_ENDIAN, ComSignalInitValue=65535, ComSignalType=UINT16, ComTimeout=0, ComTransferProperty=PENDING, ComFactorAndOffset=0.5;0
        ptoSwtCmdSC_SC_FAW_MCD_MCU_CAN_V1_4_1_dbc_Rx: source-file=FAW_MCD_MCU_CAN_V1.4.1.dbc, ComBitPosition=4, ComBitSize=2, ComFirstTimeout=1, ComHandleId=50, ComSignalEndianness=LITTLE_ENDIAN, ComSignalInitValue=0, ComSignalType=UINT8, ComTimeout=1, ComTimeoutNotification=Com_RxIpduTimeout_SC_D3_sO0, ComTransferProperty=PENDING, ComFactorAndOffset=1;0
        OvrdCtrlmodeTSC1Mtr2_TSC1Mtr2_FAW_MCD_MCU_CAN_V1_4_1_dbc_Rx: source-file=FAW_MCD_MCU_CAN_V1.4.1.dbc, ComBitPosition=0, ComBitSize=2, ComFirstTimeout=0.5, ComHandleId=51, ComSignalEndianness=LITTLE_ENDIAN, ComSignalInitValue=0, ComSignalType=UINT8, ComTimeout=0.5, ComTimeoutNotification=Com_RxIpduTimeout_TSC1Mtr2_D3_sO0, ComTransferProperty=PENDING, ComFactorAndOffset=1;0
        ReqedSpdCtrlCdnsTSC1Mtr2_TSC1Mtr2_FAW_MCD_MCU_CAN_V1_4_1_dbc_Rx: source-file=FAW_MCD_MCU_CAN_V1.4.1.dbc, ComBitPosition=2, ComBitSize=2, ComHandleId=52, ComSignalEndianness=LITTLE_ENDIAN, ComSignalInitValue=0, ComSignalType=UINT8, ComTimeout=0, ComTransferProperty=PENDING, ComFactorAndOffset=1;0
        OvrdCtrlmodePrioTSC1Mtr2_TSC1Mtr2_FAW_MCD_MCU_CAN_V1_4_1_dbc_Rx: source-file=FAW_MCD_MCU_CAN_V1.4.1.dbc, ComBitPosition=4, ComBitSize=2, ComHandleId=53, ComSignalEndianness=LITTLE_ENDIAN, ComSignalInitValue=3, ComSignalType=UINT8, ComTimeout=0, ComTransferProperty=PENDING, ComFactorAndOffset=1;0
        ReqedSpdSpdLimTSC1Mtr2_TSC1Mtr2_FAW_MCD_MCU_CAN_V1_4_1_dbc_Rx: source-file=FAW_MCD_MCU_CAN_V1.4.1.dbc, ComBitPosition=8, ComBitSize=16, ComHandleId=54, ComSignalEndianness=LITTLE_ENDIAN, ComSignalInitValue=0, ComSignalType=UINT16, ComTimeout=0, ComTransferProperty=PENDING, ComFactorAndOffset=0.5;0
        ReqedTqTqLimTSC1Mtr2_TSC1Mtr2_FAW_MCD_MCU_CAN_V1_4_1_dbc_Rx: source-file=FAW_MCD_MCU_CAN_V1.4.1.dbc, ComBitPosition=24, ComBitSize=8, ComHandleId=55, ComSignalEndianness=LITTLE_ENDIAN, ComSignalInitValue=125, ComSignalType=UINT8, ComTimeout=0, ComTransferProperty=PENDING, ComFactorAndOffset=1;-125
        ReqedTqfrActnalTSC1Mtr2_TSC1Mtr2_FAW_MCD_MCU_CAN_V1_4_1_dbc_Rx: source-file=FAW_MCD_MCU_CAN_V1.4.1.dbc, ComBitPosition=40, ComBitSize=4, ComHandleId=56, ComSignalEndianness=LITTLE_ENDIAN, ComSignalInitValue=15, ComSignalType=UINT8, ComTimeout=0, ComTransferProperty=PENDING, ComFactorAndOffset=1;0
        MsgCnterTSC1Mtr2_TSC1Mtr2_FAW_MCD_MCU_CAN_V1_4_1_dbc_Rx: source-file=FAW_MCD_MCU_CAN_V1.4.1.dbc, ComBitPosition=56, ComBitSize=4, ComHandleId=57, ComSignalEndianness=LITTLE_ENDIAN, ComSignalInitValue=0, ComSignalType=UINT8, ComTimeout=0, ComTransferProperty=PENDING, ComFactorAndOffset=1;0
        MsgChksumTSC1Mtr2_TSC1Mtr2_FAW_MCD_MCU_CAN_V1_4_1_dbc_Rx: source-file=FAW_MCD_MCU_CAN_V1.4.1.dbc, ComBitPosition=60, ComBitSize=4, ComHandleId=58, ComSignalEndianness=LITTLE_ENDIAN, ComSignalInitValue=0, ComSignalType=UINT8, ComTimeout=0, ComTransferProperty=PENDING, ComFactorAndOffset=1;0
        DCDC_VouSet_DCDC_Cmd1_CAN_Matrix_DCDC_V0_1_20250414_dbc_Tx: source-file=CAN_Matrix-DCDC-V0.1_20250414.dbc, ComBitPosition=8, ComBitSize=16, ComHandleId=71, ComSignalEndianness=BIG_ENDIAN, ComSignalInitValue=0, ComSignalType=UINT16, ComTimeout=0, ComTransferProperty=PENDING, ComFactorAndOffset=0.05;0
        DCDC_CouSet_DCDC_Cmd1_CAN_Matrix_DCDC_V0_1_20250414_dbc_Tx: source-file=CAN_Matrix-DCDC-V0.1_20250414.dbc, ComBitPosition=24, ComBitSize=12, ComHandleId=72, ComSignalEndianness=BIG_ENDIAN, ComSignalInitValue=0, ComSignalType=UINT16, ComTimeout=0, ComTransferProperty=PENDING, ComFactorAndOffset=0.1;0
        DCDC_Mode_DCDC_Cmd1_CAN_Matrix_DCDC_V0_1_20250414_dbc_Tx: source-file=CAN_Matrix-DCDC-V0.1_20250414.dbc, ComBitPosition=20, ComBitSize=2, ComHandleId=73, ComSignalEndianness=BIG_ENDIAN, ComSignalInitValue=0, ComSignalType=UINT8, ComTimeout=0, ComTransferProperty=PENDING, ComFactorAndOffset=1;0
        DCDC_Enable_DCDC_Cmd1_CAN_Matrix_DCDC_V0_1_20250414_dbc_Tx: source-file=CAN_Matrix-DCDC-V0.1_20250414.dbc, ComBitPosition=22, ComBitSize=1, ComHandleId=74, ComSignalEndianness=BIG_ENDIAN, ComSignalInitValue=0, ComSignalType=BOOLEAN, ComTimeout=0, ComTransferProperty=PENDING, ComFactorAndOffset=1;0
        DCDC_Sleep_DCDC_Cmd1_CAN_Matrix_DCDC_V0_1_20250414_dbc_Tx: source-file=CAN_Matrix-DCDC-V0.1_20250414.dbc, ComBitPosition=23, ComBitSize=1, ComHandleId=75, ComSignalEndianness=BIG_ENDIAN, ComSignalInitValue=0, ComSignalType=BOOLEAN, ComTimeout=0, ComTransferProperty=PENDING, ComFactorAndOffset=1;0
        DCDC_Precharge_DCDC_Cmd1_CAN_Matrix_DCDC_V0_1_20250414_dbc_Tx: source-file=CAN_Matrix-DCDC-V0.1_20250414.dbc, ComBitPosition=32, ComBitSize=2, ComHandleId=76, ComSignalEndianness=BIG_ENDIAN, ComSignalInitValue=0, ComSignalType=UINT8, ComTimeout=0, ComTransferProperty=PENDING, ComFactorAndOffset=1;0
        DCDC_Fault_Clear_DCDC_Cmd1_CAN_Matrix_DCDC_V0_1_20250414_dbc_Tx: source-file=CAN_Matrix-DCDC-V0.1_20250414.dbc, ComBitPosition=34, ComBitSize=1, ComHandleId=77, ComSignalEndianness=BIG_ENDIAN, ComSignalInitValue=0, ComSignalType=BOOLEAN, ComTimeout=0, ComTransferProperty=PENDING, ComFactorAndOffset=1;0
        DCDC_Dir_DCDC_Cmd1_CAN_Matrix_DCDC_V0_1_20250414_dbc_Tx: source-file=CAN_Matrix-DCDC-V0.1_20250414.dbc, ComBitPosition=39, ComBitSize=1, ComHandleId=78, ComSignalEndianness=BIG_ENDIAN, ComSignalInitValue=0, ComSignalType=BOOLEAN, ComTimeout=0, ComTransferProperty=PENDING, ComFactorAndOffset=1;0
        DCDC_Dir_Check_DCDC_Cmd1_CAN_Matrix_DCDC_V0_1_20250414_dbc_Tx: source-file=CAN_Matrix-DCDC-V0.1_20250414.dbc, ComBitPosition=55, ComBitSize=1, ComHandleId=79, ComSignalEndianness=BIG_ENDIAN, ComSignalInitValue=0, ComSignalType=BOOLEAN, ComTimeout=0, ComTransferProperty=PENDING, ComFactorAndOffset=1;0
        DCDC_Counter_DCDC_Cmd1_CAN_Matrix_DCDC_V0_1_20250414_dbc_Tx: source-file=CAN_Matrix-DCDC-V0.1_20250414.dbc, ComBitPosition=48, ComBitSize=4, ComHandleId=80, ComSignalEndianness=BIG_ENDIAN, ComSignalInitValue=0, ComSignalType=UINT8, ComTimeout=0, ComTransferProperty=PENDING, ComFactorAndOffset=1;0
        DCDC_Checksum_DCDC_Cmd1_CAN_Matrix_DCDC_V0_1_20250414_dbc_Tx: source-file=CAN_Matrix-DCDC-V0.1_20250414.dbc, ComBitPosition=56, ComBitSize=8, ComHandleId=81, ComSignalEndianness=BIG_ENDIAN, ComSignalInitValue=0, ComSignalType=UINT8, ComTimeout=0, ComTransferProperty=PENDING, ComFactorAndOffset=1;0
        DCDC_VIn_DCDC_Status1_CAN_Matrix_DCDC_V0_1_20250414_dbc_Rx: source-file=CAN_Matrix-DCDC-V0.1_20250414.dbc, ComBitPosition=14, ComBitSize=10, ComFirstTimeout=0.5, ComHandleId=59, ComSignalEndianness=BIG_ENDIAN, ComSignalInitValue=0, ComSignalType=UINT16, ComTimeout=0.5, ComTimeoutNotification=Com_RxIpduTimeout_DCDC_Status1_VR82BV, ComTransferProperty=PENDING, ComFactorAndOffset=1;0
        DCDC_Vout_DCDC_Status1_CAN_Matrix_DCDC_V0_1_20250414_dbc_Rx: source-file=CAN_Matrix-DCDC-V0.1_20250414.dbc, ComBitPosition=40, ComBitSize=12, ComHandleId=60, ComSignalEndianness=BIG_ENDIAN, ComSignalInitValue=0, ComSignalType=UINT16, ComTimeout=0, ComTransferProperty=PENDING, ComFactorAndOffset=0.05;0
        DCDC_Cout_DCDC_Status1_CAN_Matrix_DCDC_V0_1_20250414_dbc_Rx: source-file=CAN_Matrix-DCDC-V0.1_20250414.dbc, ComBitPosition=36, ComBitSize=12, ComHandleId=61, ComSignalEndianness=BIG_ENDIAN, ComSignalInitValue=0, ComSignalType=UINT16, ComTimeout=0, ComTransferProperty=PENDING, ComFactorAndOffset=0.1;0
        DCDC_ModeFB_DCDC_Status1_CAN_Matrix_DCDC_V0_1_20250414_dbc_Rx: source-file=CAN_Matrix-DCDC-V0.1_20250414.dbc, ComBitPosition=21, ComBitSize=2, ComHandleId=62, ComSignalEndianness=BIG_ENDIAN, ComSignalInitValue=0, ComSignalType=UINT8, ComTimeout=0, ComTransferProperty=PENDING, ComFactorAndOffset=1;0
        DCDC_DirFB_DCDC_Status1_CAN_Matrix_DCDC_V0_1_20250414_dbc_Rx: source-file=CAN_Matrix-DCDC-V0.1_20250414.dbc, ComBitPosition=20, ComBitSize=1, ComHandleId=63, ComSignalEndianness=BIG_ENDIAN, ComSignalInitValue=0, ComSignalType=BOOLEAN, ComTimeout=0, ComTransferProperty=PENDING, ComFactorAndOffset=1;0
        DCDC_Cmdsrc_DCDC_Status1_CAN_Matrix_DCDC_V0_1_20250414_dbc_Rx: source-file=CAN_Matrix-DCDC-V0.1_20250414.dbc, ComBitPosition=19, ComBitSize=1, ComHandleId=64, ComSignalEndianness=BIG_ENDIAN, ComSignalInitValue=0, ComSignalType=BOOLEAN, ComTimeout=0, ComTransferProperty=PENDING, ComFactorAndOffset=1;0
        DCDC_Faultlevel_DCDC_Status1_CAN_Matrix_DCDC_V0_1_20250414_dbc_Rx: source-file=CAN_Matrix-DCDC-V0.1_20250414.dbc, ComBitPosition=16, ComBitSize=3, ComHandleId=65, ComSignalEndianness=BIG_ENDIAN, ComSignalInitValue=0, ComSignalType=UINT8, ComTimeout=0, ComTransferProperty=PENDING, ComFactorAndOffset=1;0
        DCDC_State_DCDC_Status1_CAN_Matrix_DCDC_V0_1_20250414_dbc_Rx: source-file=CAN_Matrix-DCDC-V0.1_20250414.dbc, ComBitPosition=52, ComBitSize=4, ComHandleId=66, ComSignalEndianness=BIG_ENDIAN, ComSignalInitValue=0, ComSignalType=UINT8, ComTimeout=0, ComTransferProperty=PENDING, ComFactorAndOffset=1;0
        DCDC_Counter1_DCDC_Status1_CAN_Matrix_DCDC_V0_1_20250414_dbc_Rx: source-file=CAN_Matrix-DCDC-V0.1_20250414.dbc, ComBitPosition=48, ComBitSize=4, ComHandleId=67, ComSignalEndianness=BIG_ENDIAN, ComSignalInitValue=0, ComSignalType=UINT8, ComTimeout=0, ComTransferProperty=PENDING, ComFactorAndOffset=1;0
        DCDC_Checksum1_DCDC_Status1_CAN_Matrix_DCDC_V0_1_20250414_dbc_Rx: source-file=CAN_Matrix-DCDC-V0.1_20250414.dbc, ComBitPosition=56, ComBitSize=8, ComHandleId=68, ComSignalEndianness=BIG_ENDIAN, ComSignalInitValue=0, ComSignalType=UINT8, ComTimeout=0, ComTransferProperty=PENDING, ComFactorAndOffset=1;0
        DCDC_CoutLimit_DCDC_Status2_CAN_Matrix_DCDC_V0_1_20250414_dbc_Rx: source-file=CAN_Matrix-DCDC-V0.1_20250414.dbc, ComBitPosition=14, ComBitSize=10, ComFirstTimeout=0.5, ComHandleId=69, ComSignalEndianness=BIG_ENDIAN, ComSignalInitValue=0, ComSignalType=UINT16, ComTimeout=0.5, ComTimeoutNotification=Com_RxIpduTimeout_DCDC_Status2_VR82BV, ComTransferProperty=PENDING, ComFactorAndOffset=0.5;0
        DCDC_Vin_OV_level1_DCDC_Status2_CAN_Matrix_DCDC_V0_1_20250414_dbc_Rx: source-file=CAN_Matrix-DCDC-V0.1_20250414.dbc, ComBitPosition=8, ComBitSize=1, ComHandleId=70, ComSignalEndianness=BIG_ENDIAN, ComSignalInitValue=0, ComSignalType=BOOLEAN, ComTimeout=0, ComTransferProperty=PENDING, ComFactorAndOffset=1;0
        DCDC_Vin_OV_level3_DCDC_Status2_CAN_Matrix_DCDC_V0_1_20250414_dbc_Rx: source-file=CAN_Matrix-DCDC-V0.1_20250414.dbc, ComBitPosition=9, ComBitSize=1, ComHandleId=71, ComSignalEndianness=BIG_ENDIAN, ComSignalInitValue=0, ComSignalType=BOOLEAN, ComTimeout=0, ComTransferProperty=PENDING, ComFactorAndOffset=1;0
        DCDC_Vin_OV_level4_DCDC_Status2_CAN_Matrix_DCDC_V0_1_20250414_dbc_Rx: source-file=CAN_Matrix-DCDC-V0.1_20250414.dbc, ComBitPosition=10, ComBitSize=1, ComHandleId=72, ComSignalEndianness=BIG_ENDIAN, ComSignalInitValue=0, ComSignalType=BOOLEAN, ComTimeout=0, ComTransferProperty=PENDING, ComFactorAndOffset=1;0
        DCDC_Vin_UV_level1_DCDC_Status2_CAN_Matrix_DCDC_V0_1_20250414_dbc_Rx: source-file=CAN_Matrix-DCDC-V0.1_20250414.dbc, ComBitPosition=11, ComBitSize=1, ComHandleId=73, ComSignalEndianness=BIG_ENDIAN, ComSignalInitValue=0, ComSignalType=BOOLEAN, ComTimeout=0, ComTransferProperty=PENDING, ComFactorAndOffset=1;0
        DCDC_Vin_UV_level3_DCDC_Status2_CAN_Matrix_DCDC_V0_1_20250414_dbc_Rx: source-file=CAN_Matrix-DCDC-V0.1_20250414.dbc, ComBitPosition=12, ComBitSize=1, ComHandleId=74, ComSignalEndianness=BIG_ENDIAN, ComSignalInitValue=0, ComSignalType=BOOLEAN, ComTimeout=0, ComTransferProperty=PENDING, ComFactorAndOffset=1;0
        DCDC_Vin_UV_level4_DCDC_Status2_CAN_Matrix_DCDC_V0_1_20250414_dbc_Rx: source-file=CAN_Matrix-DCDC-V0.1_20250414.dbc, ComBitPosition=13, ComBitSize=1, ComHandleId=75, ComSignalEndianness=BIG_ENDIAN, ComSignalInitValue=0, ComSignalType=BOOLEAN, ComTimeout=0, ComTransferProperty=PENDING, ComFactorAndOffset=1;0
        DCDC_Vout_OV_level1_DCDC_Status2_CAN_Matrix_DCDC_V0_1_20250414_dbc_Rx: source-file=CAN_Matrix-DCDC-V0.1_20250414.dbc, ComBitPosition=16, ComBitSize=1, ComHandleId=76, ComSignalEndianness=BIG_ENDIAN, ComSignalInitValue=0, ComSignalType=BOOLEAN, ComTimeout=0, ComTransferProperty=PENDING, ComFactorAndOffset=1;0
        DCDC_Vout_OV_level3_DCDC_Status2_CAN_Matrix_DCDC_V0_1_20250414_dbc_Rx: source-file=CAN_Matrix-DCDC-V0.1_20250414.dbc, ComBitPosition=17, ComBitSize=1, ComHandleId=77, ComSignalEndianness=BIG_ENDIAN, ComSignalInitValue=0, ComSignalType=BOOLEAN, ComTimeout=0, ComTransferProperty=PENDING, ComFactorAndOffset=1;0
        DCDC_Vout_OV_level4_DCDC_Status2_CAN_Matrix_DCDC_V0_1_20250414_dbc_Rx: source-file=CAN_Matrix-DCDC-V0.1_20250414.dbc, ComBitPosition=18, ComBitSize=1, ComHandleId=78, ComSignalEndianness=BIG_ENDIAN, ComSignalInitValue=0, ComSignalType=BOOLEAN, ComTimeout=0, ComTransferProperty=PENDING, ComFactorAndOffset=1;0
        DCDC_Vout_UV_level1_DCDC_Status2_CAN_Matrix_DCDC_V0_1_20250414_dbc_Rx: source-file=CAN_Matrix-DCDC-V0.1_20250414.dbc, ComBitPosition=19, ComBitSize=1, ComHandleId=79, ComSignalEndianness=BIG_ENDIAN, ComSignalInitValue=0, ComSignalType=BOOLEAN, ComTimeout=0, ComTransferProperty=PENDING, ComFactorAndOffset=1;0
        DCDC_Vout_UV_level3_DCDC_Status2_CAN_Matrix_DCDC_V0_1_20250414_dbc_Rx: source-file=CAN_Matrix-DCDC-V0.1_20250414.dbc, ComBitPosition=20, ComBitSize=1, ComHandleId=80, ComSignalEndianness=BIG_ENDIAN, ComSignalInitValue=0, ComSignalType=BOOLEAN, ComTimeout=0, ComTransferProperty=PENDING, ComFactorAndOffset=1;0
        DCDC_Vout_UV_level4_DCDC_Status2_CAN_Matrix_DCDC_V0_1_20250414_dbc_Rx: source-file=CAN_Matrix-DCDC-V0.1_20250414.dbc, ComBitPosition=21, ComBitSize=1, ComHandleId=81, ComSignalEndianness=BIG_ENDIAN, ComSignalInitValue=0, ComSignalType=BOOLEAN, ComTimeout=0, ComTransferProperty=PENDING, ComFactorAndOffset=1;0
        DCDC_Cout_OC_level1_DCDC_Status2_CAN_Matrix_DCDC_V0_1_20250414_dbc_Rx: source-file=CAN_Matrix-DCDC-V0.1_20250414.dbc, ComBitPosition=22, ComBitSize=1, ComHandleId=82, ComSignalEndianness=BIG_ENDIAN, ComSignalInitValue=0, ComSignalType=BOOLEAN, ComTimeout=0, ComTransferProperty=PENDING, ComFactorAndOffset=1;0
        DCDC_Cout_OC_level2_DCDC_Status2_CAN_Matrix_DCDC_V0_1_20250414_dbc_Rx: source-file=CAN_Matrix-DCDC-V0.1_20250414.dbc, ComBitPosition=23, ComBitSize=1, ComHandleId=83, ComSignalEndianness=BIG_ENDIAN, ComSignalInitValue=0, ComSignalType=BOOLEAN, ComTimeout=0, ComTransferProperty=PENDING, ComFactorAndOffset=1;0
        DCDC_Cout_OC_level3_DCDC_Status2_CAN_Matrix_DCDC_V0_1_20250414_dbc_Rx: source-file=CAN_Matrix-DCDC-V0.1_20250414.dbc, ComBitPosition=24, ComBitSize=1, ComHandleId=84, ComSignalEndianness=BIG_ENDIAN, ComSignalInitValue=0, ComSignalType=BOOLEAN, ComTimeout=0, ComTransferProperty=PENDING, ComFactorAndOffset=1;0
        DCDC_Cout_OC_level4_DCDC_Status2_CAN_Matrix_DCDC_V0_1_20250414_dbc_Rx: source-file=CAN_Matrix-DCDC-V0.1_20250414.dbc, ComBitPosition=25, ComBitSize=1, ComHandleId=85, ComSignalEndianness=BIG_ENDIAN, ComSignalInitValue=0, ComSignalType=BOOLEAN, ComTimeout=0, ComTransferProperty=PENDING, ComFactorAndOffset=1;0
        DCDC_Out_SC_level1_DCDC_Status2_CAN_Matrix_DCDC_V0_1_20250414_dbc_Rx: source-file=CAN_Matrix-DCDC-V0.1_20250414.dbc, ComBitPosition=26, ComBitSize=1, ComHandleId=86, ComSignalEndianness=BIG_ENDIAN, ComSignalInitValue=0, ComSignalType=BOOLEAN, ComTimeout=0, ComTransferProperty=PENDING, ComFactorAndOffset=1;0
        DCDC_Out_SC_level2_DCDC_Status2_CAN_Matrix_DCDC_V0_1_20250414_dbc_Rx: source-file=CAN_Matrix-DCDC-V0.1_20250414.dbc, ComBitPosition=27, ComBitSize=1, ComHandleId=87, ComSignalEndianness=BIG_ENDIAN, ComSignalInitValue=0, ComSignalType=BOOLEAN, ComTimeout=0, ComTransferProperty=PENDING, ComFactorAndOffset=1;0
        DCDC_PSFB_OT_level1_DCDC_Status2_CAN_Matrix_DCDC_V0_1_20250414_dbc_Rx: source-file=CAN_Matrix-DCDC-V0.1_20250414.dbc, ComBitPosition=28, ComBitSize=1, ComHandleId=88, ComSignalEndianness=BIG_ENDIAN, ComSignalInitValue=0, ComSignalType=BOOLEAN, ComTimeout=0, ComTransferProperty=PENDING, ComFactorAndOffset=1;0
        DCDC_PSFB_OT_level3_DCDC_Status2_CAN_Matrix_DCDC_V0_1_20250414_dbc_Rx: source-file=CAN_Matrix-DCDC-V0.1_20250414.dbc, ComBitPosition=29, ComBitSize=1, ComHandleId=89, ComSignalEndianness=BIG_ENDIAN, ComSignalInitValue=0, ComSignalType=BOOLEAN, ComTimeout=0, ComTransferProperty=PENDING, ComFactorAndOffset=1;0
        DCDC_PSFB_OT_level4_DCDC_Status2_CAN_Matrix_DCDC_V0_1_20250414_dbc_Rx: source-file=CAN_Matrix-DCDC-V0.1_20250414.dbc, ComBitPosition=30, ComBitSize=1, ComHandleId=90, ComSignalEndianness=BIG_ENDIAN, ComSignalInitValue=0, ComSignalType=BOOLEAN, ComTimeout=0, ComTransferProperty=PENDING, ComFactorAndOffset=1;0
        DCDC_SR_OT_level1_DCDC_Status2_CAN_Matrix_DCDC_V0_1_20250414_dbc_Rx: source-file=CAN_Matrix-DCDC-V0.1_20250414.dbc, ComBitPosition=31, ComBitSize=1, ComHandleId=91, ComSignalEndianness=BIG_ENDIAN, ComSignalInitValue=0, ComSignalType=BOOLEAN, ComTimeout=0, ComTransferProperty=PENDING, ComFactorAndOffset=1;0
        DCDC_SR_OT_level3_DCDC_Status2_CAN_Matrix_DCDC_V0_1_20250414_dbc_Rx: source-file=CAN_Matrix-DCDC-V0.1_20250414.dbc, ComBitPosition=32, ComBitSize=1, ComHandleId=92, ComSignalEndianness=BIG_ENDIAN, ComSignalInitValue=0, ComSignalType=BOOLEAN, ComTimeout=0, ComTransferProperty=PENDING, ComFactorAndOffset=1;0
        DCDC_SR_OT_level4_DCDC_Status2_CAN_Matrix_DCDC_V0_1_20250414_dbc_Rx: source-file=CAN_Matrix-DCDC-V0.1_20250414.dbc, ComBitPosition=33, ComBitSize=1, ComHandleId=93, ComSignalEndianness=BIG_ENDIAN, ComSignalInitValue=0, ComSignalType=BOOLEAN, ComTimeout=0, ComTransferProperty=PENDING, ComFactorAndOffset=1;0
        DCDC_OC_PSFB_level2_DCDC_Status2_CAN_Matrix_DCDC_V0_1_20250414_dbc_Rx: source-file=CAN_Matrix-DCDC-V0.1_20250414.dbc, ComBitPosition=34, ComBitSize=1, ComHandleId=94, ComSignalEndianness=BIG_ENDIAN, ComSignalInitValue=0, ComSignalType=BOOLEAN, ComTimeout=0, ComTransferProperty=PENDING, ComFactorAndOffset=1;0
        DCDC_OC_BoostSub1_level2_DCDC_Status2_CAN_Matrix_DCDC_V0_1_20250414_dbc_Rx: source-file=CAN_Matrix-DCDC-V0.1_20250414.dbc, ComBitPosition=35, ComBitSize=1, ComHandleId=95, ComSignalEndianness=BIG_ENDIAN, ComSignalInitValue=0, ComSignalType=BOOLEAN, ComTimeout=0, ComTransferProperty=PENDING, ComFactorAndOffset=1;0
        DCDC_OC_BoostSub2_level2_DCDC_Status2_CAN_Matrix_DCDC_V0_1_20250414_dbc_Rx: source-file=CAN_Matrix-DCDC-V0.1_20250414.dbc, ComBitPosition=36, ComBitSize=1, ComHandleId=96, ComSignalEndianness=BIG_ENDIAN, ComSignalInitValue=0, ComSignalType=BOOLEAN, ComTimeout=0, ComTransferProperty=PENDING, ComFactorAndOffset=1;0
        DCDC_CAN_Timeout_DCDC_Status2_CAN_Matrix_DCDC_V0_1_20250414_dbc_Rx: source-file=CAN_Matrix-DCDC-V0.1_20250414.dbc, ComBitPosition=37, ComBitSize=1, ComHandleId=97, ComSignalEndianness=BIG_ENDIAN, ComSignalInitValue=0, ComSignalType=BOOLEAN, ComTimeout=0, ComTransferProperty=PENDING, ComFactorAndOffset=1;0
        DCDC_CAN_E2E_DCDC_Status2_CAN_Matrix_DCDC_V0_1_20250414_dbc_Rx: source-file=CAN_Matrix-DCDC-V0.1_20250414.dbc, ComBitPosition=38, ComBitSize=1, ComHandleId=98, ComSignalEndianness=BIG_ENDIAN, ComSignalInitValue=0, ComSignalType=BOOLEAN, ComTimeout=0, ComTransferProperty=PENDING, ComFactorAndOffset=1;0
        DCDC_Initial_Failure_DCDC_Status2_CAN_Matrix_DCDC_V0_1_20250414_dbc_Rx: source-file=CAN_Matrix-DCDC-V0.1_20250414.dbc, ComBitPosition=39, ComBitSize=1, ComHandleId=99, ComSignalEndianness=BIG_ENDIAN, ComSignalInitValue=0, ComSignalType=BOOLEAN, ComTimeout=0, ComTransferProperty=PENDING, ComFactorAndOffset=1;0
        DCDC_Precharge_Failure_DCDC_Status2_CAN_Matrix_DCDC_V0_1_20250414_dbc_Rx: source-file=CAN_Matrix-DCDC-V0.1_20250414.dbc, ComBitPosition=40, ComBitSize=1, ComHandleId=100, ComSignalEndianness=BIG_ENDIAN, ComSignalInitValue=0, ComSignalType=BOOLEAN, ComTimeout=0, ComTransferProperty=PENDING, ComFactorAndOffset=1;0
        DCDC_PSFB_CS_Failure_DCDC_Status2_CAN_Matrix_DCDC_V0_1_20250414_dbc_Rx: source-file=CAN_Matrix-DCDC-V0.1_20250414.dbc, ComBitPosition=41, ComBitSize=1, ComHandleId=101, ComSignalEndianness=BIG_ENDIAN, ComSignalInitValue=0, ComSignalType=BOOLEAN, ComTimeout=0, ComTransferProperty=PENDING, ComFactorAndOffset=1;0
        DCDC_Hard_Failure_level1_DCDC_Status2_CAN_Matrix_DCDC_V0_1_20250414_dbc_Rx: source-file=CAN_Matrix-DCDC-V0.1_20250414.dbc, ComBitPosition=42, ComBitSize=1, ComHandleId=102, ComSignalEndianness=BIG_ENDIAN, ComSignalInitValue=0, ComSignalType=BOOLEAN, ComTimeout=0, ComTransferProperty=PENDING, ComFactorAndOffset=1;0
        DCDC_HOC_PSFB_level1_DCDC_Status2_CAN_Matrix_DCDC_V0_1_20250414_dbc_Rx: source-file=CAN_Matrix-DCDC-V0.1_20250414.dbc, ComBitPosition=43, ComBitSize=1, ComHandleId=103, ComSignalEndianness=BIG_ENDIAN, ComSignalInitValue=0, ComSignalType=BOOLEAN, ComTimeout=0, ComTransferProperty=PENDING, ComFactorAndOffset=1;0
        DCDC_HOC_Cout_level1_DCDC_Status2_CAN_Matrix_DCDC_V0_1_20250414_dbc_Rx: source-file=CAN_Matrix-DCDC-V0.1_20250414.dbc, ComBitPosition=44, ComBitSize=1, ComHandleId=104, ComSignalEndianness=BIG_ENDIAN, ComSignalInitValue=0, ComSignalType=BOOLEAN, ComTimeout=0, ComTransferProperty=PENDING, ComFactorAndOffset=1;0
        DCDC_HOC_Vin_level1_DCDC_Status2_CAN_Matrix_DCDC_V0_1_20250414_dbc_Rx: source-file=CAN_Matrix-DCDC-V0.1_20250414.dbc, ComBitPosition=45, ComBitSize=1, ComHandleId=105, ComSignalEndianness=BIG_ENDIAN, ComSignalInitValue=0, ComSignalType=BOOLEAN, ComTimeout=0, ComTransferProperty=PENDING, ComFactorAndOffset=1;0
        DCDC_HOV_Vout_Boost_level1_DCDC_Status2_CAN_Matrix_DCDC_V0_1_20250414_dbc_Rx: source-file=CAN_Matrix-DCDC-V0.1_20250414.dbc, ComBitPosition=46, ComBitSize=1, ComHandleId=106, ComSignalEndianness=BIG_ENDIAN, ComSignalInitValue=0, ComSignalType=BOOLEAN, ComTimeout=0, ComTransferProperty=PENDING, ComFactorAndOffset=1;0
        DCDC_HOV_Vout_level1_DCDC_Status2_CAN_Matrix_DCDC_V0_1_20250414_dbc_Rx: source-file=CAN_Matrix-DCDC-V0.1_20250414.dbc, ComBitPosition=47, ComBitSize=1, ComHandleId=107, ComSignalEndianness=BIG_ENDIAN, ComSignalInitValue=0, ComSignalType=BOOLEAN, ComTimeout=0, ComTransferProperty=PENDING, ComFactorAndOffset=1;0
        DCDC_HOC_BoostSub1_level1_DCDC_Status2_CAN_Matrix_DCDC_V0_1_20250414_dbc_Rx: source-file=CAN_Matrix-DCDC-V0.1_20250414.dbc, ComBitPosition=48, ComBitSize=1, ComHandleId=108, ComSignalEndianness=BIG_ENDIAN, ComSignalInitValue=0, ComSignalType=BOOLEAN, ComTimeout=0, ComTransferProperty=PENDING, ComFactorAndOffset=1;0
        DCDC_HOC_BoostSub2_level2_DCDC_Status2_CAN_Matrix_DCDC_V0_1_20250414_dbc_Rx: source-file=CAN_Matrix-DCDC-V0.1_20250414.dbc, ComBitPosition=49, ComBitSize=1, ComHandleId=109, ComSignalEndianness=BIG_ENDIAN, ComSignalInitValue=0, ComSignalType=BOOLEAN, ComTimeout=0, ComTransferProperty=PENDING, ComFactorAndOffset=1;0
        DCDC_BoostSub1_CS_Failure_DCDC_Status2_CAN_Matrix_DCDC_V0_1_20250414_dbc_Rx: source-file=CAN_Matrix-DCDC-V0.1_20250414.dbc, ComBitPosition=50, ComBitSize=1, ComHandleId=110, ComSignalEndianness=BIG_ENDIAN, ComSignalInitValue=0, ComSignalType=BOOLEAN, ComTimeout=0, ComTransferProperty=PENDING, ComFactorAndOffset=1;0
        DCDC_BoostSub2_CS_Failure_DCDC_Status2_CAN_Matrix_DCDC_V0_1_20250414_dbc_Rx: source-file=CAN_Matrix-DCDC-V0.1_20250414.dbc, ComBitPosition=51, ComBitSize=1, ComHandleId=111, ComSignalEndianness=BIG_ENDIAN, ComSignalInitValue=0, ComSignalType=BOOLEAN, ComTimeout=0, ComTransferProperty=PENDING, ComFactorAndOffset=1;0
        DCDC_SoftVer_DCDC_Status3_CAN_Matrix_DCDC_V0_1_20250414_dbc_Rx: source-file=CAN_Matrix-DCDC-V0.1_20250414.dbc, ComBitPosition=8, ComBitSize=16, ComFirstTimeout=0.5, ComHandleId=112, ComSignalEndianness=BIG_ENDIAN, ComSignalInitValue=0, ComSignalType=UINT16, ComTimeout=0.5, ComTimeoutNotification=Com_RxIpduTimeout_DCDC_Status3_VR82BV, ComTransferProperty=PENDING, ComFactorAndOffset=1;0
        DCDC_HardVer_DCDC_Status3_CAN_Matrix_DCDC_V0_1_20250414_dbc_Rx: source-file=CAN_Matrix-DCDC-V0.1_20250414.dbc, ComBitPosition=24, ComBitSize=16, ComHandleId=113, ComSignalEndianness=BIG_ENDIAN, ComSignalInitValue=0, ComSignalType=UINT16, ComTimeout=0, ComTransferProperty=PENDING, ComFactorAndOffset=1;0
        DCDC_Temp_Dclink_DCDC_Status3_CAN_Matrix_DCDC_V0_1_20250414_dbc_Rx: source-file=CAN_Matrix-DCDC-V0.1_20250414.dbc, ComBitPosition=32, ComBitSize=8, ComHandleId=114, ComSignalEndianness=BIG_ENDIAN, ComSignalInitValue=0, ComSignalType=UINT8, ComTimeout=0, ComTransferProperty=PENDING, ComFactorAndOffset=1;-40
        DCDC_Temp_SR_DCDC_Status3_CAN_Matrix_DCDC_V0_1_20250414_dbc_Rx: source-file=CAN_Matrix-DCDC-V0.1_20250414.dbc, ComBitPosition=40, ComBitSize=8, ComHandleId=115, ComSignalEndianness=BIG_ENDIAN, ComSignalInitValue=0, ComSignalType=UINT8, ComTimeout=0, ComTransferProperty=PENDING, ComFactorAndOffset=1;-40
        DCDC_Temp_TSFM_DCDC_Status3_CAN_Matrix_DCDC_V0_1_20250414_dbc_Rx: source-file=CAN_Matrix-DCDC-V0.1_20250414.dbc, ComBitPosition=48, ComBitSize=8, ComHandleId=116, ComSignalEndianness=BIG_ENDIAN, ComSignalInitValue=0, ComSignalType=UINT8, ComTimeout=0, ComTransferProperty=PENDING, ComFactorAndOffset=1;-40
        DCDC_Temp_PSFB_DCDC_Status3_CAN_Matrix_DCDC_V0_1_20250414_dbc_Rx: source-file=CAN_Matrix-DCDC-V0.1_20250414.dbc, ComBitPosition=56, ComBitSize=8, ComHandleId=117, ComSignalEndianness=BIG_ENDIAN, ComSignalInitValue=0, ComSignalType=UINT8, ComTimeout=0, ComTransferProperty=PENDING, ComFactorAndOffset=1;-40
        APCUhighUbusUAPCU1_APCU1_FAW3_HVAC_V2_0DBC_dbc_Tx: source-file=FAW3_HVAC_V2.0DBC.dbc, ComBitPosition=0, ComBitSize=16, ComHandleId=82, ComSignalEndianness=LITTLE_ENDIAN, ComSignalInitValue=0, ComSignalType=UINT16, ComTimeout=0, ComTransferProperty=PENDING, ComFactorAndOffset=0.1;0
        APCUMotworkingStsAPCU1_APCU1_FAW3_HVAC_V2_0DBC_dbc_Tx: source-file=FAW3_HVAC_V2.0DBC.dbc, ComBitPosition=24, ComBitSize=2, ComHandleId=83, ComSignalEndianness=LITTLE_ENDIAN, ComSignalInitValue=0, ComSignalType=UINT8, ComTimeout=0, ComTransferProperty=PENDING, ComFactorAndOffset=1;0
        APCUMotFailrStsAPCU1_APCU1_FAW3_HVAC_V2_0DBC_dbc_Tx: source-file=FAW3_HVAC_V2.0DBC.dbc, ComBitPosition=28, ComBitSize=2, ComHandleId=84, ComSignalEndianness=LITTLE_ENDIAN, ComSignalInitValue=0, ComSignalType=UINT8, ComTimeout=0, ComTransferProperty=PENDING, ComFactorAndOffset=1;0
        APCUOutpCurAPCU1_APCU1_FAW3_HVAC_V2_0DBC_dbc_Tx: source-file=FAW3_HVAC_V2.0DBC.dbc, ComBitPosition=40, ComBitSize=16, ComHandleId=85, ComSignalEndianness=LITTLE_ENDIAN, ComSignalInitValue=0, ComSignalType=UINT16, ComTimeout=0, ComTransferProperty=PENDING, ComFactorAndOffset=1;0
        APCUTAPCU2_APCU2_FAW3_HVAC_V2_0DBC_dbc_Tx: source-file=FAW3_HVAC_V2.0DBC.dbc, ComBitPosition=0, ComBitSize=8, ComHandleId=86, ComSignalEndianness=LITTLE_ENDIAN, ComSignalInitValue=64, ComSignalType=UINT8, ComTimeout=0, ComTransferProperty=PENDING, ComFactorAndOffset=1;-40
        ProtlampDM1APCU_DM1APCU_FAW3_HVAC_V2_0DBC_dbc_Tx: source-file=FAW3_HVAC_V2.0DBC.dbc, ComBitPosition=0, ComBitSize=2, ComHandleId=87, ComSignalEndianness=LITTLE_ENDIAN, ComSignalInitValue=0, ComSignalType=UINT8, ComTimeout=0, ComTransferProperty=PENDING, ComFactorAndOffset=1;0
        amberWarnlampDM1APCU_DM1APCU_FAW3_HVAC_V2_0DBC_dbc_Tx: source-file=FAW3_HVAC_V2.0DBC.dbc, ComBitPosition=2, ComBitSize=2, ComHandleId=88, ComSignalEndianness=LITTLE_ENDIAN, ComSignalInitValue=0, ComSignalType=UINT8, ComTimeout=0, ComTransferProperty=PENDING, ComFactorAndOffset=1;0
        redstoplampDM1APCU_DM1APCU_FAW3_HVAC_V2_0DBC_dbc_Tx: source-file=FAW3_HVAC_V2.0DBC.dbc, ComBitPosition=4, ComBitSize=2, ComHandleId=89, ComSignalEndianness=LITTLE_ENDIAN, ComSignalInitValue=0, ComSignalType=UINT8, ComTimeout=0, ComTransferProperty=PENDING, ComFactorAndOffset=1;0
        malFctIndcrlampDM1APCU_DM1APCU_FAW3_HVAC_V2_0DBC_dbc_Tx: source-file=FAW3_HVAC_V2.0DBC.dbc, ComBitPosition=6, ComBitSize=2, ComHandleId=90, ComSignalEndianness=LITTLE_ENDIAN, ComSignalInitValue=0, ComSignalType=UINT8, ComTimeout=0, ComTransferProperty=PENDING, ComFactorAndOffset=1;0
        FlashProtlampDM1APCU_DM1APCU_FAW3_HVAC_V2_0DBC_dbc_Tx: source-file=FAW3_HVAC_V2.0DBC.dbc, ComBitPosition=8, ComBitSize=2, ComHandleId=91, ComSignalEndianness=LITTLE_ENDIAN, ComSignalInitValue=0, ComSignalType=UINT8, ComTimeout=0, ComTransferProperty=PENDING, ComFactorAndOffset=1;0
        FlashamberWarnlampDM1APCU_DM1APCU_FAW3_HVAC_V2_0DBC_dbc_Tx: source-file=FAW3_HVAC_V2.0DBC.dbc, ComBitPosition=10, ComBitSize=2, ComHandleId=92, ComSignalEndianness=LITTLE_ENDIAN, ComSignalInitValue=0, ComSignalType=UINT8, ComTimeout=0, ComTransferProperty=PENDING, ComFactorAndOffset=1;0
        FlashredstoplampDM1APCU_DM1APCU_FAW3_HVAC_V2_0DBC_dbc_Tx: source-file=FAW3_HVAC_V2.0DBC.dbc, ComBitPosition=12, ComBitSize=2, ComHandleId=93, ComSignalEndianness=LITTLE_ENDIAN, ComSignalInitValue=0, ComSignalType=UINT8, ComTimeout=0, ComTransferProperty=PENDING, ComFactorAndOffset=1;0
        FlashmalFctIndcrlampDM1APCU_DM1APCU_FAW3_HVAC_V2_0DBC_dbc_Tx: source-file=FAW3_HVAC_V2.0DBC.dbc, ComBitPosition=14, ComBitSize=2, ComHandleId=94, ComSignalEndianness=LITTLE_ENDIAN, ComSignalInitValue=0, ComSignalType=UINT8, ComTimeout=0, ComTransferProperty=PENDING, ComFactorAndOffset=1;0
        spn8leastsignificantbitsDM1APCU_DM1APCU_FAW3_HVAC_V2_0DBC_dbc_Tx: source-file=FAW3_HVAC_V2.0DBC.dbc, ComBitPosition=16, ComBitSize=8, ComHandleId=95, ComSignalEndianness=LITTLE_ENDIAN, ComSignalInitValue=0, ComSignalType=UINT8, ComTimeout=0, ComTransferProperty=PENDING, ComFactorAndOffset=1;0
        spnSecbyteDM1APCU_DM1APCU_FAW3_HVAC_V2_0DBC_dbc_Tx: source-file=FAW3_HVAC_V2.0DBC.dbc, ComBitPosition=24, ComBitSize=8, ComHandleId=96, ComSignalEndianness=LITTLE_ENDIAN, ComSignalInitValue=0, ComSignalType=UINT8, ComTimeout=0, ComTransferProperty=PENDING, ComFactorAndOffset=1;0
        FMiDM1APCU_DM1APCU_FAW3_HVAC_V2_0DBC_dbc_Tx: source-file=FAW3_HVAC_V2.0DBC.dbc, ComBitPosition=32, ComBitSize=5, ComHandleId=97, ComSignalEndianness=LITTLE_ENDIAN, ComSignalInitValue=0, ComSignalType=UINT8, ComTimeout=0, ComTransferProperty=PENDING, ComFactorAndOffset=1;0
        spn3mostsignificantbitsDM1APCU_DM1APCU_FAW3_HVAC_V2_0DBC_dbc_Tx: source-file=FAW3_HVAC_V2.0DBC.dbc, ComBitPosition=37, ComBitSize=3, ComHandleId=98, ComSignalEndianness=LITTLE_ENDIAN, ComSignalInitValue=0, ComSignalType=UINT8, ComTimeout=0, ComTransferProperty=PENDING, ComFactorAndOffset=1;0
        occurrenceCntDM1APCU_DM1APCU_FAW3_HVAC_V2_0DBC_dbc_Tx: source-file=FAW3_HVAC_V2.0DBC.dbc, ComBitPosition=40, ComBitSize=7, ComHandleId=99, ComSignalEndianness=LITTLE_ENDIAN, ComSignalInitValue=0, ComSignalType=UINT8, ComTimeout=0, ComTransferProperty=PENDING, ComFactorAndOffset=1;0
        spnCnvnMetHODDM1APCU_DM1APCU_FAW3_HVAC_V2_0DBC_dbc_Tx: source-file=FAW3_HVAC_V2.0DBC.dbc, ComBitPosition=47, ComBitSize=1, ComHandleId=100, ComSignalEndianness=LITTLE_ENDIAN, ComSignalInitValue=0, ComSignalType=BOOLEAN, ComTimeout=0, ComTransferProperty=PENDING, ComFactorAndOffset=1;0
        DCDCInpUDCDC1_DCDC1_FAW3_HVAC_V2_0DBC_dbc_Tx: source-file=FAW3_HVAC_V2.0DBC.dbc, ComBitPosition=0, ComBitSize=16, ComHandleId=101, ComSignalEndianness=LITTLE_ENDIAN, ComSignalInitValue=0, ComSignalType=UINT16, ComTimeout=0, ComTransferProperty=PENDING, ComFactorAndOffset=0.05;0
        DCDCInpCurDCDC1_DCDC1_FAW3_HVAC_V2_0DBC_dbc_Tx: source-file=FAW3_HVAC_V2.0DBC.dbc, ComBitPosition=16, ComBitSize=8, ComHandleId=102, ComSignalEndianness=LITTLE_ENDIAN, ComSignalInitValue=0, ComSignalType=UINT8, ComTimeout=0, ComTransferProperty=PENDING, ComFactorAndOffset=0.1;0
        DCDCOutpUDCDC1_DCDC1_FAW3_HVAC_V2_0DBC_dbc_Tx: source-file=FAW3_HVAC_V2.0DBC.dbc, ComBitPosition=24, ComBitSize=8, ComHandleId=103, ComSignalEndianness=LITTLE_ENDIAN, ComSignalInitValue=0, ComSignalType=UINT8, ComTimeout=0, ComTransferProperty=PENDING, ComFactorAndOffset=0.125;0
        DCDCOutpCurDCDC1_DCDC1_FAW3_HVAC_V2_0DBC_dbc_Tx: source-file=FAW3_HVAC_V2.0DBC.dbc, ComBitPosition=32, ComBitSize=8, ComHandleId=104, ComSignalEndianness=LITTLE_ENDIAN, ComSignalInitValue=0, ComSignalType=UINT8, ComTimeout=0, ComTransferProperty=PENDING, ComFactorAndOffset=1;0
        DCDCTDCDC1_DCDC1_FAW3_HVAC_V2_0DBC_dbc_Tx: source-file=FAW3_HVAC_V2.0DBC.dbc, ComBitPosition=40, ComBitSize=8, ComHandleId=105, ComSignalEndianness=LITTLE_ENDIAN, ComSignalInitValue=64, ComSignalType=UINT8, ComTimeout=0, ComTransferProperty=PENDING, ComFactorAndOffset=1;-40
        DCDCworkingStsDCDC1_DCDC1_FAW3_HVAC_V2_0DBC_dbc_Tx: source-file=FAW3_HVAC_V2.0DBC.dbc, ComBitPosition=48, ComBitSize=2, ComHandleId=106, ComSignalEndianness=LITTLE_ENDIAN, ComSignalInitValue=0, ComSignalType=UINT8, ComTimeout=0, ComTransferProperty=PENDING, ComFactorAndOffset=1;0
        DCDCFltStsDCDC1_DCDC1_FAW3_HVAC_V2_0DBC_dbc_Tx: source-file=FAW3_HVAC_V2.0DBC.dbc, ComBitPosition=50, ComBitSize=2, ComHandleId=107, ComSignalEndianness=LITTLE_ENDIAN, ComSignalInitValue=0, ComSignalType=UINT8, ComTimeout=0, ComTransferProperty=PENDING, ComFactorAndOffset=1;0
        ProtlampDM1DCDC_DM1DCDC_FAW3_HVAC_V2_0DBC_dbc_Tx: source-file=FAW3_HVAC_V2.0DBC.dbc, ComBitPosition=0, ComBitSize=2, ComHandleId=108, ComSignalEndianness=LITTLE_ENDIAN, ComSignalInitValue=0, ComSignalType=UINT8, ComTimeout=0, ComTransferProperty=PENDING, ComFactorAndOffset=1;0
        amberWarnlampDM1DCDC_DM1DCDC_FAW3_HVAC_V2_0DBC_dbc_Tx: source-file=FAW3_HVAC_V2.0DBC.dbc, ComBitPosition=2, ComBitSize=2, ComHandleId=109, ComSignalEndianness=LITTLE_ENDIAN, ComSignalInitValue=0, ComSignalType=UINT8, ComTimeout=0, ComTransferProperty=PENDING, ComFactorAndOffset=1;0
        redstoplampDM1DCDC_DM1DCDC_FAW3_HVAC_V2_0DBC_dbc_Tx: source-file=FAW3_HVAC_V2.0DBC.dbc, ComBitPosition=4, ComBitSize=2, ComHandleId=110, ComSignalEndianness=LITTLE_ENDIAN, ComSignalInitValue=0, ComSignalType=UINT8, ComTimeout=0, ComTransferProperty=PENDING, ComFactorAndOffset=1;0
        malFctIndcrlampDM1DCDC_DM1DCDC_FAW3_HVAC_V2_0DBC_dbc_Tx: source-file=FAW3_HVAC_V2.0DBC.dbc, ComBitPosition=6, ComBitSize=2, ComHandleId=111, ComSignalEndianness=LITTLE_ENDIAN, ComSignalInitValue=0, ComSignalType=UINT8, ComTimeout=0, ComTransferProperty=PENDING, ComFactorAndOffset=1;0
        FlashProtlampDM1DCDC_DM1DCDC_FAW3_HVAC_V2_0DBC_dbc_Tx: source-file=FAW3_HVAC_V2.0DBC.dbc, ComBitPosition=8, ComBitSize=2, ComHandleId=112, ComSignalEndianness=LITTLE_ENDIAN, ComSignalInitValue=0, ComSignalType=UINT8, ComTimeout=0, ComTransferProperty=PENDING, ComFactorAndOffset=1;0
        FlashamberWarnlampDM1DCDC_DM1DCDC_FAW3_HVAC_V2_0DBC_dbc_Tx: source-file=FAW3_HVAC_V2.0DBC.dbc, ComBitPosition=10, ComBitSize=2, ComHandleId=113, ComSignalEndianness=LITTLE_ENDIAN, ComSignalInitValue=0, ComSignalType=UINT8, ComTimeout=0, ComTransferProperty=PENDING, ComFactorAndOffset=1;0
        FlashredstoplampDM1DCDC_DM1DCDC_FAW3_HVAC_V2_0DBC_dbc_Tx: source-file=FAW3_HVAC_V2.0DBC.dbc, ComBitPosition=12, ComBitSize=2, ComHandleId=114, ComSignalEndianness=LITTLE_ENDIAN, ComSignalInitValue=0, ComSignalType=UINT8, ComTimeout=0, ComTransferProperty=PENDING, ComFactorAndOffset=1;0
        FlashmalFctIndcrlampDM1DCDC_DM1DCDC_FAW3_HVAC_V2_0DBC_dbc_Tx: source-file=FAW3_HVAC_V2.0DBC.dbc, ComBitPosition=14, ComBitSize=2, ComHandleId=115, ComSignalEndianness=LITTLE_ENDIAN, ComSignalInitValue=0, ComSignalType=UINT8, ComTimeout=0, ComTransferProperty=PENDING, ComFactorAndOffset=1;0
        spn8leastsignificantbitsDM1DCDC_DM1DCDC_FAW3_HVAC_V2_0DBC_dbc_Tx: source-file=FAW3_HVAC_V2.0DBC.dbc, ComBitPosition=16, ComBitSize=8, ComHandleId=116, ComSignalEndianness=LITTLE_ENDIAN, ComSignalInitValue=0, ComSignalType=UINT8, ComTimeout=0, ComTransferProperty=PENDING, ComFactorAndOffset=1;0
        spnSecbyteDM1DCDC_DM1DCDC_FAW3_HVAC_V2_0DBC_dbc_Tx: source-file=FAW3_HVAC_V2.0DBC.dbc, ComBitPosition=24, ComBitSize=8, ComHandleId=117, ComSignalEndianness=LITTLE_ENDIAN, ComSignalInitValue=0, ComSignalType=UINT8, ComTimeout=0, ComTransferProperty=PENDING, ComFactorAndOffset=1;0
        FMiDM1DCDC_DM1DCDC_FAW3_HVAC_V2_0DBC_dbc_Tx: source-file=FAW3_HVAC_V2.0DBC.dbc, ComBitPosition=32, ComBitSize=5, ComHandleId=118, ComSignalEndianness=LITTLE_ENDIAN, ComSignalInitValue=0, ComSignalType=UINT8, ComTimeout=0, ComTransferProperty=PENDING, ComFactorAndOffset=1;0
        spn3mostsignificantbitsDM1DCDC_DM1DCDC_FAW3_HVAC_V2_0DBC_dbc_Tx: source-file=FAW3_HVAC_V2.0DBC.dbc, ComBitPosition=37, ComBitSize=3, ComHandleId=119, ComSignalEndianness=LITTLE_ENDIAN, ComSignalInitValue=0, ComSignalType=UINT8, ComTimeout=0, ComTransferProperty=PENDING, ComFactorAndOffset=1;0
        occurrenceCntDM1DCDC_DM1DCDC_FAW3_HVAC_V2_0DBC_dbc_Tx: source-file=FAW3_HVAC_V2.0DBC.dbc, ComBitPosition=40, ComBitSize=7, ComHandleId=120, ComSignalEndianness=LITTLE_ENDIAN, ComSignalInitValue=0, ComSignalType=UINT8, ComTimeout=0, ComTransferProperty=PENDING, ComFactorAndOffset=1;0
        spnCnvnMetHODDM1DCDC_DM1DCDC_FAW3_HVAC_V2_0DBC_dbc_Tx: source-file=FAW3_HVAC_V2.0DBC.dbc, ComBitPosition=47, ComBitSize=1, ComHandleId=121, ComSignalEndianness=LITTLE_ENDIAN, ComSignalInitValue=0, ComSignalType=BOOLEAN, ComTimeout=0, ComTransferProperty=PENDING, ComFactorAndOffset=1;0
        ProtlampDM1OPCU_DM1OPCU_FAW3_HVAC_V2_0DBC_dbc_Tx: source-file=FAW3_HVAC_V2.0DBC.dbc, ComBitPosition=0, ComBitSize=2, ComHandleId=122, ComSignalEndianness=LITTLE_ENDIAN, ComSignalInitValue=0, ComSignalType=UINT8, ComTimeout=0, ComTransferProperty=PENDING, ComFactorAndOffset=1;0
        amberWarnlampDM1OPCU_DM1OPCU_FAW3_HVAC_V2_0DBC_dbc_Tx: source-file=FAW3_HVAC_V2.0DBC.dbc, ComBitPosition=2, ComBitSize=2, ComHandleId=123, ComSignalEndianness=LITTLE_ENDIAN, ComSignalInitValue=0, ComSignalType=UINT8, ComTimeout=0, ComTransferProperty=PENDING, ComFactorAndOffset=1;0
        redstoplampDM1OPCU_DM1OPCU_FAW3_HVAC_V2_0DBC_dbc_Tx: source-file=FAW3_HVAC_V2.0DBC.dbc, ComBitPosition=4, ComBitSize=2, ComHandleId=124, ComSignalEndianness=LITTLE_ENDIAN, ComSignalInitValue=0, ComSignalType=UINT8, ComTimeout=0, ComTransferProperty=PENDING, ComFactorAndOffset=1;0
        malFctIndcrlampDM1OPCU_DM1OPCU_FAW3_HVAC_V2_0DBC_dbc_Tx: source-file=FAW3_HVAC_V2.0DBC.dbc, ComBitPosition=6, ComBitSize=2, ComHandleId=125, ComSignalEndianness=LITTLE_ENDIAN, ComSignalInitValue=0, ComSignalType=UINT8, ComTimeout=0, ComTransferProperty=PENDING, ComFactorAndOffset=1;0
        FlashProtlampDM1OPCU_DM1OPCU_FAW3_HVAC_V2_0DBC_dbc_Tx: source-file=FAW3_HVAC_V2.0DBC.dbc, ComBitPosition=8, ComBitSize=2, ComHandleId=126, ComSignalEndianness=LITTLE_ENDIAN, ComSignalInitValue=0, ComSignalType=UINT8, ComTimeout=0, ComTransferProperty=PENDING, ComFactorAndOffset=1;0
        FlashamberWarnlampDM1OPCU_DM1OPCU_FAW3_HVAC_V2_0DBC_dbc_Tx: source-file=FAW3_HVAC_V2.0DBC.dbc, ComBitPosition=10, ComBitSize=2, ComHandleId=127, ComSignalEndianness=LITTLE_ENDIAN, ComSignalInitValue=0, ComSignalType=UINT8, ComTimeout=0, ComTransferProperty=PENDING, ComFactorAndOffset=1;0
        FlashredstoplampDM1OPCU_DM1OPCU_FAW3_HVAC_V2_0DBC_dbc_Tx: source-file=FAW3_HVAC_V2.0DBC.dbc, ComBitPosition=12, ComBitSize=2, ComHandleId=128, ComSignalEndianness=LITTLE_ENDIAN, ComSignalInitValue=0, ComSignalType=UINT8, ComTimeout=0, ComTransferProperty=PENDING, ComFactorAndOffset=1;0
        FlashmalFctIndcrlampDM1OPCU_DM1OPCU_FAW3_HVAC_V2_0DBC_dbc_Tx: source-file=FAW3_HVAC_V2.0DBC.dbc, ComBitPosition=14, ComBitSize=2, ComHandleId=129, ComSignalEndianness=LITTLE_ENDIAN, ComSignalInitValue=0, ComSignalType=UINT8, ComTimeout=0, ComTransferProperty=PENDING, ComFactorAndOffset=1;0
        spn8leastsignificantbitsDM1OPCU_DM1OPCU_FAW3_HVAC_V2_0DBC_dbc_Tx: source-file=FAW3_HVAC_V2.0DBC.dbc, ComBitPosition=16, ComBitSize=8, ComHandleId=130, ComSignalEndianness=LITTLE_ENDIAN, ComSignalInitValue=0, ComSignalType=UINT8, ComTimeout=0, ComTransferProperty=PENDING, ComFactorAndOffset=1;0
        spnSecbyteDM1OPCU_DM1OPCU_FAW3_HVAC_V2_0DBC_dbc_Tx: source-file=FAW3_HVAC_V2.0DBC.dbc, ComBitPosition=24, ComBitSize=8, ComHandleId=131, ComSignalEndianness=LITTLE_ENDIAN, ComSignalInitValue=0, ComSignalType=UINT8, ComTimeout=0, ComTransferProperty=PENDING, ComFactorAndOffset=1;0
        FMiDM1OPCU_DM1OPCU_FAW3_HVAC_V2_0DBC_dbc_Tx: source-file=FAW3_HVAC_V2.0DBC.dbc, ComBitPosition=32, ComBitSize=5, ComHandleId=132, ComSignalEndianness=LITTLE_ENDIAN, ComSignalInitValue=0, ComSignalType=UINT8, ComTimeout=0, ComTransferProperty=PENDING, ComFactorAndOffset=1;0
        spn3mostsignificantbitsDM1OPCU_DM1OPCU_FAW3_HVAC_V2_0DBC_dbc_Tx: source-file=FAW3_HVAC_V2.0DBC.dbc, ComBitPosition=37, ComBitSize=3, ComHandleId=133, ComSignalEndianness=LITTLE_ENDIAN, ComSignalInitValue=0, ComSignalType=UINT8, ComTimeout=0, ComTransferProperty=PENDING, ComFactorAndOffset=1;0
        occurrenceCntDM1OPCU_DM1OPCU_FAW3_HVAC_V2_0DBC_dbc_Tx: source-file=FAW3_HVAC_V2.0DBC.dbc, ComBitPosition=40, ComBitSize=7, ComHandleId=134, ComSignalEndianness=LITTLE_ENDIAN, ComSignalInitValue=0, ComSignalType=UINT8, ComTimeout=0, ComTransferProperty=PENDING, ComFactorAndOffset=1;0
        spnCnvnMetHODDM1OPCU_DM1OPCU_FAW3_HVAC_V2_0DBC_dbc_Tx: source-file=FAW3_HVAC_V2.0DBC.dbc, ComBitPosition=47, ComBitSize=1, ComHandleId=135, ComSignalEndianness=LITTLE_ENDIAN, ComSignalInitValue=0, ComSignalType=BOOLEAN, ComTimeout=0, ComTransferProperty=PENDING, ComFactorAndOffset=1;0
        OPCUhighUbusUOPCU1_OPCU1_FAW3_HVAC_V2_0DBC_dbc_Tx: source-file=FAW3_HVAC_V2.0DBC.dbc, ComBitPosition=16, ComBitSize=16, ComHandleId=136, ComSignalEndianness=LITTLE_ENDIAN, ComSignalInitValue=0, ComSignalType=UINT16, ComTimeout=0, ComTransferProperty=PENDING, ComFactorAndOffset=1;0
        OPCUMotFailrStsOPCU1_OPCU1_FAW3_HVAC_V2_0DBC_dbc_Tx: source-file=FAW3_HVAC_V2.0DBC.dbc, ComBitPosition=60, ComBitSize=2, ComHandleId=137, ComSignalEndianness=LITTLE_ENDIAN, ComSignalInitValue=0, ComSignalType=UINT8, ComTimeout=0, ComTransferProperty=PENDING, ComFactorAndOffset=1;0
        OPCUworkingStsOPCU1_OPCU1_FAW3_HVAC_V2_0DBC_dbc_Tx: source-file=FAW3_HVAC_V2.0DBC.dbc, ComBitPosition=62, ComBitSize=2, ComHandleId=138, ComSignalEndianness=LITTLE_ENDIAN, ComSignalInitValue=0, ComSignalType=UINT8, ComTimeout=0, ComTransferProperty=PENDING, ComFactorAndOffset=1;0
        oilPUMPMotIvterTOPCU2_OPCU2_FAW3_HVAC_V2_0DBC_dbc_Tx: source-file=FAW3_HVAC_V2.0DBC.dbc, ComBitPosition=8, ComBitSize=8, ComHandleId=139, ComSignalEndianness=LITTLE_ENDIAN, ComSignalInitValue=64, ComSignalType=UINT8, ComTimeout=0, ComTransferProperty=PENDING, ComFactorAndOffset=1;-40
        oilPUMPMotOutpCurOPCU2_OPCU2_FAW3_HVAC_V2_0DBC_dbc_Tx: source-file=FAW3_HVAC_V2.0DBC.dbc, ComBitPosition=24, ComBitSize=8, ComHandleId=140, ComSignalEndianness=LITTLE_ENDIAN, ComSignalInitValue=255, ComSignalType=UINT8, ComTimeout=0, ComTransferProperty=PENDING, ComFactorAndOffset=0.1;0
        mainPosRlyStsRelayState_RelayState_FAW3_HVAC_V2_0DBC_dbc_Tx: source-file=FAW3_HVAC_V2.0DBC.dbc, ComBitPosition=0, ComBitSize=3, ComHandleId=141, ComSignalEndianness=LITTLE_ENDIAN, ComSignalInitValue=7, ComSignalType=UINT8, ComTimeout=0, ComTransferProperty=PENDING, ComFactorAndOffset=1;0
        mainnegtiveRlyStsRelayState_RelayState_FAW3_HVAC_V2_0DBC_dbc_Tx: source-file=FAW3_HVAC_V2.0DBC.dbc, ComBitPosition=3, ComBitSize=3, ComHandleId=142, ComSignalEndianness=LITTLE_ENDIAN, ComSignalInitValue=7, ComSignalType=UINT8, ComTimeout=0, ComTransferProperty=PENDING, ComFactorAndOffset=1;0
        pduFailrStsRelayState_RelayState_FAW3_HVAC_V2_0DBC_dbc_Tx: source-file=FAW3_HVAC_V2.0DBC.dbc, ComBitPosition=6, ComBitSize=2, ComHandleId=143, ComSignalEndianness=LITTLE_ENDIAN, ComSignalInitValue=0, ComSignalType=UINT8, ComTimeout=0, ComTransferProperty=PENDING, ComFactorAndOffset=1;0
        preChrgnRlyStsRelayState_RelayState_FAW3_HVAC_V2_0DBC_dbc_Tx: source-file=FAW3_HVAC_V2.0DBC.dbc, ComBitPosition=8, ComBitSize=3, ComHandleId=144, ComSignalEndianness=LITTLE_ENDIAN, ComSignalInitValue=7, ComSignalType=UINT8, ComTimeout=0, ComTransferProperty=PENDING, ComFactorAndOffset=1;0
        fuelcellRlyStsRelayState_RelayState_FAW3_HVAC_V2_0DBC_dbc_Tx: source-file=FAW3_HVAC_V2.0DBC.dbc, ComBitPosition=11, ComBitSize=3, ComHandleId=145, ComSignalEndianness=LITTLE_ENDIAN, ComSignalInitValue=7, ComSignalType=UINT8, ComTimeout=0, ComTransferProperty=PENDING, ComFactorAndOffset=1;0
        PTCRlyStsRelayState_RelayState_FAW3_HVAC_V2_0DBC_dbc_Tx: source-file=FAW3_HVAC_V2.0DBC.dbc, ComBitPosition=24, ComBitSize=3, ComHandleId=146, ComSignalEndianness=LITTLE_ENDIAN, ComSignalInitValue=7, ComSignalType=UINT8, ComTimeout=0, ComTransferProperty=PENDING, ComFactorAndOffset=1;0
        AcsoryRlyStsRelayState_RelayState_FAW3_HVAC_V2_0DBC_dbc_Tx: source-file=FAW3_HVAC_V2.0DBC.dbc, ComBitPosition=27, ComBitSize=3, ComHandleId=147, ComSignalEndianness=LITTLE_ENDIAN, ComSignalInitValue=7, ComSignalType=UINT8, ComTimeout=0, ComTransferProperty=PENDING, ComFactorAndOffset=1;0
        MECURlyStsRelayState_RelayState_FAW3_HVAC_V2_0DBC_dbc_Tx: source-file=FAW3_HVAC_V2.0DBC.dbc, ComBitPosition=32, ComBitSize=3, ComHandleId=148, ComSignalEndianness=LITTLE_ENDIAN, ComSignalInitValue=7, ComSignalType=UINT8, ComTimeout=0, ComTransferProperty=PENDING, ComFactorAndOffset=1;0
        DCDCRlyStsRelayState_RelayState_FAW3_HVAC_V2_0DBC_dbc_Tx: source-file=FAW3_HVAC_V2.0DBC.dbc, ComBitPosition=35, ComBitSize=3, ComHandleId=149, ComSignalEndianness=LITTLE_ENDIAN, ComSignalInitValue=7, ComSignalType=UINT8, ComTimeout=0, ComTransferProperty=PENDING, ComFactorAndOffset=1;0
        mainPosRlyPwronStsRelayState_RelayState_FAW3_HVAC_V2_0DBC_dbc_Tx: source-file=FAW3_HVAC_V2.0DBC.dbc, ComBitPosition=40, ComBitSize=3, ComHandleId=150, ComSignalEndianness=LITTLE_ENDIAN, ComSignalInitValue=7, ComSignalType=UINT8, ComTimeout=0, ComTransferProperty=PENDING, ComFactorAndOffset=1;0
        MECUPwronStsRelayState_RelayState_FAW3_HVAC_V2_0DBC_dbc_Tx: source-file=FAW3_HVAC_V2.0DBC.dbc, ComBitPosition=43, ComBitSize=3, ComHandleId=151, ComSignalEndianness=LITTLE_ENDIAN, ComSignalInitValue=7, ComSignalType=UINT8, ComTimeout=0, ComTransferProperty=PENDING, ComFactorAndOffset=1;0
        BattpackHeatgPosRlyStsRelayState_RelayState_FAW3_HVAC_V2_0DBC_dbc_Tx: source-file=FAW3_HVAC_V2.0DBC.dbc, ComBitPosition=48, ComBitSize=3, ComHandleId=152, ComSignalEndianness=LITTLE_ENDIAN, ComSignalInitValue=7, ComSignalType=UINT8, ComTimeout=0, ComTransferProperty=PENDING, ComFactorAndOffset=1;0
        BattpackHeatgNegRlyStsRelayState_RelayState_FAW3_HVAC_V2_0DBC_dbc_Tx: source-file=FAW3_HVAC_V2.0DBC.dbc, ComBitPosition=51, ComBitSize=3, ComHandleId=153, ComSignalEndianness=LITTLE_ENDIAN, ComSignalInitValue=7, ComSignalType=UINT8, ComTimeout=0, ComTransferProperty=PENDING, ComFactorAndOffset=1;0
        hydroCoolgRlyStsRelayState_RelayState_FAW3_HVAC_V2_0DBC_dbc_Tx: source-file=FAW3_HVAC_V2.0DBC.dbc, ComBitPosition=56, ComBitSize=3, ComHandleId=154, ComSignalEndianness=LITTLE_ENDIAN, ComSignalInitValue=7, ComSignalType=UINT8, ComTimeout=0, ComTransferProperty=PENDING, ComFactorAndOffset=1;0
        acRlyStsRelayState_RelayState_FAW3_HVAC_V2_0DBC_dbc_Tx: source-file=FAW3_HVAC_V2.0DBC.dbc, ComBitPosition=59, ComBitSize=3, ComHandleId=155, ComSignalEndianness=LITTLE_ENDIAN, ComSignalInitValue=7, ComSignalType=UINT8, ComTimeout=0, ComTransferProperty=PENDING, ComFactorAndOffset=1;0
        DirtCurChrg1PosRlyStsRelayState2_RelayState2_FAW3_HVAC_V2_0DBC_dbc_Tx: source-file=FAW3_HVAC_V2.0DBC.dbc, ComBitPosition=0, ComBitSize=3, ComHandleId=156, ComSignalEndianness=LITTLE_ENDIAN, ComSignalInitValue=7, ComSignalType=UINT8, ComTimeout=0, ComTransferProperty=PENDING, ComFactorAndOffset=1;0
        DirtCurChrg1NegRlyStsRelayState2_RelayState2_FAW3_HVAC_V2_0DBC_dbc_Tx: source-file=FAW3_HVAC_V2.0DBC.dbc, ComBitPosition=3, ComBitSize=3, ComHandleId=157, ComSignalEndianness=LITTLE_ENDIAN, ComSignalInitValue=7, ComSignalType=UINT8, ComTimeout=0, ComTransferProperty=PENDING, ComFactorAndOffset=1;0
        DirtCurChrg2NegRlyStsRelayState20_RelayState2_FAW3_HVAC_V2_0DBC_dbc_Tx: source-file=FAW3_HVAC_V2.0DBC.dbc, ComBitPosition=8, ComBitSize=3, ComHandleId=158, ComSignalEndianness=LITTLE_ENDIAN, ComSignalInitValue=7, ComSignalType=UINT8, ComTimeout=0, ComTransferProperty=PENDING, ComFactorAndOffset=1;0
        DirtCurChrg2NegRlyStsRelayState21_RelayState2_FAW3_HVAC_V2_0DBC_dbc_Tx: source-file=FAW3_HVAC_V2.0DBC.dbc, ComBitPosition=11, ComBitSize=3, ComHandleId=159, ComSignalEndianness=LITTLE_ENDIAN, ComSignalInitValue=7, ComSignalType=UINT8, ComTimeout=0, ComTransferProperty=PENDING, ComFactorAndOffset=1;0
        PwrBattURelayState2_RelayState2_FAW3_HVAC_V2_0DBC_dbc_Tx: source-file=FAW3_HVAC_V2.0DBC.dbc, ComBitPosition=16, ComBitSize=16, ComHandleId=160, ComSignalEndianness=LITTLE_ENDIAN, ComSignalInitValue=0, ComSignalType=UINT16, ComTimeout=0, ComTransferProperty=PENDING, ComFactorAndOffset=0.05;0
        BattheatPTCRlyStsRelayState2_RelayState2_FAW3_HVAC_V2_0DBC_dbc_Tx: source-file=FAW3_HVAC_V2.0DBC.dbc, ComBitPosition=32, ComBitSize=3, ComHandleId=161, ComSignalEndianness=LITTLE_ENDIAN, ComSignalInitValue=7, ComSignalType=UINT8, ComTimeout=0, ComTransferProperty=PENDING, ComFactorAndOffset=1;0
        WtrCoolgRlyStsRelayState2_RelayState2_FAW3_HVAC_V2_0DBC_dbc_Tx: source-file=FAW3_HVAC_V2.0DBC.dbc, ComBitPosition=35, ComBitSize=3, ComHandleId=162, ComSignalEndianness=LITTLE_ENDIAN, ComSignalInitValue=7, ComSignalType=UINT8, ComTimeout=0, ComTransferProperty=PENDING, ComFactorAndOffset=1;0
        insulationRIMCU1PTU_IMCU1PTU_FAW3_HVAC_V2_0DBC_dbc_Tx: source-file=FAW3_HVAC_V2.0DBC.dbc, ComBitPosition=0, ComBitSize=16, ComHandleId=163, ComSignalEndianness=LITTLE_ENDIAN, ComSignalInitValue=0, ComSignalType=UINT16, ComTimeout=0, ComTransferProperty=PENDING, ComFactorAndOffset=1;0
        sulationMonrdetectsUResdIMCU1PTU_IMCU1PTU_FAW3_HVAC_V2_0DBC_dbc_Tx: source-file=FAW3_HVAC_V2.0DBC.dbc, ComBitPosition=16, ComBitSize=16, ComHandleId=164, ComSignalEndianness=LITTLE_ENDIAN, ComSignalInitValue=0, ComSignalType=UINT16, ComTimeout=0, ComTransferProperty=PENDING, ComFactorAndOffset=1;0
        insulationMonrSysStsIMCU1PTU_IMCU1PTU_FAW3_HVAC_V2_0DBC_dbc_Tx: source-file=FAW3_HVAC_V2.0DBC.dbc, ComBitPosition=32, ComBitSize=3, ComHandleId=165, ComSignalEndianness=LITTLE_ENDIAN, ComSignalInitValue=0, ComSignalType=UINT8, ComTimeout=0, ComTransferProperty=PENDING, ComFactorAndOffset=1;0
        insulationMonrAlrmIMCU1PTU_IMCU1PTU_FAW3_HVAC_V2_0DBC_dbc_Tx: source-file=FAW3_HVAC_V2.0DBC.dbc, ComBitPosition=36, ComBitSize=2, ComHandleId=166, ComSignalEndianness=LITTLE_ENDIAN, ComSignalInitValue=0, ComSignalType=UINT8, ComTimeout=0, ComTransferProperty=PENDING, ComFactorAndOffset=1;0
        MECUbusbarUMECU1Reserved_MECU1Reserved_FAW3_HVAC_V2_0DBC_dbc_Tx: source-file=FAW3_HVAC_V2.0DBC.dbc, ComBitPosition=32, ComBitSize=16, ComHandleId=167, ComSignalEndianness=LITTLE_ENDIAN, ComSignalInitValue=0, ComSignalType=UINT16, ComTimeout=0, ComTransferProperty=PENDING, ComFactorAndOffset=0.1;0
        ProtlampDM1PTU_DM1PTU_FAW3_HVAC_V2_0DBC_dbc_Tx: source-file=FAW3_HVAC_V2.0DBC.dbc, ComBitPosition=0, ComBitSize=2, ComHandleId=168, ComSignalEndianness=LITTLE_ENDIAN, ComSignalInitValue=0, ComSignalType=UINT8, ComTimeout=0, ComTransferProperty=PENDING, ComFactorAndOffset=1;0
        amberWarnlampDM1PTU_DM1PTU_FAW3_HVAC_V2_0DBC_dbc_Tx: source-file=FAW3_HVAC_V2.0DBC.dbc, ComBitPosition=2, ComBitSize=2, ComHandleId=169, ComSignalEndianness=LITTLE_ENDIAN, ComSignalInitValue=0, ComSignalType=UINT8, ComTimeout=0, ComTransferProperty=PENDING, ComFactorAndOffset=1;0
        redstoplampDM1PTU_DM1PTU_FAW3_HVAC_V2_0DBC_dbc_Tx: source-file=FAW3_HVAC_V2.0DBC.dbc, ComBitPosition=4, ComBitSize=2, ComHandleId=170, ComSignalEndianness=LITTLE_ENDIAN, ComSignalInitValue=0, ComSignalType=UINT8, ComTimeout=0, ComTransferProperty=PENDING, ComFactorAndOffset=1;0
        malFctIndcrlampDM1PTU_DM1PTU_FAW3_HVAC_V2_0DBC_dbc_Tx: source-file=FAW3_HVAC_V2.0DBC.dbc, ComBitPosition=6, ComBitSize=2, ComHandleId=171, ComSignalEndianness=LITTLE_ENDIAN, ComSignalInitValue=0, ComSignalType=UINT8, ComTimeout=0, ComTransferProperty=PENDING, ComFactorAndOffset=1;0
        FlashProtlampDM1PTU_DM1PTU_FAW3_HVAC_V2_0DBC_dbc_Tx: source-file=FAW3_HVAC_V2.0DBC.dbc, ComBitPosition=8, ComBitSize=2, ComHandleId=172, ComSignalEndianness=LITTLE_ENDIAN, ComSignalInitValue=0, ComSignalType=UINT8, ComTimeout=0, ComTransferProperty=PENDING, ComFactorAndOffset=1;0
        FlashamberWarnlampDM1PTU_DM1PTU_FAW3_HVAC_V2_0DBC_dbc_Tx: source-file=FAW3_HVAC_V2.0DBC.dbc, ComBitPosition=10, ComBitSize=2, ComHandleId=173, ComSignalEndianness=LITTLE_ENDIAN, ComSignalInitValue=0, ComSignalType=UINT8, ComTimeout=0, ComTransferProperty=PENDING, ComFactorAndOffset=1;0
        FlashredstoplampDM1PTU_DM1PTU_FAW3_HVAC_V2_0DBC_dbc_Tx: source-file=FAW3_HVAC_V2.0DBC.dbc, ComBitPosition=12, ComBitSize=2, ComHandleId=174, ComSignalEndianness=LITTLE_ENDIAN, ComSignalInitValue=0, ComSignalType=UINT8, ComTimeout=0, ComTransferProperty=PENDING, ComFactorAndOffset=1;0
        FlashmalFctIndcrlampDM1PTU_DM1PTU_FAW3_HVAC_V2_0DBC_dbc_Tx: source-file=FAW3_HVAC_V2.0DBC.dbc, ComBitPosition=14, ComBitSize=2, ComHandleId=175, ComSignalEndianness=LITTLE_ENDIAN, ComSignalInitValue=0, ComSignalType=UINT8, ComTimeout=0, ComTransferProperty=PENDING, ComFactorAndOffset=1;0
        spn8leastsignificantbitsDM1PTU_DM1PTU_FAW3_HVAC_V2_0DBC_dbc_Tx: source-file=FAW3_HVAC_V2.0DBC.dbc, ComBitPosition=16, ComBitSize=8, ComHandleId=176, ComSignalEndianness=LITTLE_ENDIAN, ComSignalInitValue=0, ComSignalType=UINT8, ComTimeout=0, ComTransferProperty=PENDING, ComFactorAndOffset=1;0
        spnSecbyteDM1PTU_DM1PTU_FAW3_HVAC_V2_0DBC_dbc_Tx: source-file=FAW3_HVAC_V2.0DBC.dbc, ComBitPosition=24, ComBitSize=8, ComHandleId=177, ComSignalEndianness=LITTLE_ENDIAN, ComSignalInitValue=0, ComSignalType=UINT8, ComTimeout=0, ComTransferProperty=PENDING, ComFactorAndOffset=1;0
        FMiDM1PTU_DM1PTU_FAW3_HVAC_V2_0DBC_dbc_Tx: source-file=FAW3_HVAC_V2.0DBC.dbc, ComBitPosition=32, ComBitSize=5, ComHandleId=178, ComSignalEndianness=LITTLE_ENDIAN, ComSignalInitValue=0, ComSignalType=UINT8, ComTimeout=0, ComTransferProperty=PENDING, ComFactorAndOffset=1;0
        spn3mostsignificantbitsDM1PTU_DM1PTU_FAW3_HVAC_V2_0DBC_dbc_Tx: source-file=FAW3_HVAC_V2.0DBC.dbc, ComBitPosition=37, ComBitSize=3, ComHandleId=179, ComSignalEndianness=LITTLE_ENDIAN, ComSignalInitValue=0, ComSignalType=UINT8, ComTimeout=0, ComTransferProperty=PENDING, ComFactorAndOffset=1;0
        occurrenceCntDM1PTU_DM1PTU_FAW3_HVAC_V2_0DBC_dbc_Tx: source-file=FAW3_HVAC_V2.0DBC.dbc, ComBitPosition=40, ComBitSize=7, ComHandleId=180, ComSignalEndianness=LITTLE_ENDIAN, ComSignalInitValue=0, ComSignalType=UINT8, ComTimeout=0, ComTransferProperty=PENDING, ComFactorAndOffset=1;0
        spnCnvnMetHODDM1PTU_DM1PTU_FAW3_HVAC_V2_0DBC_dbc_Tx: source-file=FAW3_HVAC_V2.0DBC.dbc, ComBitPosition=47, ComBitSize=1, ComHandleId=181, ComSignalEndianness=LITTLE_ENDIAN, ComSignalInitValue=0, ComSignalType=BOOLEAN, ComTimeout=0, ComTransferProperty=PENDING, ComFactorAndOffset=1;0
        DCDCOutpUReqHCUDCDC_HCUDCDC_FAW3_HVAC_V2_0DBC_dbc_Rx: source-file=FAW3_HVAC_V2.0DBC.dbc, ComBitPosition=0, ComBitSize=8, ComFirstTimeout=1, ComHandleId=118, ComSignalEndianness=LITTLE_ENDIAN, ComSignalInitValue=0, ComSignalType=UINT8, ComTimeout=1, ComTimeoutNotification=Com_RxIpduTimeout_HCUDCDC_OjcG_c, ComTransferProperty=PENDING, ComFactorAndOffset=0.125;0
        DCDCworkingeanableCmdHCUDCDC_HCUDCDC_FAW3_HVAC_V2_0DBC_dbc_Rx: source-file=FAW3_HVAC_V2.0DBC.dbc, ComBitPosition=8, ComBitSize=2, ComHandleId=119, ComSignalEndianness=LITTLE_ENDIAN, ComSignalInitValue=0, ComSignalType=UINT8, ComTimeout=0, ComTransferProperty=PENDING, ComFactorAndOffset=1;0
        airPUMPMotworkingEnaHCUAPCU_HCUAPCU_FAW3_HVAC_V2_0DBC_dbc_Rx: source-file=FAW3_HVAC_V2.0DBC.dbc, ComBitPosition=0, ComBitSize=2, ComFirstTimeout=1, ComHandleId=120, ComSignalEndianness=LITTLE_ENDIAN, ComSignalInitValue=0, ComSignalType=UINT8, ComTimeout=1, ComTimeoutNotification=Com_RxIpduTimeout_HCUAPCU_OjcG_c, ComTransferProperty=PENDING, ComFactorAndOffset=1;0
        oilPUMPMotworkingEnaCmdHCUOPCU_HCUOPCU_FAW3_HVAC_V2_0DBC_dbc_Rx: source-file=FAW3_HVAC_V2.0DBC.dbc, ComBitPosition=0, ComBitSize=2, ComFirstTimeout=1, ComHandleId=121, ComSignalEndianness=LITTLE_ENDIAN, ComSignalInitValue=0, ComSignalType=UINT8, ComTimeout=1, ComTimeoutNotification=Com_RxIpduTimeout_HCUOPCU_OjcG_c, ComTransferProperty=PENDING, ComFactorAndOffset=1;0
        mainPoshighURlyCtrlCmdHCU3_HCU3_FAW3_HVAC_V2_0DBC_dbc_Rx: source-file=FAW3_HVAC_V2.0DBC.dbc, ComBitPosition=0, ComBitSize=2, ComFirstTimeout=1, ComHandleId=122, ComSignalEndianness=LITTLE_ENDIAN, ComSignalInitValue=3, ComSignalType=UINT8, ComTimeout=1, ComTimeoutNotification=Com_RxIpduTimeout_HCU3_OjcG_c, ComTransferProperty=PENDING, ComFactorAndOffset=1;0
        fuelcellRlyCtrlCmdHCU3_HCU3_FAW3_HVAC_V2_0DBC_dbc_Rx: source-file=FAW3_HVAC_V2.0DBC.dbc, ComBitPosition=8, ComBitSize=2, ComHandleId=123, ComSignalEndianness=LITTLE_ENDIAN, ComSignalInitValue=3, ComSignalType=UINT8, ComTimeout=0, ComTransferProperty=PENDING, ComFactorAndOffset=1;0
        BattheatPTCRlyCtrlCmdHCU3_HCU3_FAW3_HVAC_V2_0DBC_dbc_Rx: source-file=FAW3_HVAC_V2.0DBC.dbc, ComBitPosition=12, ComBitSize=2, ComHandleId=124, ComSignalEndianness=LITTLE_ENDIAN, ComSignalInitValue=3, ComSignalType=UINT8, ComTimeout=0, ComTransferProperty=PENDING, ComFactorAndOffset=1;0
        AcsoryRlyCtrlCmdHCU3_HCU3_FAW3_HVAC_V2_0DBC_dbc_Rx: source-file=FAW3_HVAC_V2.0DBC.dbc, ComBitPosition=32, ComBitSize=2, ComHandleId=125, ComSignalEndianness=LITTLE_ENDIAN, ComSignalInitValue=3, ComSignalType=UINT8, ComTimeout=0, ComTransferProperty=PENDING, ComFactorAndOffset=1;0
        PTCRlyCtrlCmdHCU3_HCU3_FAW3_HVAC_V2_0DBC_dbc_Rx: source-file=FAW3_HVAC_V2.0DBC.dbc, ComBitPosition=34, ComBitSize=2, ComHandleId=126, ComSignalEndianness=LITTLE_ENDIAN, ComSignalInitValue=3, ComSignalType=UINT8, ComTimeout=0, ComTransferProperty=PENDING, ComFactorAndOffset=1;0
        MECURlyclosingReqHCU3_HCU3_FAW3_HVAC_V2_0DBC_dbc_Rx: source-file=FAW3_HVAC_V2.0DBC.dbc, ComBitPosition=36, ComBitSize=2, ComHandleId=127, ComSignalEndianness=LITTLE_ENDIAN, ComSignalInitValue=3, ComSignalType=UINT8, ComTimeout=0, ComTransferProperty=PENDING, ComFactorAndOffset=1;0
        DCDCRlyclosingReqHCU3_HCU3_FAW3_HVAC_V2_0DBC_dbc_Rx: source-file=FAW3_HVAC_V2.0DBC.dbc, ComBitPosition=38, ComBitSize=2, ComHandleId=128, ComSignalEndianness=LITTLE_ENDIAN, ComSignalInitValue=3, ComSignalType=UINT8, ComTimeout=0, ComTransferProperty=PENDING, ComFactorAndOffset=1;0
        acRlyclosingReqHCU3_HCU3_FAW3_HVAC_V2_0DBC_dbc_Rx: source-file=FAW3_HVAC_V2.0DBC.dbc, ComBitPosition=40, ComBitSize=2, ComHandleId=129, ComSignalEndianness=LITTLE_ENDIAN, ComSignalInitValue=3, ComSignalType=UINT8, ComTimeout=0, ComTransferProperty=PENDING, ComFactorAndOffset=1;0
        DirtCurChrg1PosRlyCtrlCmdBMS5_BMS5_FAW3_HVAC_V2_0DBC_dbc_Rx: source-file=FAW3_HVAC_V2.0DBC.dbc, ComBitPosition=0, ComBitSize=2, ComFirstTimeout=0.5, ComHandleId=130, ComSignalEndianness=LITTLE_ENDIAN, ComSignalInitValue=3, ComSignalType=UINT8, ComTimeout=0.5, ComTimeoutNotification=Com_RxIpduTimeout_BMS5_OjcG_c, ComTransferProperty=PENDING, ComFactorAndOffset=1;0
        DirtCurChrg1NegRlyCtrlCmdBMS5_BMS5_FAW3_HVAC_V2_0DBC_dbc_Rx: source-file=FAW3_HVAC_V2.0DBC.dbc, ComBitPosition=2, ComBitSize=2, ComHandleId=131, ComSignalEndianness=LITTLE_ENDIAN, ComSignalInitValue=3, ComSignalType=UINT8, ComTimeout=0, ComTransferProperty=PENDING, ComFactorAndOffset=1;0
        DirtCurChrg2PosRlyCtrlCmdBMS5_BMS5_FAW3_HVAC_V2_0DBC_dbc_Rx: source-file=FAW3_HVAC_V2.0DBC.dbc, ComBitPosition=4, ComBitSize=2, ComHandleId=132, ComSignalEndianness=LITTLE_ENDIAN, ComSignalInitValue=3, ComSignalType=UINT8, ComTimeout=0, ComTransferProperty=PENDING, ComFactorAndOffset=1;0
        DirtCurChrg2NegRlyCtrlCmdBMS5_BMS5_FAW3_HVAC_V2_0DBC_dbc_Rx: source-file=FAW3_HVAC_V2.0DBC.dbc, ComBitPosition=6, ComBitSize=2, ComHandleId=133, ComSignalEndianness=LITTLE_ENDIAN, ComSignalInitValue=3, ComSignalType=UINT8, ComTimeout=0, ComTransferProperty=PENDING, ComFactorAndOffset=1;0
        WtrCoolgRlyCtrlCmdBMS5_BMS5_FAW3_HVAC_V2_0DBC_dbc_Rx: source-file=FAW3_HVAC_V2.0DBC.dbc, ComBitPosition=8, ComBitSize=2, ComHandleId=134, ComSignalEndianness=LITTLE_ENDIAN, ComSignalInitValue=0, ComSignalType=UINT8, ComTimeout=0, ComTransferProperty=PENDING, ComFactorAndOffset=1;0
        insulationtesterCtrlCmdBMS5_BMS5_FAW3_HVAC_V2_0DBC_dbc_Rx: source-file=FAW3_HVAC_V2.0DBC.dbc, ComBitPosition=12, ComBitSize=2, ComHandleId=135, ComSignalEndianness=LITTLE_ENDIAN, ComSignalInitValue=3, ComSignalType=UINT8, ComTimeout=0, ComTransferProperty=PENDING, ComFactorAndOffset=1;0
        mainNegRlyStsBMS5_BMS5_FAW3_HVAC_V2_0DBC_dbc_Rx: source-file=FAW3_HVAC_V2.0DBC.dbc, ComBitPosition=40, ComBitSize=3, ComHandleId=136, ComSignalEndianness=LITTLE_ENDIAN, ComSignalInitValue=7, ComSignalType=UINT8, ComTimeout=0, ComTransferProperty=PENDING, ComFactorAndOffset=1;0
        MotCtrllerbusUMCU2_MCU2_FAW3_HVAC_V2_0DBC_dbc_Rx: source-file=FAW3_HVAC_V2.0DBC.dbc, ComBitPosition=0, ComBitSize=16, ComFirstTimeout=1, ComHandleId=137, ComSignalEndianness=LITTLE_ENDIAN, ComSignalInitValue=0, ComSignalType=UINT16, ComTimeout=1, ComTimeoutNotification=Com_RxIpduTimeout_MCU2_OjcG_c, ComTransferProperty=PENDING, ComFactorAndOffset=0.05;0
        MotCtrllerbusCurMCU2_MCU2_FAW3_HVAC_V2_0DBC_dbc_Rx: source-file=FAW3_HVAC_V2.0DBC.dbc, ComBitPosition=16, ComBitSize=16, ComHandleId=138, ComSignalEndianness=LITTLE_ENDIAN, ComSignalInitValue=32000, ComSignalType=UINT16, ComTimeout=0, ComTransferProperty=PENDING, ComFactorAndOffset=0.05;-1600
        MotTMCU2_MCU2_FAW3_HVAC_V2_0DBC_dbc_Rx: source-file=FAW3_HVAC_V2.0DBC.dbc, ComBitPosition=32, ComBitSize=8, ComHandleId=139, ComSignalEndianness=LITTLE_ENDIAN, ComSignalInitValue=64, ComSignalType=UINT8, ComTimeout=0, ComTransferProperty=PENDING, ComFactorAndOffset=1;-40
        MotCtrllerTMCU2_MCU2_FAW3_HVAC_V2_0DBC_dbc_Rx: source-file=FAW3_HVAC_V2.0DBC.dbc, ComBitPosition=40, ComBitSize=8, ComHandleId=140, ComSignalEndianness=LITTLE_ENDIAN, ComSignalInitValue=64, ComSignalType=UINT8, ComTimeout=0, ComTransferProperty=PENDING, ComFactorAndOffset=1;-40
      ComTimeBase: import=COMM_IMPORT, ComGwTimeBase=0.005, ComRxTimeBase=0.005, ComTxTimeBase=0.005
    ComGeneral:
      import = NONE
      ComConfigurationUseDet = true
      ComEnableSignalGroupArrayApi = false
      ComMetaDataSupport = false
      ComRetryFailedTransmitRequests = false
      ComMultiCoreSupport = false
      ComSupportedIPduGroups = 6
      ComUserCbkHeaderFile = ComRx_Indication.h
      ComVersionInfoApi = true
