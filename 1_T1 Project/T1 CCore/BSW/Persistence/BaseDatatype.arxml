AUTOSAR XML (schema 4-3-0)
standard types defined: void, boolean, float32, float64, sint16, sint32, sint64, sint8, uint16, uint32, uint64, uint8, boolean_CompuMethod, boolean_DataConstr, float32_DataConstr, float64_DataConstr, sint16_DataConstr, sint32_DataConstr, sint64_DataConstr, sint8_DataConstr, uint16_DataConstr, uint32_DataConstr, uint64_DataConstr, uint8_DataConstr
